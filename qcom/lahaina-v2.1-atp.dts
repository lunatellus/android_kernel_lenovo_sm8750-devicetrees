// SPDX-License-Identifier: BSD-3-Clause
/*
 * Copyright (c) Qualcomm Technologies, Inc. and/or its subsidiaries.
 */

/dts-v1/;

#include "lahaina-v2.1.dtsi"
#include "lahaina-atp.dtsi"

/ {
	model = "Qualcomm Technologies, Inc. Lahaina v2.1 ATP";
	compatible = "qcom,lahaina-atp", "qcom,lahaina", "qcom,atp";
	qcom,board-id = <0x10021 0>;
};
