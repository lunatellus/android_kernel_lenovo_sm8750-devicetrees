// SPDX-License-Identifier: BSD-3-Clause
/*
 * Copyright (c) Qualcomm Technologies, Inc. and/or its subsidiaries.
 */

#include "alorp.dtsi"

/ {
	model = "Qualcomm Technologies, Inc. AlorP IoT";
	compatible = "qcom,alorp";
	qcom,msm-id = <764 0x10000>;
};
