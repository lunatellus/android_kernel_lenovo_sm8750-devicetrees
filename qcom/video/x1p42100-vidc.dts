// SPDX-License-Identifier: BSD-3-Clause
/*
 * Copyright (c) Qualcomm Technologies, Inc. and/or its subsidiaries.
 */

/dts-v1/;
/plugin/;

#include <dt-bindings/interrupt-controller/arm-gic.h>
#include <dt-bindings/clock/qcom,x1p42100-gcc.h>
#include <dt-bindings/interconnect/qcom,x1p42100-rpmh.h>
#include <dt-bindings/clock/qcom,x1p42100-videocc.h>
#include "x1p42100-vidc.dtsi"


/ {
	model = "Qualcomm Technologies, Inc. x1p42100";
	compatible = "qcom,x1p42100";
	qcom,msm-id = <635 0x10000>, <635 0x20000>;
	qcom,board-id = <0 0>;
};
