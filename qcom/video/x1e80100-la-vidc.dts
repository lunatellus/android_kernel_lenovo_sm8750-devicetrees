// SPDX-License-Identifier: BSD-3-Clause
/*
 * Copyright (c) Qualcomm Technologies, Inc. and/or its subsidiaries.
 */

/dts-v1/;
/plugin/;

#include <dt-bindings/interrupt-controller/arm-gic.h>
#include <dt-bindings/clock/qcom,x1e80100-gcc.h>
#include <dt-bindings/interconnect/qcom,x1e80100-rpmh.h>
#include <dt-bindings/clock/qcom,sm8650-videocc.h>
#include "x1e80100-vidc.dtsi"

/ {
	model = "Qualcomm Technologies, Inc. X1E80100";
	compatible = "qcom,x1e80100";
	qcom,msm-id = <555 0x10000>, <555 0x20000>;
	qcom,board-id = <0 0>;
};

&secure_non_pixel_cb {
	compatible = "qcom,vidc,cb-sec-non-pxl";
	iommus = <&apps_smmu 0x1944 0x0000>;
	qcom,iommu-vmid = <0xB>; /* VMID_CP_NON_PIXEL */
	};

&secure_bitstream_cb {
	compatible = "qcom,vidc,cb-sec-bitstream";
	iommus = <&apps_smmu 0x1941 0x0004>;
	qcom,iommu-vmid = <0x9>; /* VMID_CP_BITSTREAM */
	};

&secure_pixel_cb {
	compatible = "qcom,vidc,cb-sec-pxl";
	iommus = <&apps_smmu 0x1943 0x0000>;
	qcom,iommu-vmid = <0xA>; /* VMID_CP_PIXEL */
	};
