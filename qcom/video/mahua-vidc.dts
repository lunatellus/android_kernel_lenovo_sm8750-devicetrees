// SPDX-License-Identifier: BSD-3-Clause
/*
 * Copyright (c) Qualcomm Technologies, Inc. and/or its subsidiaries.
 */

/dts-v1/;
/plugin/;

#include <dt-bindings/interrupt-controller/arm-gic.h>
#include <dt-bindings/clock/qcom,glymur-gcc.h>
#include <dt-bindings/interconnect/qcom,glymur-rpmh.h>
#include <dt-bindings/clock/qcom,glymur-videocc.h>
#include <dt-bindings/interconnect/qcom,icc.h>
#include "mahua-vidc.dtsi"

/ {
	model = "Qualcomm Technologies, Inc. mahua";
	compatible = "qcom,mahua";
	qcom,msm-id = <693 0x10000>,<693 0x20000>;
	qcom,board-id = <0 0>;
};
