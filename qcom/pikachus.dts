// SPDX-License-Identifier: BSD-3-Clause
/*
 * Copyright (c) Qualcomm Technologies, Inc. and/or its subsidiaries.
 */
/dts-v1/;

#include "pikachus.dtsi"

/ {
	model = "Qualcomm Technologies, Inc. PikachuS SoC";
	compatible = "qcom,pikachus";
	qcom,board-id = <0 0>;
};

