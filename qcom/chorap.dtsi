// SPDX-License-Identifier: BSD-3-Clause
/*
 * Copyright (c) Qualcomm Technologies, Inc. and/or its subsidiaries.
 */

#include "chora.dtsi"

/ {
	model = "Qualcomm Technologies, Inc. ChoraP";
	compatible = "qcom,chorap";
	qcom,msm-id = <744 0x10000>;
};
