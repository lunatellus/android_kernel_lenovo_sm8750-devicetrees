// SPDX-License-Identifier: BSD-3-Clause
/*
 * Copyright (c) Qualcomm Technologies, Inc. and/or its subsidiaries.
 */

/dts-v1/;

#include "bengal-iot.dtsi"
#include "bengal-iot-idp.dtsi"

/ {
	model = "Qualcomm Technologies, Inc. BENGAL-IOT IDP USBC Audio";
	compatible = "qcom,bengal-iot-idp", "qcom,bengal-iot", "qcom,idp";
	qcom,board-id = <34 1>;
};
