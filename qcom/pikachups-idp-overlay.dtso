// SPDX-License-Identifier: BSD-3-Clause
/*
 * Copyright (c) Qualcomm Technologies, Inc. and/or its subsidiaries.
 */

/dts-v1/;
/plugin/;

#include "pikachups-idp.dtsi"

/ {
	model = "Qualcomm Technologies, Inc. PikachuPS IDP";
	compatible = "qcom,pikachups-idp", "qcom,pikachups", "qcom,idp";
	qcom,msm-id = <783 0x10000>;
	qcom,board-id = <0x10022 0>;
};


