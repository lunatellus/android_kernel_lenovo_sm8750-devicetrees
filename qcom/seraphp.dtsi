// SPDX-License-Identifier: BSD-3-Clause
/*
 * Copyright (c) Qualcomm Technologies, Inc. and/or its subsidiaries.
 */

/dts-v1/;

#include "seraph.dtsi"

/ {
	model = "Qualcomm Technologies, Inc. SeraphP SoC";
	compatible = "qcom,seraphp";
	qcom,msm-id = <673 0x10000>;
};
