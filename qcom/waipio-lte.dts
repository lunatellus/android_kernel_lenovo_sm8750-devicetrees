// SPDX-License-Identifier: BSD-3-Clause
/*
 * Copyright (c) Qualcomm Technologies, Inc. and/or its subsidiaries.
 */

/dts-v1/;

#include "waipio-lte.dtsi"

/ {
	model = "Qualcomm Technologies, Inc. Waipio LTE SoC";
	compatible = "qcom,waipio";
	qcom,board-id = <0 0>;
};
