// SPDX-License-Identifier: BSD-3-Clause
/*
 * Copyright (c) Qualcomm Technologies, Inc. and/or its subsidiaries.
 */

/dts-v1/;
/plugin/;

#include "shikra-rumi.dtsi"

/ {
  model = "Qualcomm Technologies, Inc. Shikra RUMI";
  compatible = "qcom,shikra-rumi", "qcom,shikra", "qcom,rumi";
  qcom,msm-id = <756 0x10000>;
  qcom,board-id = <15 0 >;
};
