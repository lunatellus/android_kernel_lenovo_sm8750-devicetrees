// SPDX-License-Identifier: BSD-3-Clause
/*
 * Copyright (c) Qualcomm Technologies, Inc. and/or its subsidiaries.
 */

/dts-v1/;

#include "lahainap-v2.1.dtsi"

/ {
	model = "Qualcomm Technologies, Inc. LahianaP v2.1 SoC";
	compatible = "qcom,lahainap";
	qcom,board-id = <0 0>;
};
