// SPDX-License-Identifier: BSD-3-Clause
/*
 * Copyright (c) Qualcomm Technologies, Inc. and/or its subsidiaries.
 */

/dts-v1/;
/plugin/;

#include "vienna-rumi.dtsi"
#include "vienna-pmw6100-v2.dtsi"

/ {
	model = "Qualcomm Technologies, Inc. Vienna RUMI PMW6100 V2";
	compatible = "qcom,vienna-rumi", "qcom,vienna", "qcom,rumi";
	qcom,board-id = <15 0 >;
	qcom,pmic-id = <0x20064 0x0 0x0 0x0>;
};
