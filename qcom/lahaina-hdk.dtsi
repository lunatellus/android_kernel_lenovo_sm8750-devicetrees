// SPDX-License-Identifier: BSD-3-Clause
/*
 * Copyright (c) Qualcomm Technologies, Inc. and/or its subsidiaries.
 */

#include "lahaina-qrd-common.dtsi"

&usb1 {
	dwc3@a800000 {
		dr_mode = "host";
	};
};

&sdhc_2 {
	cd-gpios = <&tlmm 92 GPIO_ACTIVE_HIGH>;
};

&pcie1 {
	qcom,link-check-max-count = <50>;
	qcom,ep-gpio = <&tlmm 6 0>;
	qcom,boot-option = <0x0>;
};
