// SPDX-License-Identifier: BSD-3-Clause
/*
 * Copyright (c) Qualcomm Technologies, Inc. and/or its subsidiaries.
 */

/dts-v1/;
/plugin/;

#include "shikra-nfc-common-gpios.dtsi"

/ {
  model = "Qualcomm Technologies, Inc. Shikra EVK Kunlun NFC";
  compatible = "qcom,shikra-evk", "qcom,shikra-cqm", "qcom,shikra-cqs", "qcom,evk";
  qcom,msm-id = <756 0x10000>, <758 0x10000>;
  qcom,board-id = <0x20033 0x0>, <0x10021 0x0>;
};
