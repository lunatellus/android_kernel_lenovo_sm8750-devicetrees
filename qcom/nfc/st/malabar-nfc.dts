// SPDX-License-Identifier: BSD-3-Clause
/*
 *  Copyright (c) Qualcomm Technologies, Inc. and/or its subsidiaries.
 */

/dts-v1/;
/plugin/;

#include "malabar-nfc-common-gpios.dtsi"
/ {
        model = "Qualcomm Technologies, Inc. Malabar SoC";
        compatible = "qcom,malabar", "qcom,malabar-qmb";
        qcom,msm-id = <733 0x10000>, <757 0x10000>, <800 0x10000>;
        qcom,board-id = <0x10015 0>, <33 0>, <0x20001 0>, <0x10001 0>,
                        <0x10008 0>, <0x1000b 0>, <0x10008 0x600>, <0x1000b 0x600>,
                        <0x10001 0x600>, <0x10101 0x0>, <0x10001 1>, <0x10008 1>,
                        <0x10108 0x0>, <0x1010b 0>;
};
