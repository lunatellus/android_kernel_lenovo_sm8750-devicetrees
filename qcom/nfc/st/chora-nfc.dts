// SPDX-License-Identifier: BSD-3-Clause

/*
 * Copyright (c) Qualcomm Technologies, Inc. and/or its subsidiaries.
 */

/dts-v1/;
/plugin/;

#include "chora-nfc-common-gpios.dtsi"
/ {
        model = "Qualcomm Technologies, Inc. Chora SoC";
        compatible = "qcom,chora";
        qcom,msm-id = <724 0x10000>, <744 0x10000>;
        qcom,board-id = <0x10008 0x0>, <0x1000b 0x0>, <0x10021 0x0>,
			<0x10001 0x0>, <0x10015 0x0>, <0x1020b 0x0>,
                        <0x2020b 0x0>, <0x10208 0x0>, <0x10121 0x0>,
                        <0x10101 0x0>, <0x10308 0x0>, <0x10115 0x0>,
                        <0x10108 0x0>, <0x2000b 0x0>, <0x10215 0x0>;
};
