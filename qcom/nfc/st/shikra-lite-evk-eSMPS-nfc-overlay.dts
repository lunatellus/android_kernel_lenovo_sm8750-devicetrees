// SPDX-License-Identifier: BSD-3-Clause
/*
 * Copyright (c) Qualcomm Technologies, Inc. and/or its subsidiaries.
 */

/dts-v1/;
/plugin/;

#include "shikra-nfc-common-gpios.dtsi"

/ {
  model = "Qualcomm Technologies, Inc. Shikra Lite EVK eSMPS NFC";
  compatible = "qcom,shikra-lite-evk", "qcom,shikra-lite-cqm", "qcom,shikra-lite-cqs", "qcom,evk";
  qcom,msm-id = <756 0x10000>, <758 0x10000>;
  qcom,board-id = <0x10033 0x0>;
};
