// SPDX-License-Identifier: BSD-3-Clause
/*
 *  Copyright (c) Qualcomm Technologies, Inc. and/or its subsidiaries.
 */

/dts-v1/;
/plugin/;

#include "malabar-nfc-sn220-gpios.dtsi"

/ {
        model = "Qualcomm Technologies, Inc. Malabar SoC";
        compatible = "qcom,malabar", "qcom,malabar-qmb";
        qcom,msm-id = <733 0x10000>, <757 0x10000>, <800 0x10000>;
        qcom,board-id = <0x20008 0>;
};
