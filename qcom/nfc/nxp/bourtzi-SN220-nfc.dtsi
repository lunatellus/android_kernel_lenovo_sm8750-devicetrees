// SPDX-License-Identifier: BSD-3-Clause
/*
 * Copyright (c) Qualcomm Technologies, Inc. and/or its subsidiaries.
 */

&qupv3_se8_i2c {
	status = "ok";
	#address-cells = <1>;
	#size-cells = <0>;
	nq@28 {
		compatible = "qcom,sn-nci";
		reg = <0x28>;
		qcom,sn-irq = <&tlmm 9 0x00>;
		qcom,sn-ven = <&tlmm 4 0x00>;
		qcom,sn-clkreq = <&tlmm 98 0x00>;
		qcom,sn-vdd-1p8-supply = <&L23B_E0>;
		qcom,sn-vdd-1p8-voltage = <1650000 1950000>;
		qcom,sn-vdd-1p8-current = <9999>;
		interrupt-parent = <&tlmm>;
		interrupts = <9 0>;
		interrupt-names = "nfc_irq";
	};
};
