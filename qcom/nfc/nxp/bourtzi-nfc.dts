// SPDX-License-Identifier: BSD-3-Clause

/*
 * Copyright (c) Qualcomm Technologies, Inc. and/or its subsidiaries.
 */

/dts-v1/;
/plugin/;

#include "bourtzi-SN220-nfc.dtsi"
/ {
        model = "Qualcomm Technologies, Inc. Bourtzi SoC";
        compatible = "qcom,bourtzi";
        qcom,msm-id = <776 0x10000>, <777 0x10000>;
        qcom,board-id = <0x20008 0x0>, <0x20015 0x0>, <0x40015 0x0>;
};
