// SPDX-License-Identifier: BSD-3-Clause
/*
 * Copyright (c) Qualcomm Technologies, Inc. and/or its subsidiaries.
 */

/dts-v1/;
/plugin/;

#include "bengal-nfc-common-gpios.dtsi"
/ {
        model = "Qualcomm Technologies, Inc. Bengal SoC";
        compatible = "qcom,bengal";
        qcom,msm-id = <417 0x10000>, <444 0x10000>, <420 0x10000>, <445 0x10000>, <470 0x10000>, <469 0x10000>;
        qcom,board-id = <34 0>, <34 1>, <0x1000B 0>, <15 0>;
};

