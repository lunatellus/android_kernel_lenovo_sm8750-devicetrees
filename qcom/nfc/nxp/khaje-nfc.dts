// SPDX-License-Identifier: BSD-3-Clause
/*
 * Copyright (c) Qualcomm Technologies, Inc. and/or its subsidiaries.
 */

/dts-v1/;
/plugin/;

#include "khaje-nfc-common-gpios.dtsi"
/ {
	model = "Qualcomm Technologies, Inc. Khaje SoC";
	compatible = "qcom,khaje";
	qcom,msm-id = <518 0x10000>, <561 0x10000>, <562 0x10000>, <586 0x10000>, <762 0x10000>;
	qcom,board-id = <0x10022 0>, <0x10122 0>, <0x1010022 0>, <0x1010B 0>, <0x2010B 0>, <0x1000B 0>;
};
