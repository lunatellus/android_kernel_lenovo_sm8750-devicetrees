// SPDX-License-Identifier: BSD-3-Clause

/*
 * Copyright (c) Qualcomm Technologies, Inc. and/or its subsidiaries.
 */

/dts-v1/;
/plugin/;

#include "diwali-nfc.dtsi"
/ {
        model = "Qualcomm Technologies, Inc. Diwali SoC";
        compatible = "qcom,diwali";
        qcom,msm-id = <506 0x10000>, <547 0x10000>, <564 0x10000>;
        qcom,board-id = <33 0>, <34 0>, <34 1>, <34 2>, <34 3>, <0x1000B 0>;
};
