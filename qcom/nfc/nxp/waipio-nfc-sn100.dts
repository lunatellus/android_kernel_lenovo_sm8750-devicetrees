// SPDX-License-Identifier: BSD-3-Clause

/*
 * Copyright (c) Qualcomm Technologies, Inc. and/or its subsidiaries.
 */

/dts-v1/;
/plugin/;

#include "waipio-nfc.dtsi"
/ {
        model = "Qualcomm Technologies, Inc. Waipio SoC";
        compatible = "qcom,waipio";
        qcom,msm-id = <457 0x10000>, <482 0x10000>, <457 0x20000>, <482 0x20000>, <552 0x10000>;
        qcom,board-id = <0x10021 0>, <0x10001 0>, <0x10101 0x1>, <0x02010001 0x2>,
                        <0x01010001 0x1>,<0x1000b 0>, <0x2000b 0>, <0x10008 0>,
                        <0x01010008 0x1>,<0x10101 0x1>, <0x02010008 0>,<0x03010008 0x03>,
                        <0x04010008 0x04>, <0x10008 5>;
};
