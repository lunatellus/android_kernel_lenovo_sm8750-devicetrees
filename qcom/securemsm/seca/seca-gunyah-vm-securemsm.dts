// SPDX-License-Identifier: BSD-3-Clause
/*
 * Copyright (c) Qualcomm Technologies, Inc. and/or its subsidiaries.
 */

/dts-v1/;
/plugin/;

#include "seca-vm-securemsm.dtsi"

/ {
	model = "Qualcomm Technologies, Inc. SECA QAM Gunyah VM";
	compatible = "qcom,seca", "qcom,qam";
	qcom,msm-id = <742 0x10000>, <742 0x10001>;
	qcom,board-id = <0x00010019 0x0>, <0x00010025 0x0>,
			<0x00010019 0x1>, <0x00010025 0x1>;
};
