// SPDX-License-Identifier: BSD-3-Clause
/*
 * Copyright (c) Qualcomm Technologies, Inc. and/or its subsidiaries.
 */

/dts-v1/;
/plugin/;

#include "monaco-vm-securemsm.dtsi"

/ {
	model = "Qualcomm Technologies, Inc. Monaco Guest Virtual Machine";
	compatible = "qcom,monaco", "qcom,quinvm";
	qcom,msm-id = <606 0x10000>, <695 0x10000>;
	qcom,board-id = <0x0 0x1000001>, <0x0 0x1000002>, <0x0 0x2000001>, <0x0 0x2000002>;
};
