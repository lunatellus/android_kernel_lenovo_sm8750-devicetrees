// SPDX-License-Identifier: BSD-3-Clause
/*
 * Copyright (c) Qualcomm Technologies, Inc. and/or its subsidiaries.
 */

&soc {
	qcom_qseecom: qseecom@d0e00000 {
		compatible = "qcom,qseecom";
		reg = <0xd0e00000 0x1800000>;
		reg-names = "secapp-region";
		memory-region = <&qseecom_mem>;
		qcom,hlos-num-ce-hw-instances = <1>;
		qcom,hlos-ce-hw-instance = <0>;
		qcom,qsee-ce-hw-instance = <0>;
		qcom,disk-encrypt-pipe-pair = <2>;
		qcom,no-clock-support;
		qcom,commonlib-loaded-by-hostvm;
		qcom,qsee-reentrancy-support = <2>;
	};
};
