// SPDX-License-Identifier: BSD-3-Clause
/*
 * Copyright (c) Qualcomm Technologies, Inc. and/or its subsidiaries.
 */

/dts-v1/;

#include "waipio-lte.dtsi"
#include "waipio-atp.dtsi"
#include "waipio-pm8008.dtsi"

/ {
	model = "Qualcomm Technologies, Inc. Waipio LTE ATP with PM8008";
	compatible = "qcom,waipio-atp", "qcom,waipio", "qcom,atp";
	qcom,board-id = <33 0>;
};
