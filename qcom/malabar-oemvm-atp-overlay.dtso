// SPDX-License-Identifier: BSD-3-Clause
/*
 * Copyright (c) Qualcomm Technologies, Inc. and/or its subsidiaries.
 */
/dts-v1/;
/plugin/;

#include "malabar-oemvm-avf.dtsi"
#include "malabar-oemvm-atp-avf.dtsi"

/ {
	model = "Qualcomm Technologies, Inc. Malabar OEMVM ATP";
	compatible = "qcom,malabar-atp", "qcom,malabar", "qcom,malabarp-atp",
			"qcom,malabarp", "qcom,atp";
	qcom,board-id = <33 0>;

	host {
	};
};
