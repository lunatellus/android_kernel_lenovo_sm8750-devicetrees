// SPDX-License-Identifier: BSD-3-Clause
/*
 * Copyright (c) Qualcomm Technologies, Inc. and/or its subsidiaries.
 */

/dts-v1/;
/plugin/;

#include "shikra-evk-kunlun-nfc-imxcam.dtsi"

/ {
  model = "Qualcomm Technologies, Inc. Shikra EVK Kunlun NFC IMXCAM";
  compatible = "qcom,shikra-evk", "qcom,shikra", "qcom,shikra-cqm", "qcom,shikra-cqs", "qcom,evk";
  qcom,board-id = <0x20033 0x01>;
};
