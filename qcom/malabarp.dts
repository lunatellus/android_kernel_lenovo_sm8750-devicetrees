// SPDX-License-Identifier: BSD-3-Clause
/*
 * Copyright (c) Qualcomm Technologies, Inc. and/or its subsidiaries.
 */

/dts-v1/;

#include "malabarp.dtsi"

/ {
	model = "Qualcomm Technologies, Inc. MalabarP SoC";
	compatible = "qcom,malabarp";
	qcom,board-id = <0 0>;
};
