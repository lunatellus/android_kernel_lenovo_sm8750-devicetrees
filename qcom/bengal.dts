// SPDX-License-Identifier: BSD-3-Clause
/*
 * Copyright (c) Qualcomm Technologies, Inc. and/or its subsidiaries.
 */

/dts-v1/;

#include "bengal.dtsi"

/ {
	model = "Qualcomm Technologies, Inc. Bengal SoC";
	compatible = "qcom,bengal";
	qcom,board-id = <0 0>;
};
