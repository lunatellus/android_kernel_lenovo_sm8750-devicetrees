// SPDX-License-Identifier: BSD-3-Clause
/*
 * Copyright (c) Qualcomm Technologies, Inc. and/or its subsidiaries.
 */

#include "ravelin-sg.dtsi"

/ {

	model = "Qualcomm Technologies, Inc. RavelinP SG";
	compatible = "qcom,ravelinp";
	qcom,msm-id = <654 0x10000>;
};
