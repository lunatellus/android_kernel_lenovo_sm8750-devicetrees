// SPDX-License-Identifier: BSD-3-Clause
/*
 * Copyright (c) Qualcomm Technologies, Inc. and/or its subsidiaries.
 */
/dts-v1/;

#include "pikachu.dtsi"

/ {
	model = "Qualcomm Technologies, Inc. Pikachu SoC";
	compatible = "qcom,pikachu";
	qcom,board-id = <0 0>;
};
