// SPDX-License-Identifier: BSD-3-Clause
/*
 * Copyright (c) Qualcomm Technologies, Inc. and/or its subsidiaries.
 */

#include "malabar.dtsi"

&display_heap {
	status = "disabled";
};

&reserved_memory {
	/delete-node/ non_secure_display_memory;
	/delete-node/ mem_dump_region;
	/delete-node/ trust_ui_vm_region@f3800000;
	/delete-node/ oem_vm_region@f7c00000;
	/delete-node/ vm_comm_mem_region;
};

&soc {
	/* Delete old reserved_mmeory & add new node here */
	/delete-node/ mem_dump;
	/delete-node/ qcom,gunyah-panic-notifier;
	/delete-node/ dmesg-dump;
	/delete-node/ gunyah-cma-mem;
};
