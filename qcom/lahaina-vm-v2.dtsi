// SPDX-License-Identifier: BSD-3-Clause
/*
 * Copyright (c) Qualcomm Technologies, Inc. and/or its subsidiaries.
 */

#include "lahaina-vm.dtsi"

/ {
	model = "Qualcomm Technologies, Inc. Lahaina VM v2";
	compatible = "qcom,lahaina";
	qcom,msm-id = <415 0x20000>, <501 0x20000>;
};
