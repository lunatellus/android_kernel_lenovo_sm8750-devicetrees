// SPDX-License-Identifier: BSD-3-Clause
/*
 * Copyright (c) Qualcomm Technologies, Inc. and/or its subsidiaries.
 */

/dts-v1/;
/plugin/;

/ {
	model = "Qualcomm Technologies, Inc. SA8x97p MGVM LV Guest Virtual Machine";
	compatible = "qcom,sa8797p", "qcom,quinvm";
	qcom,msm-id = <690 0x10000>, <690 0x10001>, <690 0x20000>;
	qcom,board-id = <0x0 0x2000002>;
};

#include "sa8797p-sdp8-vm.dtsi"
#include "sa8797p-sdp8-vm-lv-mt.dtsi"

&{/} {
	model = "Qualcomm Technologies, Inc. SA8x97p MGVM LV Guest Virtual Machine";
	compatible = "qcom,sa8797p", "qcom,quinvm";
	qcom,msm-id = <690 0x10000>, <690 0x10001>, <690 0x20000>;
	qcom,board-id = <0x0 0x2000002>;
	qcom,msm-name  = "SA_QX_VM";

	#address-cells = <2>;
	#size-cells = <2>;
};
