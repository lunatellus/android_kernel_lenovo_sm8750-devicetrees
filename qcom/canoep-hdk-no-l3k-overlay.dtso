// SPDX-License-Identifier: BSD-3-Clause
/*
 * Copyright (c) Qualcomm Technologies, Inc. and/or its subsidiaries.
 */

/dts-v1/;
/plugin/;

#include "canoep-hdk-no-l3k.dtsi"

/ {
	model = "Qualcomm Technologies, Inc. CanoeP HDK + Pandeiro + No L3k";
	compatible = "qcom,canoep-hdk", "qcom,canoep", "qcom,hdk";
	qcom,msm-id = <661 0x10000>, <661 0x20000>, <0x1000295 0x10000>,
		      <0x1000295 0x20000>;
	qcom,board-id = <0x1011F 0>;
};
