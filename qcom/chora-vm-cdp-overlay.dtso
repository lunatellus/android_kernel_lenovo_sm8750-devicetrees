// SPDX-License-Identifier: BSD-3-Clause
/*
 * Copyright (c) Qualcomm Technologies, Inc. and/or its subsidiaries.
 */
/dts-v1/;
/plugin/;

#include "chora-vm-avf.dtsi"
#include "chora-vm-cdp-avf.dtsi"

/ {
	model = "Qualcomm Technologies, Inc. Chora SVM CDP";
	compatible = "qcom,chora-cdp", "qcom,chora", "qcom,chorap-cdp",
			"qcom,chorap", "qcom,cdp";
	qcom,board-id = <0x10001 0x0>, <0x20001 0x0>;

	host {
	};
};
