// SPDX-License-Identifier: BSD-3-Clause
/*
 * Copyright (c) Qualcomm Technologies, Inc. and/or its subsidiaries.
 */

#include "shikra.dtsi"

&qup_uart0_tx {
	drive-strength = <2>;
	bias-disable;
};

&qup_uart0_rx {
	drive-strength = <2>;
	bias-disable;
};

&uart0 {
	status = "okay";
};
