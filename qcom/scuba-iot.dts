// SPDX-License-Identifier: BSD-3-Clause
/*
 * Copyright (c) Qualcomm Technologies, Inc. and/or its subsidiaries.
 */

/dts-v1/;

#include "scuba-iot.dtsi"

/ {
	model = "Qualcomm Technologies, Inc. Scuba IOT SoC";
	compatible = "qcom,scuba-iot";
	qcom,board-id = <0 0>;
};
