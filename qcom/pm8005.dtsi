// SPDX-License-Identifier: BSD-3-Clause
/*
 * Copyright (c) Qualcomm Technologies, Inc. and/or its subsidiaries.
 */

#include <dt-bindings/spmi/spmi.h>
#include <dt-bindings/interrupt-controller/irq.h>

pm8005: pm8005@4 {
	compatible = "qcom,spmi-pmic";
	reg = <4 SPMI_USID>;
	#address-cells = <1>;
	#size-cells = <0>;

	pm8005_gpios: gpio@c000 {
		compatible = "qcom,pm8005-gpio";
		reg = <0xc000>;
		gpio-controller;
		#gpio-cells = <2>;
		interrupt-controller;
		#interrupt-cells = <2>;
	};

	pm8005_tz: qcom,temp-alarm@2400 {
		compatible = "qcom,spmi-temp-alarm";
		reg = <0x2400>;
		interrupts = <0x4 0x24 0x0 IRQ_TYPE_EDGE_BOTH>;
		#thermal-sensor-cells = <0>;
	};

};

pm8005_5: pm8005@5 {
	compatible = "qcom,spmi-pmic";
	reg = <5 SPMI_USID>;
	#address-cells = <1>;
	#size-cells = <0>;
};
