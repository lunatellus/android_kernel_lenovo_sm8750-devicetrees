// SPDX-License-Identifier: BSD-3-Clause
/*
 * Copyright (c) Qualcomm Technologies, Inc. and/or its subsidiaries.
 */

/dts-v1/;
/plugin/;

#include "pikachu-vm-avf.dtsi"
#include "pikachu-vm-idp-avf.dtsi"

/ {
	model = "Qualcomm Technologies, Inc. Pikachu SVM IDP";
	compatible = "qcom,pikachu-idp", "qcom,pikachu", "qcom,idp";
	qcom,board-id = <0x10022 0>;

	host {
	};
};
