// SPDX-License-Identifier: BSD-3-Clause
/*
 * Copyright (c) Qualcomm Technologies, Inc. and/or its subsidiaries.
 */
/dts-v1/;
/plugin/;

#include "pikachus.dtsi"
#include "pikachus-idp-dtof.dtsi"
/ {
	model = "Qualcomm Technologies, Inc. PikachuS IDP DTOF";
	compatible = "qcom,pikachus-idp", "qcom,pikachus", "qcom,idp";
	qcom,board-id = <0x10022 1>;
};

