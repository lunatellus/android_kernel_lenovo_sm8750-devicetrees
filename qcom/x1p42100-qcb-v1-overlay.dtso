// SPDX-License-Identifier: BSD-3-Clause
/*
 * Copyright (c) Qualcomm Technologies, Inc. and/or its subsidiaries.
 */

/dts-v1/;
/plugin/;

#include "x1p42100-qcb-v1.dtsi"

/ {
	model = "Qualcomm Technologies, Inc. X1P42100 QCB with MM/NSP swap";
	compatible = "qcom,x1p42100-qcb", "qcom,x1p42100", "qcom,qcb";
	qcom,msm-id = <635 0x10000>;
	qcom,board-id = <0x10022 0>;
};
