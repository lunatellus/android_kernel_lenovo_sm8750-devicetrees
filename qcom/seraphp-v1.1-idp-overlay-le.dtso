// SPDX-License-Identifier: BSD-3-Clause
/*
 * Copyright (c) Qualcomm Technologies, Inc. and/or its subsidiaries.
 */

/dts-v1/;
/plugin/;

#include "seraphp-v1.1-idp.dtsi"
#include "seraph-le-ipa-disable.dtsi"

/ {
	model = "Qualcomm Technologies, Inc. SeraphP v1.1 IDP";
	compatible = "qcom,seraphp-v1.1-idp", "qcom,seraphp", "qcom,idp";
	qcom,msm-id = <673 0x10001>;
	qcom,board-id = <0x10022 0>;
};

