// SPDX-License-Identifier: BSD-3-Clause
/*
 * Copyright (c) Qualcomm Technologies, Inc. and/or its subsidiaries.
 */

/dts-v1/;
/plugin/;

/ {
	model = "Qualcomm Technologies, Inc. Monaco Flex Multi LV Virtual Machine";
	compatible = "qcom,monaco", "qcom,quinvm";
	qcom,msm-id = <695 0x10000>;
	qcom,board-id = <0x0 0x2000002>;
	qcom,sdp = <0x320>;
};

#include "sa7255p-sdp8-vm.dtsi"
#include "sa7775p-sdp8-vm-cpu-conf.dtsi"
#include "sa7775p-sdp8-vm-lv-mt.dtsi"

&{/} {
	model = "Qualcomm Technologies, Inc. Monaco Flex Multi LV Virtual Machine";
	compatible = "qcom,monaco", "qcom,quinvm";
	qcom,msm-id = <695 0x10000>;
	qcom,board-id = <0x0 0x2000002>;
	qcom,msm-name  = "SA_QX_VM";
	qcom,sdp = <0x320>;

	#address-cells = <2>;
	#size-cells = <2>;
};
