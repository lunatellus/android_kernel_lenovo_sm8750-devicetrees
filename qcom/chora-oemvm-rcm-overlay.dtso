// SPDX-License-Identifier: BSD-3-Clause
/*
 * Copyright (c) Qualcomm Technologies, Inc. and/or its subsidiaries.
 */
/dts-v1/;
/plugin/;

#include "chora-oemvm-avf.dtsi"
#include "chora-oemvm-rcm-avf.dtsi"

/ {
	model = "Qualcomm Technologies, Inc. Chora OEMVM RCM";
	compatible = "qcom,chora-rcm", "qcom,chora", "qcom,chorap-rcm", "qcom,chorap",
			   "qcom,rcm";
	qcom,board-id = <0x10015 0x0>, <0x20015 0x0>;

	host {
	};
};
