// SPDX-License-Identifier: BSD-3-Clause
/*
 * Copyright (c) Qualcomm Technologies, Inc. and/or its subsidiaries.
 */

/dts-v1/;

#include "bengalp-iot.dtsi"

/ {
	model = "Qualcomm Technologies, Inc. BENGALP-IOT SoC";
	compatible = "qcom,bengalp-iot";
	qcom,board-id = <0 0>;
};
