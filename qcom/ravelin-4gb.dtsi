// SPDX-License-Identifier: BSD-3-Clause
/*
 * Copyright (c) Qualcomm Technologies, Inc. and/or its subsidiaries.
 */

#include "ravelin.dtsi"
#include "ravelin-low-memory.dtsi"
/ {
};

&mem_client_3_size {
	qcom,peripheral-size = <0x200000>;
};

&soc {
};
