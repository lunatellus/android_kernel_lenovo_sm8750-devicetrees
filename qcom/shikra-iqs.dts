// SPDX-License-Identifier: BSD-3-Clause
/*
 * Copyright (c) Qualcomm Technologies, Inc. and/or its subsidiaries.
 */

/dts-v1/;

#include "shikra-iqs.dtsi"

/ {
	model = "Qualcomm Technologies, Inc. Shikra IQS SoC";
	compatible = "qcom,shikra-iqs";
	qcom,board-id = <0 0>;
};
