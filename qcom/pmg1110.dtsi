// SPDX-License-Identifier: BSD-3-Clause
/*
 * Copyright (c) Qualcomm Technologies, Inc. and/or its subsidiaries.
 */

#include <dt-bindings/spmi/spmi.h>

pmg1110: pmg1110@a {
	compatible = "qcom,spmi-pmic";
	reg = <10 SPMI_USID>;
	#address-cells = <1>;
	#size-cells = <0>;

	pmg1110_tz: qcom,temp-alarm@a00 {
		compatible = "qcom,spmi-temp-alarm";
		reg = <0xa00>;
		interrupts = <0xa 0xa 0x0 IRQ_TYPE_EDGE_BOTH>;
		#thermal-sensor-cells = <0>;
	};
};
