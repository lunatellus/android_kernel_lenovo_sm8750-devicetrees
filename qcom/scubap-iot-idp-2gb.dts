// SPDX-License-Identifier: BSD-3-Clause
/*
 * Copyright (c) Qualcomm Technologies, Inc. and/or its subsidiaries.
 */

/dts-v1/;

#include "scuba-iot-low-ram.dtsi"
#include "scuba-iot-idp.dtsi"
#include "scuba-iot-qcs.dtsi"

/ {
	model = "Qualcomm Technologies, Inc. Scubap IOT IDP 2GB DDR";
	compatible = "qcom,scuba-idp", "qcom,scubap-iot", "qcom,idp";
	qcom,msm-id = <474 0x10000>;
	qcom,board-id = <34 0x400>;
};
