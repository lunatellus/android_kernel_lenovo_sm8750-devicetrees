// SPDX-License-Identifier: GPL-2.0-only

&qupv3_se4_spi {
	#address-cells = <1>;
	#size-cells = <0>;
	status = "ok";

	novatek@0 {
		compatible = "novatek,NVT-ts-spi";
		reg = <0x0>;
		status = "ok";
		spi-max-frequency = <0x989680>;
		novatek,irq-gpio = <&tlmm 0xa2 0x2001>;
		novatek,pen-support;
		novatek,mp-support-dt;
		pinctrl-names = "cs_active", "cs_sleep";
		pinctrl-0 = <&qupv3_se4_spi_cs_active>;
		pinctrl-1 = <&qupv3_se4_spi_cs_sleep>;

#include "touch/lenovo/elden-novatek-mp-criteria-6097.dtsi"
	};
};

&qupv3_se4_spi {

	novatek@0 {
		panel = <&elden_nt36523_csot_3k_dsc_vid &elden_nt36523_csot_dsc_vid>;
	};
};
