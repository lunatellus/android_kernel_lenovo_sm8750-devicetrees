// SPDX-License-Identifier: BSD-3-Clause
/*
 * Copyright (c) Qualcomm Technologies, Inc. and/or its subsidiaries.
 */

/dts-v1/;
/plugin/;

#include "chora-cdp.dtsi"
#include "chora-pm7550ba-smb1500.dtsi"

/ {
	model = "Qualcomm Technologies, Inc. Chora CDP wcn7750";
	compatible = "qcom,chora-cdp", "qcom,chora", "qcom,chorap-cdp", "qcom,chorap", "qcom,cdp";
	qcom,msm-id = <724 0x10000>, <744 0x10000>;
	qcom,board-id = <0x20001 0x0>;
};

&S6B_E0 {
	regulator-min-microvolt = <2156000>;
	regulator-max-microvolt = <2700000>;
	qcom,init-voltage = <2156000>;
};

&pm7550ba_eusb2_repeater {
	status = "ok";
	vdd18-supply = <&L7B_E0>;
	vdd3-supply = <&L17B_E0>;
};

&eusb2_phy0 {
	dummy-supply = <&pm7550ba_eusb2_repeater>;
	usb-repeater = <&pm7550ba_eusb2_repeater>;
};
