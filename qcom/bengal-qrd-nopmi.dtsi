// SPDX-License-Identifier: BSD-3-Clause
/*
 * Copyright (c) Qualcomm Technologies, Inc. and/or its subsidiaries.
 */

#include "bengal-qrd.dtsi"

&led_flash_rear {
	/delete-property/ flash-source;
	/delete-property/ torch-source;
	/delete-property/ switch-source;
};

&led_flash_rear_aux {
	/delete-property/ flash-source;
	/delete-property/ torch-source;
	/delete-property/ switch-source;
};

&led_flash_rear_aux2 {
	/delete-property/ flash-source;
	/delete-property/ torch-source;
	/delete-property/ switch-source;
};
