// SPDX-License-Identifier: BSD-3-Clause
/*
 * Copyright (c) Qualcomm Technologies, Inc. and/or its subsidiaries.
 */

/dts-v1/;
/plugin/;

#include <dt-bindings/interrupt-controller/arm-gic.h>
#include "bengal-pmi632.dtsi"
#include "bengal-rumi.dtsi"

/ {
	model = "Qualcomm Technologies, Inc. Bengal RUMI";
	compatible = "qcom,bengal-rumi", "qcom,bengal", "qcom,rumi";
	qcom,msm-id = <417 0x10000>;
	qcom,board-id = <15 0>;
};
