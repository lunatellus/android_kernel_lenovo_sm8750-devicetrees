// SPDX-License-Identifier: BSD-3-Clause
/*
 * Copyright (c) Qualcomm Technologies, Inc. and/or its subsidiaries.
 */

/dts-v1/;

#include "lahainap-v2.1.dtsi"
#include "lahainap-atp.dtsi"

/ {
	model = "Qualcomm Technologies, Inc. LahainaP v2.1 ATP";
	compatible = "qcom,lahainap-atp", "qcom,lahainap", "qcom,atp";
	qcom,board-id = <0x10021 0>;
};
