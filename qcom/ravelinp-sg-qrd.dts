// SPDX-License-Identifier: BSD-3-Clause
/*
 * Copyright (c) Qualcomm Technologies, Inc. and/or its subsidiaries.
 */

/dts-v1/;

#include "ravelinp-sg.dtsi"
#include "ravelinp-sg-qrd.dtsi"

/ {
	model = "Qualcomm Technologies, Inc. RavelinP SG QRD";
	compatible = "qcom,ravelinp-qrd", "qcom,ravelinp", "qcom,qrd";
	qcom,board-id = <0x1000B 0>;
};


