// SPDX-License-Identifier: BSD-3-Clause
/*
 * Copyright (c) Qualcomm Technologies, Inc. and/or its subsidiaries.
 */

/dts-v1/;
/plugin/;

#include "malabar-mtp-wcn3950.dtsi"
#include "malabar-pmiv010x.dtsi"

/ {
	model = "Qualcomm Technologies, Inc. Malabar MTP + WCN3950";
	compatible = "qcom,malabar-mtp", "qcom,malabar", "qcom,malabarp-mtp", "qcom,malabarp",
			"qcom,mtp";
	qcom,msm-id = <733 0x10000>, <757 0x10000>;
	qcom,board-id = <0x20008 0>;
};

&L5E {
	regulator-min-microvolt = <2952000>;
	regulator-max-microvolt = <3544000>;
	qcom,init-voltage = <2952000>;
};
