// SPDX-License-Identifier: BSD-3-Clause
/*
 * Copyright (c) Qualcomm Technologies, Inc. and/or its subsidiaries.
 */

/dts-v1/;

#include "pikachup.dtsi"

/ {
	model = "Qualcomm Technologies, Inc. PikachuP SoC";
	compatible = "qcom,pikachup";
	qcom,board-id = <0 0>;
};
