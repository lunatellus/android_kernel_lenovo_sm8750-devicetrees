// SPDX-License-Identifier: BSD-3-Clause
/*
 * Copyright (c) 2023 Qualcomm Innovation Center, Inc. All rights reserved.
 */

/dts-v1/;

#include "sunp-v2.dtsi"
#include "sun-v2-techpacks.dtsi"

#include "mm/hw_fence/sun-hw-fence.dtsi"

/ {
	model = "Qualcomm Technologies, Inc. SunP v2 SoC";
	compatible = "qcom,sunp";
	qcom,board-id = <0 0>;
};
