// SPDX-License-Identifier: BSD-3-Clause
/*
 * Copyright (c) Qualcomm Technologies, Inc. and/or its subsidiaries.
 */

/dts-v1/;
/plugin/;

#include "pikachup.dtsi"
#include "pikachup-atp.dtsi"

/ {
	model = "Qualcomm Technologies, Inc. PichakuP ATP";
	compatible = "qcom,pikachup-atp", "qcom,pikachup", "qcom,atp";
	qcom,board-id = <0x10021 0>;
};

