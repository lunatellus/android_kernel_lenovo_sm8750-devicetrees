// SPDX-License-Identifier: BSD-3-Clause
/*
 * Copyright (c) Qualcomm Technologies, Inc. and/or its subsidiaries.
 */

#include "lahaina-v2.dtsi"

/ {
	model = "Qualcomm Technologies, Inc. LahainaP v2";
	compatible = "qcom,lahainap";
	qcom,msm-id = <439 0x20000>, <502 0x20000>;
};
