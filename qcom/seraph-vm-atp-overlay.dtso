// SPDX-License-Identifier: BSD-3-Clause
/*
 * Copyright (c) Qualcomm Technologies, Inc. and/or its subsidiaries.
 */

/dts-v1/;
/plugin/;

#include "seraph-vm-avf.dtsi"
#include "seraph-vm-atp-avf.dtsi"

/ {
	model = "Qualcomm Technologies, Inc. Seraph SVM ATP";
	compatible = "qcom,seraph-atp", "qcom,seraph", "qcom,atp";
	qcom,board-id = <0x10021 0>;

	host {
	};
};
