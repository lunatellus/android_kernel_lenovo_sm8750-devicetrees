// SPDX-License-Identifier: BSD-3-Clause
/*
 * Copyright (c) Qualcomm Technologies, Inc. and/or its subsidiaries.
 */

/dts-v1/;
/plugin/;

#include <dt-bindings/clock/qcom,aop-qmp.h>
#include <dt-bindings/clock/qcom,malabar-gpucc.h>
#include <dt-bindings/clock/qcom,rpmh.h>
#include <dt-bindings/clock/qcom,sm4450-gcc.h>
#include <dt-bindings/interconnect/qcom,ravelin.h>
#include <dt-bindings/interrupt-controller/arm-gic.h>
#include <dt-bindings/regulator/qcom,rpmh-regulator-levels.h>

#include "bourtzi-gpu.dtsi"
#include "bourtzi-gpu-pwrlevels.dtsi"
/ {
		model = "Qualcomm Technologies, Inc. Bourtzi SoC";
		compatible = "qcom,bourtzi", "qcom,bourtzip",
				"qcom,bourtzi-atp", "qcom,bourtzip-atp",
				"qcom,atp", "qcom,bourtzi-cdp",
				"qcom,bourtzip-cdp", "qcom,cdp",
				"qcom,bourtzi-mtp", "qcom,bourtzip-mtp",
				"qcom,mtp", "qcom,bourtzi-qrd",
				"qcom,bourtzip-qrd", "qcom,qrd",
				"qcom,bourtzi-rcm", "qcom,bourtzip-rcm",
				"qcom,rcm";
		qcom,msm-id = <0x308 0x10000>, <0x309 0x10000>;
		qcom,board-id = <0 0>, <0x10021 0x0>, <0x10001 0x0>,
				<0x20001 0x0>, <0x10008 0x0>, <0x20008 0x0>,
				<0x1000b 0x0>, <0x10015 0x0>, <0x2000b 0x0>,
				<0x30015 0x0>, <0x20015 0x0>, <0x40015 0x0>,
				<0x10008 0x600>, <0 0x600>, <0x20001 0x600>,
                                <0x10001 0x600>, <0x30015 0x600>, <0x10015 0x600>;
};
