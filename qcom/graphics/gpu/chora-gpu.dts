// SPDX-License-Identifier: BSD-3-Clause
/*
 * Copyright (c) Qualcomm Technologies, Inc. and/or its subsidiaries.
 */

/dts-v1/;
/plugin/;

#include <dt-bindings/clock/qcom,aop-qmp.h>
#include <dt-bindings/clock/qcom,chora-gcc.h>
#include <dt-bindings/clock/qcom,chora-gpucc.h>
#include <dt-bindings/clock/qcom,rpmh.h>
#include <dt-bindings/interconnect/qcom,chora.h>
#include <dt-bindings/regulator/qcom,rpmh-regulator-levels.h>
#include <dt-bindings/interrupt-controller/arm-gic.h>

#include "chora-gpu.dtsi"
#include "chora-gpu-pwrlevels.dtsi"

/ {
	model = "Qualcomm Technologies, Inc. Chora SoC";
	compatible = "qcom,chora";
	qcom,msm-id = <724 0x10000>, <744 0x10000>;
	qcom,board-id = <0 0>;
};
