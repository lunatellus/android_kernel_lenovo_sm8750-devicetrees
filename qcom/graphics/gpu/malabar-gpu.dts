// SPDX-License-Identifier: BSD-3-Clause
/*
 * Copyright (c) Qualcomm Technologies, Inc. and/or its subsidiaries.
 */

/dts-v1/;
/plugin/;

#include <dt-bindings/clock/qcom,aop-qmp.h>
#include <dt-bindings/clock/qcom,malabar-gcc.h>
#include <dt-bindings/clock/qcom,malabar-gpucc.h>
#include <dt-bindings/clock/qcom,rpmh.h>
#include <dt-bindings/interconnect/qcom,malabar.h>
#include <dt-bindings/interrupt-controller/arm-gic.h>
#include <dt-bindings/regulator/qcom,rpmh-regulator-levels.h>

#include "malabar-gpu.dtsi"
#include "malabar-gpu-pwrlevels.dtsi"
/ {
		model = "Qualcomm Technologies, Inc. Malabar";
		compatible = "qcom,malabar";
		qcom,msm-id = <0x2F5 0x10000>, <0x2DD 0x10000>;
		qcom,board-id = <0 0>, <0 0x600>;
};
