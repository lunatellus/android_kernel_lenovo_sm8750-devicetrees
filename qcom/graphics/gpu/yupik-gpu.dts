// SPDX-License-Identifier: BSD-3-Clause
/*
 * Copyright (c) Qualcomm Technologies, Inc. and/or its subsidiaries.
 */

/dts-v1/;
/plugin/;

#include <dt-bindings/clock/qcom,aop-qmp.h>
#include <dt-bindings/clock/qcom,gcc-sc7280.h>
#include <dt-bindings/clock/qcom,gpucc-sc7280.h>
#include <dt-bindings/clock/qcom,rpmh.h>
#include <dt-bindings/interconnect/qcom,yupik.h>
#include <dt-bindings/interrupt-controller/arm-gic.h>
#include <dt-bindings/regulator/qcom,rpmh-regulator-levels.h>

#include "yupik-gpu.dtsi"
#include "yupik-gpu-pwrlevels.dtsi"
/ {
	model = "Qualcomm Technologies, Inc. Yupik";
	compatible = "qcom,yupik-iot", "qcom,yupik-iot-idp",
			"qcom,yupik-iot-qrd", "qcom,yupikp-iot",
			"qcom,yupikp-iot-idp", "qcom,yupikp-iot-qrd";
	qcom,msm-id = <497 0x10000>, <575 0x10000>,
			<576 0x10000>, <498 0x10000>,
			<475 0x10000>, <515 0x10000>;
	qcom,board-id = <0 0>, <34 1>,
			<34 0>, <34 2>,
			<0x1000B 0>;
};
