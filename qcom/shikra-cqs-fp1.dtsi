// SPDX-License-Identifier: BSD-3-Clause
/*
 * Copyright (c) Qualcomm Technologies, Inc. and/or its subsidiaries.
 */

#include "shikra-cqs.dtsi"
#include "shikra-lite-thermal.dtsi"
#include "shikra-pmic-overlay-pm4125.dtsi"

/ {
	model = "Qualcomm Technologies, Inc. Shikra CQS FP1 SoC";
	compatible = "qcom,shikra-cqs", "qcom,shikra";
	qcom,msm-id = <758 0x10000>;
	qcom,softsku-id = <1>;
};

&cdsp_pas {
	status = "disabled";
};

&lpaicp_pas {
	status = "disabled";
};
