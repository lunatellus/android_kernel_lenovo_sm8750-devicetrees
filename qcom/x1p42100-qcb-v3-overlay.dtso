// SPDX-License-Identifier: BSD-3-Clause
/*
 * Copyright (c) Qualcomm Technologies, Inc. and/or its subsidiaries.
 */

/dts-v1/;
/plugin/;

#include "x1p42100-qcb-v3.dtsi"

/ {
	model = "Qualcomm Technologies, Inc. X1P42100 QCB with DSI + Hamilton";
	compatible = "qcom,x1p42100-qcb", "qcom,x1p42100", "qcom,qcb";
	qcom,msm-id = <635 0x10000>;
	qcom,board-id = <0x30022 0>;
};
