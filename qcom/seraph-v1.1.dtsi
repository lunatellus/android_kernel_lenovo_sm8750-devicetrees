// SPDX-License-Identifier: BSD-3-Clause
/*
 * Copyright (c) Qualcomm Technologies, Inc. and/or its subsidiaries.
 */

#include "seraph.dtsi"
/ {
	model = "Qualcomm Technologies, Inc. Seraph v1.1";
	compatible = "qcom,seraph";
	qcom,msm-id = <672 0x10001>, <792 0x10001>;
};
