// SPDX-License-Identifier: BSD-3-Clause
/*
 * Copyright (c) Qualcomm Technologies, Inc. and/or its subsidiaries.
 */

/dts-v1/;
/plugin/;

/ {
	model = "Qualcomm Technologies, Inc. Lemans Flex QAM Gunyah LV VM";
	compatible = "qcom,lemans", "qcom,qam";
	qcom,msm-id = <534 0x10000>, <534 0x20000>;
	qcom,board-id = <0x10025 0x0>;
};
