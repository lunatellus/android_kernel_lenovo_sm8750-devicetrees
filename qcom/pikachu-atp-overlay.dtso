// SPDX-License-Identifier: BSD-3-Clause
/*
 * Copyright (c) Qualcomm Technologies, Inc. and/or its subsidiaries.
 */

/dts-v1/;
/plugin/;

#include "pikachu-atp.dtsi"

/ {
	model = "Qualcomm Technologies, Inc. Pikachu ATP";
	compatible = "qcom,pikachu-atp", "qcom,pikachu", "qcom,atp";
	qcom,msm-id = <736 0x10000>;
	qcom,board-id = <0x10021 0>;
};

