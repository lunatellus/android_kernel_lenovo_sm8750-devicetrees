// SPDX-License-Identifier: BSD-3-Clause
/*
 * Copyright (c) Qualcomm Technologies, Inc. and/or its subsidiaries.
 */
/dts-v1/;
/plugin/;

#include "malabar-oemvm-avf.dtsi"
#include "malabar-oemvm-qrd-avf.dtsi"

/ {
	model = "Qualcomm Technologies, Inc. Malabar OEMVM QRD";
	compatible = "qcom,malabar-qrd", "qcom,malabar", "qcom,malabarp-qrd", "qcom,malabarp",
			   "qcom,qrd";
	qcom,board-id = <0x1000b 0>;

	host {
	};
};
