// SPDX-License-Identifier: BSD-3-Clause
/*
 * Copyright (c) Qualcomm Technologies, Inc. and/or its subsidiaries.
 */

/dts-v1/;
/plugin/;

#include "shikra-lite-evk-eSMPS-nfc.dtsi"

/ {
  model = "Qualcomm Technologies, Inc. Shikra Lite EVK eSMPS NFC";
  compatible = "qcom,shikra-lite-evk", "qcom,shikra", "qcom,shikra-lite-cqm", "qcom,shikra-lite-cqs", "qcom,evk";
  qcom,board-id = <0x10033 0x0>;
};
