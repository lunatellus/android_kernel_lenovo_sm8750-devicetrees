// SPDX-License-Identifier: BSD-3-Clause
/*
 * Copyright (c) Qualcomm Technologies, Inc. and/or its subsidiaries.
 */

/dts-v1/;

#include "viennap-low-ram.dtsi"

/ {
	model = "Qualcomm Technologies, Inc. ViennaP SoC 2GB DDR";
	compatible = "qcom,viennap";
	qcom,board-id = <0 0x400>;
};
