// SPDX-License-Identifier: BSD-3-Clause
/*
 * Copyright (c) Qualcomm Technologies, Inc. and/or its subsidiaries.
 */

/dts-v1/;

#include "waipio-le.dtsi"
#include "waipio-mtp.dtsi"

/ {
	model = "Qualcomm Technologies, Inc. Waipio MTP XR with PCIE";
	compatible = "qcom,waipio-mtp", "qcom,waipio", "qcom,mtp";
	qcom,board-id = <0x10008 7>;
};
