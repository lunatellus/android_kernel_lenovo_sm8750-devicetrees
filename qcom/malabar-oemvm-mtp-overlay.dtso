// SPDX-License-Identifier: BSD-3-Clause
/*
 * Copyright (c) Qualcomm Technologies, Inc. and/or its subsidiaries.
 */
/dts-v1/;
/plugin/;

#include "malabar-oemvm-avf.dtsi"
#include "malabar-oemvm-mtp-avf.dtsi"

/ {
	model = "Qualcomm Technologies, Inc. Malabar OEMVM MTP";
	compatible = "qcom,malabar-mtp", "qcom,malabar", "qcom,malabarp-mtp",
			"qcom,malabarp", "qcom,mtp";
	qcom,board-id = <0x10008 0>, <0x20008 0>;

	host {
	};
};
