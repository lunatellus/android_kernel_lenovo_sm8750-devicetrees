// SPDX-License-Identifier: BSD-3-Clause
/*
 * Copyright (c) Qualcomm Technologies, Inc. and/or its subsidiaries.
 */

/dts-v1/;

#include "ravelinp-sg.dtsi"
#include "ravelinp-sg-idp.dtsi"

/ {
	model = "Qualcomm Technologies, Inc. RavelinP SG IDP";
	compatible = "qcom,ravelinp-idp", "qcom,ravelinp", "qcom,idp";
	qcom,board-id = <34 0>;
};

