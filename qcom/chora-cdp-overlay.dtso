// SPDX-License-Identifier: BSD-3-Clause
/*
 * Copyright (c) Qualcomm Technologies, Inc. and/or its subsidiaries.
 */

/dts-v1/;
/plugin/;

#include "chora-cdp.dtsi"
#include "chora-pmiv010x-pmd802x.dtsi"

/ {
	model = "Qualcomm Technologies, Inc. Chora CDP evros";
	compatible = "qcom,chora-cdp", "qcom,chora", "qcom,chorap-cdp", "qcom,chorap", "qcom,cdp";
	qcom,msm-id = <724 0x10000>, <744 0x10000>;
	qcom,board-id = <0x10001 0x0>;
};

&pmiv010x_eusb2_repeater {
	status = "ok";
	vdd18-supply = <&L7B_E0>;
	vdd3-supply = <&L17B_E0>;
};

&eusb2_phy0 {
	dummy-supply = <&pmiv010x_eusb2_repeater>;
	usb-repeater = <&pmiv010x_eusb2_repeater>;
};
