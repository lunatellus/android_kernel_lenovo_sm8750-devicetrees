// SPDX-License-Identifier: BSD-3-Clause
/*
 * Copyright (c) Qualcomm Technologies, Inc. and/or its subsidiaries.
 */

/dts-v1/;
/plugin/;

#include "pikachu-vm-avf.dtsi"
#include "pikachu-vm-atp-avf.dtsi"

/ {
	model = "Qualcomm Technologies, Inc. Pikachu SVM ATP";
	compatible = "qcom,pikachu-atp", "qcom,pikachu", "qcom,atp";
	qcom,board-id = <0x10021 0>;

	host {
	};
};
