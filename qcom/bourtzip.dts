// SPDX-License-Identifier: BSD-3-Clause
/*
 * Copyright (c) Qualcomm Technologies, Inc. and/or its subsidiaries.
 */

/dts-v1/;

#include "bourtzip.dtsi"

/ {
	model = "Qualcomm Technologies, Inc. BourtziP SoC";
	compatible = "qcom,bourtzip";
	qcom,board-id = <0 0>;
};
