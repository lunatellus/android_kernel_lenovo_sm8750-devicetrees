// SPDX-License-Identifier: BSD-3-Clause
/*
 * Copyright (c) Qualcomm Technologies, Inc. and/or its subsidiaries.
 */

/dts-v1/;
/plugin/;

#include "chora-wcn7750-bt.dtsi"

/ {
	model = "Qualcomm Technologies, Inc. Chora SoC ";
	compatible = "qcom,chora", "qcom,chorap",
			"qcom,chora-cdp", "qcom,chorap-cdp","qcom,cdp",
			"qcom,chora-mtp", "qcom,chorap-mtp","qcom,mtp",
			"qcom,chora-qrd", "qcom,chorap-qrd","qcom,qrd",
			"qcom,chora-rcm", "qcom,chorap-rcm","qcom,rcm";
	qcom,msm-id = <724 0x10000>, <744 0x10000>;
	qcom,board-id = <1 0>, <21 0>,
			<0x20001 0x0>,	//cdp
			<0x20008 0x0>,	//mtp
			<0x2000b 0x0>,	//qrd
			<0x20015 0x0>;	//rcm

};
