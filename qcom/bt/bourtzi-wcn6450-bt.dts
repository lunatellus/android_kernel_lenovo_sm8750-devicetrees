// SPDX-License-Identifier: BSD-3-Clause
/*
 * Copyright (c) Qualcomm Technologies, Inc. and/or its subsidiaries.
 */


/dts-v1/;
/plugin/;

#include "bourtzi-wcn6450-bt.dtsi"


/ {
        model = "Qualcomm Technologies, Inc. Bourtzi MTP + evros + cottid + tioman ";
        compatible = "qcom,bourtzi-mtp", "qcom,bourtzip-mtp","qcom,bourtzi", "qcom,bourtzip", "qcom,mtp",
        "qcom,bourtzi-qrd", "qcom,bourtzip-qrd","qcom,grd",
         "qcom,bourtzi-rcm", "qcom,bourtzip-rcm","qcom,rcm";
        qcom,msm-id = <776 0x10000>, <777 0x10000>;
        qcom,board-id = <0x20008 0x0>, <0x2000b 0x0>,<0x20015 0x0>;
};