// SPDX-License-Identifier: BSD-3-Clause

/*
 * Copyright (c) Qualcomm Technologies, Inc. and/or its subsidiaries.
 */

/dts-v1/;
/plugin/;

#include "malabar-bt.dtsi"

/ {
	model = "Qualcomm Technologies, Inc. Malabar SoC";
	compatible = "qcom,malabar", "qcom,malabarp",
			"qcom,malabar-atp", "qcom,malabarp-atp", "qcom,atp",
			"qcom,malabar-cdp", "qcom,malabarp-cdp", "qcom,cdp",
			"qcom,malabar-mtp", "qcom,malabarp-mtp", "qcom,mtp",
			"qcom,malabar-qrd", "qcom,malabarp-qrd", "qcom,qrd",
			"qcom,malabar-rcm", "qcom,malabarp-rcm", "qcom,rcm";
	qcom,msm-id = <733 0x10000>, <757 0x10000>;
	qcom,board-id = <1 0>, <8 0>, <11 0>, <21 0>,
			<33 0>,						//atp
			<0x10001 0>, <0x10001 0x600>, <0x20001 0>,	//cdp
			<0x10001 1>,
			<0x10008 0>, <0x10008 0x600>, <0x20008 0>,	//mtp
			<0x10008 1>,
			<0x1000b 0>, <0x1000b 0x600>,			//qrd
			<0x10015 0>;					//rcm

};

