// SPDX-License-Identifier: BSD-3-Clause
/*
 * Copyright (c) Qualcomm Technologies, Inc. and/or its subsidiaries.
 */

/dts-v1/;
/plugin/;

#include "lahaina-qca6490-bt.dtsi"

/ {
	model = "Qualcomm Technologies, Inc. LAHAINA  SoC";
	compatible = "qcom,lahaina-idp", "qcom,lahaina", "qcom,idp";
	qcom,msm-id = <415 0x10000>, <456 0x10000>, <501 0x10000>;
	qcom,board-id = <0 1>, <34 1>, <34 0>, <34 2>, <0x1000B 0>, <0x10021 0>, <2 0>;
};
