// SPDX-License-Identifier: BSD-3-Clause

/*
* Copyright (c) Qualcomm Technologies, Inc. and/or its subsidiaries.
 */

/dts-v1/;
/plugin/;

#include "x1e80100-kiwi-bt.dtsi"

/ {
  model = "Qualcomm Technologies, Inc. X1E80100 SOC";
  compatible = "qcom,kiwi", "qcom,x1e80100-qcb", "qcom,x1e80100", "qcom,qcb", "qcom,x1e80100-qcp", "qcom,qcp";
  qcom,msm-id = <555 0x10000>, <555 0x20000>, <0x22b 0x10000>, <0x22b 0x20000>;
  qcom,board-id = <40 0>, <0x2B 0x0>, <0x22 0>, <0x22 1>;
};
