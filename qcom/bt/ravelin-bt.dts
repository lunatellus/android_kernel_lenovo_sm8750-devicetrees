// SPDX-License-Identifier: BSD-3-Clause
/*
 * Copyright (c) 2024 Qualcomm Innovation Center, Inc. All rights reserved.
 */

/dts-v1/;
/plugin/;

#include "ravelin-bt.dtsi"

/ {
        model = "Qualcomm Technologies, Inc. Ravelin SoC";
        compatible = "qcom,ravelin", "qcom,ravelin-atp",
			"qcom,ravelin-idp", "qcom,ravelin-qrd",
			"qcom,ravelin-rumi", "qcom,ravelinp",
			"qcom,ravelinp-atp", "qcom,ravelinp-idp",
			"qcom,ravelinp-qrd";
	qcom,msm-id = <568 0x10000>, <581 0x10000>, <582 0x10000>,  <602 0x10000>, <653 0x10000>,
			<654 0x10000>;
        qcom,board-id = <0 0>, <0 0x600>, <0x1000B 0>, <0x1000B 0x600>, <0x1000F 0>, <33 0>,
			<34 0>, <34 1>, <34 2>, <34 0x600>, <34 0x601>,
			<0x10022 0x0>, <0x10022 3>, <0x10022 0x4>, <0x10022 0x5>,
			<0x10022 0x6>, <0x10022 0x7>, <0x10022 0x08>;
};
