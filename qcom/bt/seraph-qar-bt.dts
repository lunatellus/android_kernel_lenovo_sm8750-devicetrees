/*
 * Copyright (c) Qualcomm Technologies, Inc. and/or its subsidiaries.
 * SPDX-License-Identifier: BSD-3-Clause
*/

/dts-v1/;
/plugin/;

#include "seraph-qar-bt.dtsi"

/ {
	model = "Qualcomm Technologies, Inc. SeraphP QAR";
	compatible = "qcom,seraphp-qar", "qcom,seraphp", "qcom,qar", "qcom,seraphp-v1.1-qar";
	qcom,msm-id = <673 0x10000>, <673 0x10001>;
	qcom,board-id = <0x1002C 0>, <0x1002C 1>, <0x1002C 2>;
};

