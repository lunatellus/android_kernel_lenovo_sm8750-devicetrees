/*
 * Copyright (c) Qualcomm Technologies, Inc. and/or its subsidiaries.
 * SPDX-License-Identifier: BSD-3-Clause-Clear
 */

/dts-v1/;
/plugin/;

#include "seraph-bt.dtsi"

/ {
        model = "Qualcomm Technologies, Inc. Seraph SoC";
        compatible = "qcom,seraph", "qcom,seraph-v1.1-idp", "qcom,seraph-v1.1-atp";
        qcom,msm-id = <672 0x10000>, <673 0x10000>, <672 0x10001> , <673 0x10001>, <792 0x10001>;
        qcom,board-id = <0x10021 0>, <0x10022 0>, <0x10022 1>, <0x10022 2>, <0x10022 3>;
};

