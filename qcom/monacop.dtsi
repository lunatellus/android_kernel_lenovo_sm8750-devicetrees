// SPDX-License-Identifier: BSD-3-Clause
/*
 * Copyright (c) Qualcomm Technologies, Inc. and/or its subsidiaries.
 */

#include "monaco.dtsi"

/ {
	model = "Qualcomm Technologies, Inc. MonacoP";
	compatible = "qcom,monacop";
	qcom,msm-id = <517 0x10000>;
};

