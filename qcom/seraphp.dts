// SPDX-License-Identifier: BSD-3-Clause
/*
 * Copyright (c) Qualcomm Technologies, Inc. and/or its subsidiaries.
 */

/dts-v1/;

#include "seraphp.dtsi"

/ {
	model = "Qualcomm Technologies, Inc. SeraphP SoC";
	compatible = "qcom,seraphp";
	qcom,board-id = <0 0>;
};
