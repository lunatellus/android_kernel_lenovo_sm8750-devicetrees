// SPDX-License-Identifier: BSD-3-Clause
/*
 * Copyright (c) Qualcomm Technologies, Inc. and/or its subsidiaries.
 */

/dts-v1/;
/plugin/;

#include "seraphp.dtsi"
#include "seraphp-qar.dtsi"

/ {
	model = "Qualcomm Technologies, Inc. SeraphP QAR";
	compatible = "qcom,seraphp-qar", "qcom,seraphp", "qcom,qar";
	qcom,board-id = <0x1002C 0>;
};
