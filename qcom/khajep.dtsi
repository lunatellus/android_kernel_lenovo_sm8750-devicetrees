// SPDX-License-Identifier: BSD-3-Clause
/*
 * Copyright (c) Qualcomm Technologies, Inc. and/or its subsidiaries.
 */

/dts-v1/;

#include "khaje.dtsi"

/ {
	model = "Qualcomm Technologies, Inc. Khajep SoC";
	compatible = "qcom,khajep";
	qcom,msm-id = <561 0x10000>, <762 0x10000>;
};
