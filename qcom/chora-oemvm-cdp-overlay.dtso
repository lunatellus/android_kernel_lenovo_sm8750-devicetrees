// SPDX-License-Identifier: BSD-3-Clause
/*
 * Copyright (c) Qualcomm Technologies, Inc. and/or its subsidiaries.
 */
/dts-v1/;
/plugin/;

#include "chora-oemvm-avf.dtsi"
#include "chora-oemvm-cdp-avf.dtsi"

/ {
	model = "Qualcomm Technologies, Inc. Chora OEMVM CDP";
	compatible = "qcom,chora-cdp", "qcom,chora", "qcom,chorap-cdp",
			"qcom,chorap", "qcom,cdp";
	qcom,board-id = <0x10001 0x0>, <0x20001 0x0>;

	host {
	};
};
