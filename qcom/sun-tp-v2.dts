// SPDX-License-Identifier: BSD-3-Clause
/*
 * Copyright (c) 2024 Qualcomm Innovation Center, Inc. All rights reserved.
 */

/dts-v1/;

#include "sun-v2.dtsi"
#include "sun-tp-v2.dtsi"
#include "sun-v2-techpacks.dtsi"

#include "data/sun-ipa.dtsi"
#include "fingerprint/sun-fingerprint.dtsi"

/ {
	model = "Qualcomm Technologies, Inc. Sun Alt. Thermal Profile v2 SoC";
	compatible = "qcom,sun";
	qcom,board-id = <0 0>;
};
