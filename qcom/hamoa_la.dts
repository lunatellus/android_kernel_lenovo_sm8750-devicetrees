// SPDX-License-Identifier: BSD-3-Clause
/*
 * Copyright (c) Qualcomm Technologies, Inc. and/or its subsidiaries.
 */

/dts-v1/;

#include "hamoa_la.dtsi"
#include "x1e80100-coresight.dtsi"
#include "x1e80100-thermal.dtsi"

/ {
	model = "Qualcomm Technologies, Inc. hamoa la SoC";
	compatible = "qcom,x1e80100";
	qcom,board-id = <0 0>;
	qcom,msm-id = <555 0x10000>;
};
