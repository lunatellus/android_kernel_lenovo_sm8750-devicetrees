// SPDX-License-Identifier: BSD-3-Clause
/*
 * Copyright (c) Qualcomm Technologies, Inc. and/or its subsidiaries.
 */

/dts-v1/;
/plugin/;

#include "seraphp-atp.dtsi"
#include "seraph-le-ipa-disable.dtsi"

/ {
	model = "Qualcomm Technologies, Inc. SeraphP ATP";
	compatible = "qcom,seraphp-atp", "qcom,seraphp", "qcom,atp";
	qcom,msm-id = <673 0x10000>;
	qcom,board-id = <0x10021 0>;
};
