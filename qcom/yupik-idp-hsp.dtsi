// SPDX-License-Identifier: BSD-3-Clause
/*
 * Copyright (c) Qualcomm Technologies, Inc. and/or its subsidiaries.
 */

#include "yupik-idp.dtsi"

&pcie0 {
	status = "ok";
};

&pcie0_msi {
	status = "ok";
};
