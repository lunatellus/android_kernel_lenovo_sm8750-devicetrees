// SPDX-License-Identifier: BSD-3-Clause
/*
 * Copyright (c) Qualcomm Technologies, Inc. and/or its subsidiaries.
 */

/dts-v1/;
/plugin/;

/ {
	model = "Qualcomm Technologies, Inc. SA8797p-v2 Multi LA  Guest Virtual Machine";
	compatible = "qcom,sa8797p", "qcom,quinvm";
	qcom,msm-id = <690 0x20000>;
	qcom,board-id = <0x0 0x2000001>;
};

#include "sa8797p-sdp8-vm.dtsi"
#include "sa8797p-sdp8-vm-la-mt.dtsi"

&{/} {
	model = "Qualcomm Technologies, Inc. SA8797p-v2 Multi LA  Guest Virtual Machine";
	compatible = "qcom,sa8797p", "qcom,quinvm";
	qcom,msm-id = <690 0x20000>;
	qcom,board-id = <0x0 0x2000001>;
	qcom,msm-name  = "SA_QX_VM";

	#address-cells = <2>;
	#size-cells = <2>;
};

&chosen {
	bootconfig = "androidboot.dtbo_idx=31 androidboot.fstab_suffix=hqx.nord.qcom";
};
