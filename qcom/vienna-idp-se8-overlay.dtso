// SPDX-License-Identifier: BSD-3-Clause
/*
 * Copyright (c) Qualcomm Technologies, Inc. and/or its subsidiaries.
 */

/dts-v1/;
/plugin/;

#include "vienna-idp-se8.dtsi"
#include "vienna-pmw6100-v1.dtsi"

/ {
	model = "Qualcomm Technologies, Inc. Vienna IDP SE8 PMW6100 V1";
	compatible = "qcom,vienna-idp", "qcom,vienna", "qcom,idp";
	qcom,board-id = <0x10022 0x02>;
	qcom,pmic-id = <0x10064 0x0 0x0 0x0>;
};
