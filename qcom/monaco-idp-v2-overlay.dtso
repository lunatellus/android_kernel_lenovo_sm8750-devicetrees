// SPDX-License-Identifier: BSD-3-Clause
/*
 * Copyright (c) Qualcomm Technologies, Inc. and/or its subsidiaries.
 */

/dts-v1/;
/plugin/;

#include "monaco-idp-v2.dtsi"

/ {
	model = "Qualcomm Technologies, Inc. Monaco IDP V2.0";
	qcom,board-id = <0x020022 0x0>;
};
