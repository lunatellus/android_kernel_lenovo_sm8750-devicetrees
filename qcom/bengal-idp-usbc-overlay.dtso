// SPDX-License-Identifier: BSD-3-Clause
/*
 * Copyright (c) Qualcomm Technologies, Inc. and/or its subsidiaries.
 */

/dts-v1/;
/plugin/;

#include <dt-bindings/interrupt-controller/arm-gic.h>
#include "bengal-idp.dtsi"
#include "bengal-idp-pmi632.dtsi"

/ {
	model = "Qualcomm Technologies, Inc. BENGAL IDP USBC Audio";
	compatible = "qcom,bengal-idp", "qcom,bengal", "qcom,idp";
	qcom,msm-id = <417 0x10000>, <444 0x10000>;
	qcom,board-id = <34 1>;
};
