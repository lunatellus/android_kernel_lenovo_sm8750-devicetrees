// SPDX-License-Identifier: BSD-3-Clause
/*
 * Copyright (c) Qualcomm Technologies, Inc. and/or its subsidiaries.
 */

/dts-v1/;

#include "ravelin-sg.dtsi"

/ {
	model = "Qualcomm Technologies, Inc. Ravelin SG SoC";
	compatible = "qcom,ravelin";
	qcom,board-id = <0 0>;
};

