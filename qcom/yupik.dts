// SPDX-License-Identifier: BSD-3-Clause
/*
 * Copyright (c) Qualcomm Technologies, Inc. and/or its subsidiaries.
 */

/dts-v1/;

#include "yupik.dtsi"

/ {
	model = "Qualcomm Technologies, Inc. Yupik SoC";
	compatible = "qcom,yupik";
	qcom,board-id = <0 0>;
};
