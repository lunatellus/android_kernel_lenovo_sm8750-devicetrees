// SPDX-License-Identifier: BSD-3-Clause
/*
 * Copyright (c) Qualcomm Technologies, Inc. and/or its subsidiaries.
 */

/dts-v1/;
/plugin/;

#include "pikachus-idp.dtsi"

/ {
	model = "Qualcomm Technologies, Inc. PikachuS IDP";
	compatible = "qcom,pikachus-idp", "qcom,pikachus", "qcom,idp";
	qcom,msm-id = <784 0x10000>;
	qcom,board-id = <0x10022 0>;
};

