// SPDX-License-Identifier: BSD-3-Clause
/*
 * Copyright (c) Qualcomm Technologies, Inc. and/or its subsidiaries.
 */

/dts-v1/;

#include "ravelin-4gb.dtsi"

/ {
	model = "Qualcomm Technologies, Inc. Ravelin 4Gb SoC";
	compatible = "qcom,ravelin";
	qcom,board-id = <0 0x600>;
};
