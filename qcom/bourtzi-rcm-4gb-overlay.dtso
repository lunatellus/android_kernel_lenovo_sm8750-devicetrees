// SPDX-License-Identifier: BSD-3-Clause
/*
 * Copyright (c) Qualcomm Technologies, Inc. and/or its subsidiaries.
 */

/dts-v1/;
/plugin/;

#include "bourtzi-rcm-4gb.dtsi"
#include "bourtzi-pm7250b.dtsi"
#include "bourtzi-smb1355.dtsi"

/ {
	model = "Qualcomm Technologies, Inc. Bourtzi RCM + WCN3998 + tioman + 4GB";
	compatible = "qcom,bourtzi-rcm", "qcom,bourtzip-rcm", "qcom,bourtzi", "qcom,bourtzip", "qcom,rcm";
	qcom,msm-id = <776 0x10000>, <777 0x10000>;
	qcom,board-id = <0x10015 0x600>;
};
