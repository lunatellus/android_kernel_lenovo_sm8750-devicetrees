// SPDX-License-Identifier: BSD-3-Clause
/*
 * Copyright (c) Qualcomm Technologies, Inc. and/or its subsidiaries.
 */

#include "bengal.dtsi"
#include "bengal-pmi632.dtsi"

/ {
	model = "Qualcomm Technologies, Inc. BENGALP-IOT";
	compatible = "qcom,bengalp-iot";
	qcom,msm-id = <470 0x0>, <470 0x10000>;
	qcom,msm-name = "BENGALP-IOT";
};
