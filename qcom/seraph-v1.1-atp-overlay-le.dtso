// SPDX-License-Identifier: BSD-3-Clause
/*
 * Copyright (c) Qualcomm Technologies, Inc. and/or its subsidiaries.
 */

/dts-v1/;
/plugin/;

#include "seraph-v1.1-atp.dtsi"
#include "seraph-le-ipa-disable.dtsi"

/ {
	model = "Qualcomm Technologies, Inc. Seraph v1.1 ATP";
	compatible = "qcom,seraph-v1.1-atp", "qcom,seraph", "qcom,atp";
	qcom,msm-id = <672 0x10001>, <792 0x10001>;
	qcom,board-id = <0x10021 0>;
};
