// SPDX-License-Identifier: BSD-3-Clause
/*
 * Copyright (c) Qualcomm Technologies, Inc. and/or its subsidiaries.
 */

/dts-v1/;

#include "waipio.dtsi"

/ {
	model = "Qualcomm Technologies, Inc. Waipio SoC";
	compatible = "qcom,waipio";
	qcom,board-id = <0 0>;
};
