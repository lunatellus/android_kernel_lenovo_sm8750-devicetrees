/* Copyright (c) Qualcomm Technologies, Inc. and/or its subsidiaries
 * SPDX-License-Identifier: BSD-3-Clause
 */
/dts-v1/;
/plugin/;

#include <dt-bindings/mailbox/qcom-ipcc.h>
#include <dt-bindings/mailbox/qcom-ipcc-canoe.h>
#include <dt-bindings/interrupt-controller/arm-gic.h>
#include "chora-synx.dtsi"

/ {
	model = "Qualcomm Technologies, Inc. Chora SoC";
	compatible = "qcom,chora";
	qcom,msm-id = <724 0x10000>, <724 0x20000>, <744 0x10000>, <744 0x20000>;
	qcom,board-id = <0 0>;
};
