// SPDX-License-Identifier: BSD-3-Clause
/*
 * Copyright (c) Qualcomm Technologies, Inc. and/or its subsidiaries.
 */

/dts-v1/;
/plugin/;

#include "shikra-evk-kunlun-nfc-atp.dtsi"

/ {
  model = "Qualcomm Technologies, Inc. Shikra EVK Kunlun NFC ATP";
  compatible = "qcom,shikra-evk", "qcom,shikra", "qcom,shikra-cqm", "qcom,shikra-cqs", "qcom,evk";
  qcom,board-id = <0x10021 0x0>;
};
