// SPDX-License-Identifier: BSD-3-Clause
/*
 * Copyright (c) 2023 Qualcomm Innovation Center, Inc. All rights reserved.
 */

/dts-v1/;

#include "sun.dtsi"
#include "sun-techpacks.dtsi"

#include "mm/hw_fence/sun-hw-fence.dtsi"
#include "data/sun-ipa.dtsi"
#include "fingerprint/sun-fingerprint.dtsi"

/ {
	model = "Qualcomm Technologies, Inc. Sun SoC";
	compatible = "qcom,sun";
	qcom,board-id = <0 0>;
};
