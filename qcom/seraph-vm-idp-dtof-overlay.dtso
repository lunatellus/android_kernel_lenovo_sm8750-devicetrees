// SPDX-License-Identifier: BSD-3-Clause
/*
 * Copyright (c) Qualcomm Technologies, Inc. and/or its subsidiaries.
 */

/dts-v1/;
/plugin/;

#include "seraph-vm-avf.dtsi"
#include "seraph-vm-idp-dtof-avf.dtsi"

/ {
	model = "Qualcomm Technologies, Inc. Seraph SVM IDP DTOF";
	compatible = "qcom,seraph-idp", "qcom,seraph", "qcom,idp";
	qcom,board-id = <0x10022 1>;

	host {
	};
};
