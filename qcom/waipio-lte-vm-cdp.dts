// SPDX-License-Identifier: BSD-3-Clause
/*
 * Copyright (c) Qualcomm Technologies, Inc. and/or its subsidiaries.
 */

/dts-v1/;

#include "waipio-lte-vm.dtsi"
#include "waipio-lte-vm-cdp.dtsi"

/ {
	model = "Qualcomm Technologies, Inc. Waipio LTE SVM CDP";
	compatible = "qcom,waipio-cdp", "qcom,waipio", "qcom,cdp";
	qcom,board-id = <0x10001 0>;
};
