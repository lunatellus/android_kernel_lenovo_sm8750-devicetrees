// SPDX-License-Identifier: BSD-3-Clause
/*
 * Copyright (c) Qualcomm Technologies, Inc. and/or its subsidiaries.
 */
/dts-v1/;
/plugin/;

#include "bourtzi-vm-avf.dtsi"
#include "bourtzi-vm-mtp-avf.dtsi"

/ {
	model = "Qualcomm Technologies, Inc. Bourtzi SVM MTP";
	compatible = "qcom,bourtzi-mtp", "qcom,mtp", "qcom,bourtzi";
	qcom,board-id = <0x8 0x0>;

	host {
	};
};
