// SPDX-License-Identifier: BSD-3-Clause
/*
 * Copyright (c) Qualcomm Technologies, Inc. and/or its subsidiaries.
 */
#include <dt-bindings/clock/qcom,x1p42100-gcc.h>
#include <x1e80100-qupv3.dtsi>
&qupv3_id_2 {
	status = "okay";
};

&qupv3_se21_2uart {
	status = "okay";
};

