// SPDX-License-Identifier: BSD-3-Clause
/*
 * Copyright (c) Qualcomm Technologies, Inc. and/or its subsidiaries.
 */

/dts-v1/;

#include "ravelinp-sg.dtsi"

/ {
	model = "Qualcomm Technologies, Inc. RavelinP SG SoC";
	compatible = "qcom,ravelinp";
	qcom,board-id = <0 0>;
};

