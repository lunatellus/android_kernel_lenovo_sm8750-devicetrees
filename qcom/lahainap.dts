// SPDX-License-Identifier: BSD-3-Clause
/*
 * Copyright (c) Qualcomm Technologies, Inc. and/or its subsidiaries.
 */

/dts-v1/;

#include "lahainap.dtsi"

/ {
	model = "Qualcomm Technologies, Inc. LahianaP SoC";
	compatible = "qcom,lahainap";
	qcom,board-id = <0 0>;
};
