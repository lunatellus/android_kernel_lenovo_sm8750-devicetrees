// SPDX-License-Identifier: BSD-3-Clause
/*
 * Copyright (c) Qualcomm Technologies, Inc. and/or its subsidiaries.
 */

/dts-v1/;
/plugin/;

#include "pikachus-atp.dtsi"

/ {
	model = "Qualcomm Technologies, Inc. PikachuS ATP";
	compatible = "qcom,pikachus-atp", "qcom,pikachus", "qcom,atp";
	qcom,msm-id = <784 0x10000>;
	qcom,board-id = <0x10021 0>;
};

