// SPDX-License-Identifier: BSD-3-Clause
/*
 * Copyright (c) Qualcomm Technologies, Inc. and/or its subsidiaries.
 */

/dts-v1/;

#include "monaco-vm.dtsi"
#include "monaco-vm-la.dtsi"

/ {
	model = "Qualcomm Technologies, Inc. Monaco Single LA Virtual Machine";
	compatible = "qcom,monaco", "qcom,quinvm";
	qcom,board-id = <0 0x1000001>;
	qcom,sdp = <0x2c6>;
};
