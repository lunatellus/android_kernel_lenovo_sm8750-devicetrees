// SPDX-License-Identifier: BSD-3-Clause
/*
 * Copyright (c) Qualcomm Technologies, Inc. and/or its subsidiaries.
 */

/dts-v1/;
/plugin/;

#include "seraph-v1.1-idp-dtof.dtsi"
#include "seraph-le-ipa-disable.dtsi"

/ {
	model = "Qualcomm Technologies, Inc. Seraph IDP DTOF";
	compatible = "qcom,seraph-idp", "qcom,seraph", "qcom,idp";
	qcom,msm-id = <672 0x10001>, <792 0x10001>;
	qcom,board-id = <0x10022 1>;
};
