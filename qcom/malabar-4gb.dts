// SPDX-License-Identifier: BSD-3-Clause
/*
 * Copyright (c) Qualcomm Technologies, Inc. and/or its subsidiaries.
 */

/dts-v1/;

#include "malabar-4gb.dtsi"

/ {
	model = "Qualcomm Technologies, Inc. Malabar SoC 4GB DDR";
	compatible = "qcom,malabar";
	qcom,board-id = <0 0x600>;
};
