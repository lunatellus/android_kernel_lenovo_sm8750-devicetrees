// SPDX-License-Identifier: BSD-3-Clause
/*
 * Copyright (c) Qualcomm Technologies, Inc. and/or its subsidiaries.
 */

&non_devices_common {
	required-subnodes-display = <
		&clock_cpucc
		&config
		&config_64
		&config_66
		&config_68
		&config_70
		&config_72
		&config_74
		&config_76
		&config_78
		&config_80
		&config_82
		&config_84
		&display_panel_avdd_default
		&display_panel_vdd_default
		&display_panel_vddio_default
		&dsi_ft8726_fhd_plus_120_video
		&dsi_ft8726_fhd_plus_60_video
		&dsi_ft8726_fhd_plus_90_video
		&dsi_panel_pwr_supply_amoled
		&dsi_panel_pwr_supply_lcd_labibb
		&dsi_panel_pwr_supply_lcd
		&dsi_panel_pwr_supply_sim
		&dsi_pll_codes_data
		&dsi_vtdr6130_amoled_120hz_cmd
		&dsi_vtdr6130_amoled_120hz_video
		&dsi_vtdr6130_amoled_60hz_cmd
		&dsi_vtdr6130_amoled_60hz_video
		&dsi_vtdr6130_amoled_90hz_cmd
		&dsi_vtdr6130_amoled_90hz_video
		&dsi_vtdr6130_amoled_cmd
		&dsi_vtdr6130_amoled_qsync_144hz_cmd
		&dsi_vtdr6130_amoled_qsync_144hz_video
		&dsi_vtdr6130_amoled_video
		&goodix_berlin_0
		&mdss_dsi0
		&mdss_dsi_phy0
		&mdss_mdp
		&mux
		&mux_63
		&mux_65
		&mux_67
		&mux_69
		&mux_71
		&mux_73
		&mux_75
		&mux_77
		&mux_79
		&mux_81
		&mux_83
		&pmx_sde
		&pmx_sde_te
		&pmx_ts_active
		&pmx_ts_int_suspend
		&pmx_ts_release
		&pmx_ts_reset_suspend
		&qcom_ctrl_supply_entries
		&qcom_ctrl_supply_entry_0
		&qcom_mdss_dsi_display_timings
		&qcom_mdss_dsi_display_timings_11
		&qcom_mdss_dsi_display_timings_13
		&qcom_mdss_dsi_display_timings_17
		&qcom_mdss_dsi_display_timings_19
		&qcom_mdss_dsi_display_timings_21
		&qcom_mdss_dsi_display_timings_23
		&qcom_mdss_dsi_display_timings_25
		&qcom_mdss_dsi_display_timings_27
		&qcom_mdss_dsi_display_timings_273
		&qcom_mdss_dsi_display_timings_277
		&qcom_mdss_dsi_display_timings_281
		&qcom_mdss_dsi_display_timings_286
		&qcom_mdss_dsi_display_timings_288
		&qcom_mdss_dsi_display_timings_29
		&qcom_mdss_dsi_display_timings_290
		&qcom_mdss_dsi_display_timings_32
		&qcom_mdss_dsi_display_timings_33
		&qcom_mdss_dsi_display_timings_34
		&qcom_mdss_dsi_display_timings_36
		&qcom_mdss_dsi_display_timings_37
		&qcom_mdss_dsi_display_timings_38
		&qcom_mdss_dsi_display_timings_40
		&qcom_mdss_dsi_display_timings_41
		&qcom_mdss_dsi_display_timings_42
		&qcom_mdss_dsi_display_timings_43
		&qcom_mdss_dsi_display_timings_44
		&qcom_mdss_dsi_display_timings_45
		&qcom_mdss_dsi_display_timings_46
		&qcom_mdss_dsi_display_timings_48
		&qcom_mdss_dsi_display_timings_50
		&qcom_mdss_dsi_display_timings_52
		&qcom_mdss_dsi_display_timings_54
		&qcom_mdss_dsi_display_timings_57
		&qcom_mdss_dsi_display_timings_59
		&qcom_mdss_dsi_display_timings_61
		&qcom_mdss_dsi_display_timings_7
		&qcom_mdss_dsi_display_timings_9
		&qcom_panel_supply_entry_0
		&qcom_panel_supply_entry_0_1
		&qcom_panel_supply_entry_0_2
		&qcom_panel_supply_entry_0_4
		&qcom_panel_supply_entry_1
		&qcom_panel_supply_entry_1_3
		&qcom_panel_supply_entry_1_5
		&qcom_panel_supply_entry_2
		&qcom_panel_supply_entry_2_6
		&qcom_panel_supply_entry_3
		&qcom_phy_supply_entries
		&qcom_phy_supply_entry_0
		&qcom_sde_dspp_blocks
		&qcom_sde_sspp_vig_blocks
		&sde_dsi
		&sde_dsi_active
		&sde_dsi_suspend
		&sde_te_active
		&sde_te_suspend
		&smmu_sde_iommu_region_partition
		&smmu_sde_unsec
		&timing_0
		&timing_0_10
		&timing_0_12
		&timing_0_14
		&timing_0_18
		&timing_0_20
		&timing_0_22
		&timing_0_24
		&timing_0_26
		&timing_0_274
		&timing_0_278
		&timing_0_28
		&timing_0_282
		&timing_0_287
		&timing_0_289
		&timing_0_291
		&timing_0_30
		&timing_0_33
		&timing_0_34
		&timing_0_35
		&timing_0_37
		&timing_0_38
		&timing_0_39
		&timing_0_41
		&timing_0_42
		&timing_0_43
		&timing_0_44
		&timing_0_45
		&timing_0_46
		&timing_0_47
		&timing_0_49
		&timing_0_51
		&timing_0_53
		&timing_0_58
		&timing_0_8
		&timing_1
		&timing_1_15
		&timing_1_275
		&timing_1_283
		&timing_1_31
		&timing_1_35
		&timing_1_39
		&timing_1_40
		&timing_1_60
		&timing_1_62
		&timing_2
		&timing_2_16
		&timing_2_276
		&timing_2_284
		&timing_2_32
		&timing_2_36
		&timing_2_55
		&timing_3
		&timing_3_285
		&timing_3_56
		&timing_4
		&timing_5
		&timing_7
		&touch_panel_avdd_default
		&ts_active
		&ts_int_suspend
		&ts_release
		&ts_reset_suspend
		&vcm_0
	>;
};
