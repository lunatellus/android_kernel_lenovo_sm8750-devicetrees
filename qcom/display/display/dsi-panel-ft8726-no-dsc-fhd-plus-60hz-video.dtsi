// SPDX-License-Identifier: BSD-3-Clause
/*
 * Copyright (c) Qualcomm Technologies, Inc. and/or its subsidiaries.
 */

&mdss_mdp {
	dsi_ft8726_fhd_plus_no_dsc_60_video: qcom,mdss_dsi_ft8726_fhd_plus_no_dsc_60_video {
		qcom,mdss-dsi-panel-name =
			"ft8726 lcd video mode dsi focaltech panel with NON-DSC";
		qcom,mdss-dsi-panel-type = "dsi_video_mode";
		qcom,dsi-ctrl-num = <0>;
		qcom,dsi-phy-num = <0>;
		qcom,mdss-dsi-virtual-channel-id = <0>;
		qcom,mdss-dsi-stream = <0>;
		qcom,mdss-dsi-bpp = <24>;
		qcom,mdss-dsi-border-color = <0>;
		qcom,mdss-dsi-traffic-mode = "burst_mode";
		qcom,mdss-dsi-bllp-power-mode;
		qcom,mdss-dsi-bllp-eof-power-mode;
		qcom,mdss-dsi-lane-0-state;
		qcom,mdss-dsi-lane-1-state;
		qcom,mdss-dsi-lane-2-state;
		qcom,mdss-dsi-lane-3-state;
		qcom,mdss-dsi-dma-trigger = "trigger_sw";
		qcom,mdss-dsi-mdp-trigger = "none";
		qcom,mdss-dsi-reset-sequence = <1 10>, <0 10>, <1 10>;
		qcom,mdss-dsi-tx-eot-append;
		qcom,adjust-timer-wakeup-ms = <1>;

		qcom,mdss-dsi-panel-hdr-color-primaries = <14500 15500 32000
				17000 15500 30000 8000 3000>;
		qcom,mdss-dsi-panel-peak-brightness = <4200000>;
		qcom,mdss-dsi-panel-blackness-level = <3230>;

		qcom,mdss-dsi-display-timings {
			timing@0 {
				qcom,mdss-dsi-panel-width = <1080>;
				qcom,mdss-dsi-panel-height = <2408>;
				qcom,mdss-dsi-h-front-porch = <40>;
				qcom,mdss-dsi-h-back-porch = <36>;
				qcom,mdss-dsi-h-pulse-width = <12>;
				qcom,mdss-dsi-h-sync-skew = <0>;
				qcom,mdss-dsi-v-back-porch = <18>;
				qcom,mdss-dsi-v-front-porch = <46>;
				qcom,mdss-dsi-v-pulse-width = <2>;
				qcom,mdss-dsi-panel-framerate = <60>;
				qcom,mdss-dsi-on-command = [
					15 01 00 00 00 00 02 00 00
					39 01 00 00 00 00 04 FF 87 20 01
					15 01 00 00 00 00 02 00 80
					39 01 00 00 00 00 03 FF 87 20
					15 01 00 00 00 00 02 00 00
					39 01 00 00 00 00 05 2A 00 00 04 37
					15 01 00 00 00 00 02 00 00
					39 01 00 00 00 00 05 2B 00 00 09 67
					15 01 00 00 00 00 02 00 A3
					39 01 00 00 00 00 05 B3 09 68 00 18
					15 01 00 00 00 00 02 00 60
					39 01 00 00 00 00 07 C0 00 B4 00 31 00 11
					15 01 00 00 00 00 02 00 70
					39 01 00 00 00 00 08 C0 00 C8 00 C8 0D 03 14
					15 01 00 00 00 00 02 00 79
					39 01 00 00 00 00 04 C0 15 01 11
					15 01 00 00 00 00 02 00 80
					39 01 00 00 00 00 07 C0 00 48 00 31 00 11
					15 01 00 00 00 00 02 00 90
					39 01 00 00 00 00 07 C0 00 48 00 31 00 11
					15 01 00 00 00 00 02 00 A0
					39 01 00 00 00 00 07 C0 00 5A 00 31 00 11
					15 01 00 00 00 00 02 00 B0
					39 01 00 00 00 00 06 C0 00 93 00 31 11
					15 01 00 00 00 00 02 00 A3
					39 01 00 00 00 00 07 C1 00 5E 00 28 00 02
					15 01 00 00 00 00 02 00 80
					39 01 00 00 00 00 09 CE 01 81 FF FF 01 90 01 90
					15 01 00 00 00 00 02 00 8C
					39 01 00 00 00 00 05 CE 01 90 01 90
					15 01 00 00 00 00 02 00 90
					39 01 00 00 00 00 0F CE 00 BD 12 75 00 BD 80 FF FF 00 04 00 0D 0D
					15 01 00 00 00 00 02 00 A0
					39 01 00 00 00 00 04 CE 00 00 00
					15 01 00 00 00 00 02 00 B0
					39 01 00 00 00 00 04 CE 22 00 00
					15 01 00 00 00 00 02 00 E1
					39 01 00 00 00 00 06 CE 04 03 14 03 14
					15 01 00 00 00 00 02 00 F1
					39 01 00 00 00 00 03 CE 32 2A
					15 01 00 00 00 00 02 00 F4
					39 01 00 00 00 00 05 CE 01 30 01 0D
					15 01 00 00 00 00 02 00 B0
					39 01 00 00 00 00 05 CF 01 01 64 68
					15 01 00 00 00 00 02 00 B5
					39 01 00 00 00 00 05 CF 05 05 64 68
					15 01 00 00 00 00 02 00 C0
					39 01 00 00 00 00 05 CF 09 09 63 67
					15 01 00 00 00 00 02 00 C5
					39 01 00 00 00 00 05 CF 09 09 69 6D
					15 01 00 00 00 00 02 00 D1
					39 01 00 00 00 00 0D C1 0C E3 12 20 1F 15 0A E2 0F 1E 19 D4
					15 01 00 00 00 00 02 00 E1
					39 01 00 00 00 00 03 C1 12 20
					15 01 00 00 00 00 02 00 E4
					39 01 00 00 00 00 0D CF 09 AD 09 AC 09 AC 09 AC 09 AC 09 AC
					15 01 00 00 00 00 02 00 80
					39 01 00 00 00 00 03 C1 44 44
					15 01 00 00 00 00 02 00 90
					15 01 00 00 00 00 02 C1 03
					15 01 00 00 00 00 02 00 CC
					15 01 00 00 00 00 02 C1 18
					15 01 00 00 00 00 02 00 E0
					15 01 00 00 00 00 02 C1 00
					15 01 00 00 00 00 02 00 80
					15 01 00 00 00 00 02 00 F6
					15 01 00 00 00 00 02 CF 90
					15 01 00 00 00 00 02 00 80
					39 01 00 00 00 00 09 C2 82 01 1F 1F 00 00 00 00
					15 01 00 00 00 00 02 00 90
					39 01 00 00 00 00 05 C2 00 00 00 00
					15 01 00 00 00 00 02 00 A0
					39 01 00 00 00 00 10 C2 00 00 00 21 89 01 00 00 21 89 02 00 00 21 89
					15 01 00 00 00 00 02 00 B0
					39 01 00 00 00 00 0B C2 03 00 00 21 89 80 08 03 02 02
					15 01 00 00 00 00 02 00 CA
					39 01 00 00 00 00 06 C2 84 08 03 01 81
					15 01 00 00 00 00 02 00 E0
					39 01 00 00 00 00 06 C2 33 33 70 00 70
					15 01 00 00 00 00 02 00 E8
					39 01 00 00 00 00 09 C2 00 00 00 00 00 00 00 00
					15 01 00 00 00 00 02 00 D0
					39 01 00 00 00 00 11 C3 00 00 00 00 00 00 00 00 00 00 00 00 00 00 00 00
					15 01 00 00 00 00 02 00 80
					39 01 00 00 00 00 11 CB 00 01 00 03 FD 01 01 00 00 00 FD 01 00 03 00 00
					15 01 00 00 00 00 02 00 90
					39 01 00 00 00 00 11 CB 00 00 00 0F F0 00 00 00 00 00 FF 00 00 00 00 00
					15 01 00 00 00 00 02 00 A0
					39 01 00 00 00 00 05 CB 00 00 00 00
					15 01 00 00 00 00 02 00 A4
					39 01 00 00 00 00 05 CB 03 00 0C 00
					15 01 00 00 00 00 02 00 B0
					39 01 00 00 00 00 05 CB 13 58 05 30
					15 01 00 00 00 00 02 00 C0
					39 01 00 00 00 00 05 CB 13 58 05 30
					15 01 00 00 00 00 02 00 D5
					39 01 00 00 00 00 0C CB 00 00 00 00 00 00 00 00 00 00 00
					15 01 00 00 00 00 02 00 E0
					39 01 00 00 00 00 0E CB 00 00 00 00 00 00 00 00 00 00 00 00 00
					15 01 00 00 00 00 02 00 80
					39 01 00 00 00 00 11 CC 23 12 23 1C 23 0A 23 23 09 08 07 06 23 23 23 23
					15 01 00 00 00 00 02 00 90
					39 01 00 00 00 00 09 CC 23 18 16 17 23 19 1A 1B
					15 01 00 00 00 00 02 00 A0
					39 01 00 00 00 00 11 CC 23 12 23 1D 23 0E 23 23 06 07 08 09 23 23 23 23
					15 01 00 00 00 00 02 00 B0
					39 01 00 00 00 00 09 CC 23 18 16 17 23 19 1A 1B
					15 01 00 00 00 00 02 00 80
					39 01 00 00 00 00 11 CD 23 23 23 02 23 0A 23 23 09 08 07 06 23 23 23 23
					15 01 00 00 00 00 02 00 90
					39 01 00 00 00 00 09 CD 23 18 16 17 23 19 1A 1B
					15 01 00 00 00 00 02 00 A0
					39 01 00 00 00 00 11 CD 23 23 23 02 23 0E 23 23 06 07 08 09 23 23 23 23
					15 01 00 00 00 00 02 00 B0
					39 01 00 00 00 00 09 CD 23 18 16 17 23 19 1A 1B
					15 01 00 00 00 00 02 00 86
					39 01 00 00 00 00 07 C0 00 00 00 01 10 05
					15 01 00 00 00 00 02 00 96
					39 01 00 00 00 00 07 C0 00 00 00 01 10 05
					15 01 00 00 00 00 02 00 A3
					39 01 00 00 00 00 07 CE 00 00 00 01 10 05
					15 01 00 00 00 00 02 00 B3
					39 01 00 00 00 00 07 CE 00 00 00 01 10 05
					15 01 00 00 00 00 02 00 69
					39 01 00 00 00 00 04 C0 01 14 01
					15 01 00 00 00 00 02 00 82
					39 01 00 00 00 00 03 A7 10 00
					15 01 00 00 00 00 02 00 8D
					15 01 00 00 00 00 02 A7 01
					15 01 00 00 00 00 02 00 8F
					15 01 00 00 00 00 02 A7 01
					15 01 00 00 00 00 02 00 93
					15 01 00 00 00 00 02 C5 37
					15 01 00 00 00 00 02 00 97
					15 01 00 00 00 00 02 C5 37
					15 01 00 00 00 00 02 00 9A
					15 01 00 00 00 00 02 C5 32
					15 01 00 00 00 00 02 00 9C
					15 01 00 00 00 00 02 C5 32
					15 01 00 00 00 00 02 00 B6
					39 01 00 00 00 00 09 C5 10 10 0E 0E 10 10 0E 0E
					15 01 00 00 00 00 02 00 88
					15 01 00 00 00 00 02 C4 08
					15 01 00 00 00 00 02 00 80
					15 01 00 00 00 00 02 A7 03
					15 01 00 00 00 00 02 00 B0
					15 01 00 00 00 00 02 C5 D1
					15 01 00 00 00 00 02 00 B3
					15 01 00 00 00 00 02 C5 D1
					15 01 00 00 00 00 02 00 99
					15 01 00 00 00 00 02 CF 50
					15 01 00 00 00 00 02 00 8C
					15 01 00 00 00 00 02 C3 00
					15 01 00 00 00 00 02 00 A0
					39 01 00 00 00 00 03 C3 35 21
					15 01 00 00 00 00 02 00 A4
					39 01 00 00 00 00 03 C3 01 20
					15 01 00 00 00 00 02 00 AA
					15 01 00 00 00 00 02 C3 21
					15 01 00 00 00 00 02 00 AD
					15 01 00 00 00 00 02 C3 01
					15 01 00 00 00 00 02 00 AE
					15 01 00 00 00 00 02 C3 20
					15 01 00 00 00 00 02 00 B3
					15 01 00 00 00 00 02 C3 21
					15 01 00 00 00 00 02 00 B6
					39 01 00 00 00 00 03 C3 01 20
					15 01 00 00 00 00 02 00 C3
					15 01 00 00 00 00 02 C5 FF
					15 01 00 00 00 00 02 00 A9
					15 01 00 00 00 00 02 F5 8E
					15 01 00 00 00 00 02 00 B0
					15 01 00 00 00 00 02 B3 00
					15 01 00 00 00 00 02 00 83
					15 01 00 00 00 00 02 B0 63
					15 01 00 00 00 00 02 00 93
					15 01 00 00 00 00 02 C4 08
					15 01 00 00 00 00 02 00 80
					15 01 00 00 00 00 02 B3 22
					15 01 00 00 00 00 02 00 90
					15 01 00 00 00 00 02 C3 08
					15 01 00 00 00 00 02 00 FA
					15 01 00 00 00 00 02 C2 14
					15 01 00 00 00 00 02 00 CA
					15 01 00 00 00 00 02 C0 80
					15 01 00 00 00 00 02 00 82
					15 01 00 00 00 00 02 F5 01
					15 01 00 00 00 00 02 00 93
					15 01 00 00 00 00 02 F5 01
					15 01 00 00 00 00 02 00 9B
					15 01 00 00 00 00 02 F5 49
					15 01 00 00 00 00 02 00 9D
					15 01 00 00 00 00 02 F5 49
					15 01 00 00 00 00 02 00 BE
					39 01 00 00 00 00 03 C5 F0 F0
					15 01 00 00 00 00 02 00 85
					15 01 00 00 00 00 02 A7 01
					15 01 00 00 00 00 02 00 DC
					15 01 00 00 00 00 02 C3 37
					15 01 00 00 00 00 02 00 8A
					15 01 00 00 00 00 02 F5 C7
					15 01 00 00 00 00 02 00 99
					15 01 00 00 00 00 02 CF 50
					15 01 00 00 00 00 02 00 9C
					15 01 00 00 00 00 02 F5 00
					15 01 00 00 00 00 02 00 9E
					15 01 00 00 00 00 02 F5 00
					15 01 00 00 00 00 02 00 B0
					39 01 00 00 00 00 07 C5 D0 4A 39 D0 4A 0F
					15 01 00 00 00 00 02 00 C2
					15 01 00 00 00 00 02 F5 42
					15 01 00 00 00 00 02 00 E8
					15 01 00 00 00 00 02 C0 40
					15 01 00 00 00 00 02 00 D4
					15 01 00 00 00 00 02 CB 03
					15 01 00 00 00 00 02 00 B0
					39 01 00 00 00 00 04 CA 6B 6B 09
					15 01 00 00 00 00 02 00 80
					15 01 00 00 00 00 02 A4 CA
					15 01 00 00 00 00 02 00 87
					15 01 00 00 00 00 02 C5 0C
					15 01 00 00 00 00 02 00 89
					39 01 00 00 00 00 04 C5 0C 0C 0C
					15 01 00 00 00 00 02 00 8C
					39 01 00 00 00 00 04 C5 0C 0C 0C
					15 01 00 00 00 00 02 00 00
					15 01 00 00 00 00 02 1C 02
					39 01 00 00 00 00 04 FF FF FF FF
					15 01 00 00 00 00 02 51 F0
					15 01 00 00 00 00 02 53 2C
					15 01 00 00 00 00 02 55 00
					15 01 00 00 00 00 02 1C 02
					05 01 00 00 C8 00 01 11
					05 01 00 00 96 00 01 29
				];
				qcom,mdss-dsi-on-command-state = "dsi_lp_mode";
				qcom,mdss-dsi-off-command = [
					05 01 00 00 10 00 01 28
					05 01 00 00 32 00 01 10
				];
				qcom,mdss-dsi-off-command-state = "dsi_lp_mode";
			};
		};
	};
};
