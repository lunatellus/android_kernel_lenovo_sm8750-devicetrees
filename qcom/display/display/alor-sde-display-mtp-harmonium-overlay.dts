// SPDX-License-Identifier: BSD-3-Clause
/*
 * Copyright (c) Qualcomm Technologies, Inc. and/or its subsidiaries.
 */


/dts-v1/;
/plugin/;

#include "alor-sde-display-mtp-harmonium.dtsi"

/ {
	model = "Qualcomm Technologies, Inc. Alor MTP";
	compatible = "qcom,alor-mtp", "qcom,alor", "qcom,mtp";
	qcom,msm-id = <764 0x10000>;
	qcom,board-id = <0x50008 0>;
};
