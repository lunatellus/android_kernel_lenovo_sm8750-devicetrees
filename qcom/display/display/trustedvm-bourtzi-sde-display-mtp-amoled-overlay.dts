// SPDX-License-Identifier: BSD-3-Clause
/*
 * Copyright (c) Qualcomm Technologies, Inc. and/or its subsidiaries.
 */

/dts-v1/;
/plugin/;

#include "trustedvm-bourtzi-sde.dtsi"
#include "trustedvm-bourtzi-sde-display-mtp-amoled.dtsi"

/ {
	model = "Qualcomm Technologies, Inc. Bourtzi SVM";
	compatible = "qcom,bourtzi-mtp", "qcom,bourtzip-mtp", "qcom,bourtzi", "qcom,bourtzip", "qcom,mtp";
	qcom,msm-id = <776 0x10000>, <777 0x10000>;
	qcom,board-id = <0x8 0x0>;
};
