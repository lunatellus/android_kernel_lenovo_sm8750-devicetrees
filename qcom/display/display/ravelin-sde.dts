// SPDX-License-Identifier: BSD-3-Clause
/*
 * Copyright (c) Qualcomm Technologies, Inc. and/or its subsidiaries.
 */

/dts-v1/;
/plugin/;

#include "ravelin-sde.dtsi"

/ {
	qcom,msm-id = <568 0x10000>, <602 0x10000>,
			<581 0x10000>, <582 0x10000>,
			<653 0x10000>, <654 0x10000>;
	qcom,board-id = <0 0>, <0 0x600>;
};
