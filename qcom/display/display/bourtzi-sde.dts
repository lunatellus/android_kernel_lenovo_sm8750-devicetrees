// SPDX-License-Identifier: BSD-3-Clause
/*
 * Copyright (c) Qualcomm Technologies, Inc. and/or its subsidiaries.
 */

/dts-v1/;
/plugin/;

#include "bourtzi-sde.dtsi"

/ {
	model = "Qualcomm Technologies, Inc. Bourtzi";
	compatible = "qcom,bourtzi";
	qcom,msm-id = <776 0x10000>, <777 0x10000>;
	qcom,board-id = <0 0>, <0 0x600>;
};
