// SPDX-License-Identifier: BSD-3-Clause
/*
 * Copyright (c) Qualcomm Technologies, Inc. and/or its subsidiaries.
 */

/dts-v1/;
/plugin/;

#include "bourtzi-sde-display-mtp-amoled.dtsi"

/ {
	model = "Qualcomm Technologies, Inc. Bourtzi RCM + WCN3998 + tioman + Amoled";
	compatible = "qcom,bourtzi-rcm", "qcom,bourtzip-rcm", "qcom,bourtzi", "qcom,bourtzip", "qcom,rcm";
	qcom,msm-id = <776 0x10000>, <777 0x10000>;
	qcom,board-id = <0x10015 0x600>, <0x10015 0x0>, <0x20015 0x0>;
};
