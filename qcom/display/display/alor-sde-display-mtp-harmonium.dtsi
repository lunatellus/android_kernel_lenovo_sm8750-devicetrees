// SPDX-License-Identifier: BSD-3-Clause
/*
 * Copyright (c) Qualcomm Technologies, Inc. and/or its subsidiaries.
 */

#include "alor-sde-display-mtp.dtsi"

&sde_dp {
	status = "ok";
	usb-phy = <&usb_qmp_dp_phy>;
	qcom,altmode-dev = <&altmode 0>;
	qcom,dp-aux-switch = <&wcd_usbss>;
};

&mdss_mdp {
	status = "ok";
	connectors = <&sde_dsi &sde_dsi1 &smmu_sde_unsec &smmu_sde_sec
			&sde_wb0 &sde_wb1 &sde_dp &sde_cesta>;
};
