// SPDX-License-Identifier: BSD-3-Clause
/*
 * Copyright (c) Qualcomm Technologies, Inc. and/or its subsidiaries.
 */

/dts-v1/;
/plugin/;

#include "seraph-v1.1.dtsi"
#include "seraph-v1.1-idp.dtsi"

/ {
	model = "Qualcomm Technologies, Inc. Seraph v1.1 IDP";
	compatible = "qcom,seraph-v1.1-idp", "qcom,seraph", "qcom,idp";
	qcom,board-id = <0x10022 1>;
};
