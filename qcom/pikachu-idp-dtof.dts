// SPDX-License-Identifier: BSD-3-Clause
/*
 * Copyright (c) Qualcomm Technologies, Inc. and/or its subsidiaries.
 */

/dts-v1/;
/plugin/;

#include "pikachu.dtsi"
#include "pikachu-idp-dtof.dtsi"

/ {
	model = "Qualcomm Technologies, Inc. Pikachu IDP DTOF";
	compatible = "qcom,pikachu-idp", "qcom,pikachu", "qcom,idp";
	qcom,board-id = <0x10022 1>;
};

