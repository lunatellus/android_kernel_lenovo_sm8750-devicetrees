// SPDX-License-Identifier: BSD-3-Clause
/*
 * Copyright (c) Qualcomm Technologies, Inc. and/or its subsidiaries.
 */

/dts-v1/;

#include "lemans-vm.dtsi"
#include "lemans-vm-la.dtsi"

/ {
	model = "Qualcomm Technologies, Inc. Lemans Single LA Guest Virtual Machine";
	compatible = "qcom,lemans", "qcom,quinvm";
	qcom,board-id = <0x0 0x1000001>;
	qcom,sdp = <0x2c6>;
};
