// SPDX-License-Identifier: BSD-3-Clause
/*
 * Copyright (c) Qualcomm Technologies, Inc. and/or its subsidiaries.
 */

/dts-v1/;
/plugin/;

#include "yupik-rumi.dtsi"

/ {
	model = "Qualcomm Technologies, Inc. Yupik RUMI";
	compatible = "qcom,yupik-rumi", "qcom,yupik", "qcom,rumi";
	qcom,msm-id = <475 0x10000>, <515 0x10000>;
	qcom,board-id = <0x1000f 0>;
};
