// SPDX-License-Identifier: BSD-3-Clause
/*
 * Copyright (c) Qualcomm Technologies, Inc. and/or its subsidiaries.
 */

/dts-v1/;
/plugin/;

#include "chora-atp.dtsi"

/ {
	model = "Qualcomm Technologies, Inc. Chora ATP evros";
	compatible = "qcom,chora-atp", "qcom,chora", "qcom,chorap-atp", "qcom,chorap",  "qcom,atp";
	qcom,msm-id = <724 0x10000>, <744 0x10000>;
	qcom,board-id = <0x10021 0x0>;
};

&pm7550ba_eusb2_repeater {
	status = "ok";
	vdd18-supply = <&L7B_E0>;
	vdd3-supply = <&L17B_E0>;
};

&eusb2_phy0 {
	dummy-supply = <&pm7550ba_eusb2_repeater>;
	usb-repeater = <&pm7550ba_eusb2_repeater>;
};
