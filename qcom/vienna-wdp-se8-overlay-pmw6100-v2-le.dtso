// SPDX-License-Identifier: BSD-3-Clause
/*
 * Copyright (c) Qualcomm Technologies, Inc. and/or its subsidiaries.
 */

/dts-v1/;
/plugin/;

#include "vienna-wdp-se8.dtsi"
#include "vienna-pmw6100-v2.dtsi"
#include "vienna-le.dtsi"

/ {
    model = "Qualcomm Technologies, Inc. Vienna WDP SE8 PMW6100 V2 for LE";
    compatible = "qcom,vienna-wdp", "qcom,vienna", "qcom,wdp";
    qcom,board-id = <0x10024 0x02>;
    qcom,pmic-id = <0x20064 0x0 0x0 0x0>;
};

