// SPDX-License-Identifier: BSD-3-Clause
/*
 * Copyright (c) Qualcomm Technologies, Inc. and/or its subsidiaries.
 */

/dts-v1/;
/plugin/;

#include <dt-bindings/interrupt-controller/arm-gic.h>
#include <dt-bindings/soc/qcom,ipcc.h>
#include <dt-bindings/interconnect/qcom,malabar.h>
#include <dt-bindings/clock/qcom,malabar-gcc.h>
#include <dt-bindings/clock/qcom,rpmcc.h>
#include "malabar-ipa.dtsi"

/ {
        model = "Qualcomm Technologies, Inc. Malabar SoC";
        compatible = "qcom,malabar", "qcom,malabar-mtp", "qcom,mtp";
        qcom,msm-id = <733 0x10000>;
        qcom,board-id = <0 0>, <0 0x600>,  <0x10008 0x600>;
};
