// SPDX-License-Identifier: BSD-3-Clause
/*
 * Copyright (c) Qualcomm Technologies, Inc. and/or its subsidiaries.
 */

/dts-v1/;
/plugin/;

#include <dt-bindings/interrupt-controller/arm-gic.h>
#include <dt-bindings/soc/qcom,ipcc.h>
#include <dt-bindings/interconnect/qcom,diwali.h>
#include <dt-bindings/clock/qcom,gcc-diwali.h>
#include <dt-bindings/clock/qcom,rpmh.h>
#include "diwali-ipa.dtsi"

/ {
	model = "Qualcomm Technologies, Inc. Diwali";
	compatible = "qcom,diwali";
	qcom,msm-id = <506 0x10000>;
	qcom,board-id = <0 0>;
};
