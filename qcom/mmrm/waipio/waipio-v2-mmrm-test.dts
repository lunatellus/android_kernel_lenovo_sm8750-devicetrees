// SPDX-License-Identifier: BSD-3-Clause
/*
 * Copyright (c) 2024 Qualcomm Innovation Center, Inc. All rights reserved.
 */

/dts-v1/;
/plugin/;

#include <dt-bindings/clock/qcom,sm8450-camcc.h>
#include <dt-bindings/clock/qcom,sm8450-videocc.h>
#include <dt-bindings/clock/qcom,sm8450-dispcc.h>
#include "waipio-v2-mmrm-test.dtsi"

/ {
	model = "Qualcomm Technologies, Inc. waipio v1 & v2 SoC";
	compatible = "qcom,waipio";
	qcom,msm-id = <457 0x20000>, <482 0x20000>;
	qcom,board-id = <0 0>; /* required by merge_dtbs.py */
};
