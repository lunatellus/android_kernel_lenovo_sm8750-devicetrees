// SPDX-License-Identifier: BSD-3-Clause
/*
 * Copyright (c) Qualcomm Technologies, Inc. and/or its subsidiaries.
 */

/dts-v1/;
/plugin/;

/ {
	model = "Qualcomm Technologies, Inc. SECA QAM Gunyah VM";
	compatible = "qcom,sa8787p", "qcom,qam";
	qcom,msm-id = <742 0x10000>, <742 0x10001>;
	qcom,board-id = <0x00010019 0x0>, <0x00010019 0x1>, <0x00010025 0>, <0x00010025 1>;
};

