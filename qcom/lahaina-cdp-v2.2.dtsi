// SPDX-License-Identifier: BSD-3-Clause
/*
 * Copyright (c) Qualcomm Technologies, Inc. and/or its subsidiaries.
 */

#include "lahaina-cdp.dtsi"

&qupv3_se4_i2c {
	 st_fts@49 {
		st,x-flip = <1>;
		st,y-flip = <1>;
	 };
};
