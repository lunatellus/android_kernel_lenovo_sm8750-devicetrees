// SPDX-License-Identifier: BSD-3-Clause
/*
 * Copyright (c) Qualcomm Technologies, Inc. and/or its subsidiaries.
 */

&soc {
	walt {
		#address-cells = <1>;
		#size-cells = <1>;
		ranges;

		qcom,cycle-cntr {
			compatible = "qcom,cycle-cntr-hw";
			reg = <0xf521000 0x1400>;
			reg-names = "freq-domain0";
		};
	};
};
