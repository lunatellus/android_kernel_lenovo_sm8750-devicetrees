// SPDX-License-Identifier: BSD-3-Clause
/*
 * Copyright (c) Qualcomm Technologies, Inc. and/or its subsidiaries.
 */

/dts-v1/;
/plugin/;

#include "seraphp-v1.1.dtsi"
#include "seraphp-v1.1-qar.dtsi"

/ {
	model = "Qualcomm Technologies, Inc. SeraphP v1.1 QAR";
	compatible = "qcom,seraphp-qar", "qcom,seraphp", "qcom,qar";
	qcom,board-id = <0x1002C 0>;
};
