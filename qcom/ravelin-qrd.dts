// SPDX-License-Identifier: BSD-3-Clause
/*
 * Copyright (c) Qualcomm Technologies, Inc. and/or its subsidiaries.
 */

/dts-v1/;

#include "ravelin.dtsi"
#include "ravelin-qrd.dtsi"

/ {
	model = "Qualcomm Technologies, Inc. Ravelin QRD";
	compatible = "qcom,ravelin-qrd", "qcom,ravelin", "qcom,qrd";
	qcom,board-id = <0x1000B 0>;
};

