// SPDX-License-Identifier: BSD-3-Clause
/*
 * Copyright (c) Qualcomm Technologies, Inc. and/or its subsidiaries.
 */

/dts-v1/;
/plugin/;

#include "vienna-atp-no-cam.dtsi"
#include "vienna-pmw6100-v1.dtsi"

/ {
	model = "Qualcomm Technologies, Inc. Vienna ATP No Camera PMW6100 V1";
	compatible = "qcom,vienna-atp", "qcom,vienna", "qcom,atp";
	qcom,board-id = <0x10021 0x01>;
	qcom,pmic-id = <0x10064 0x0 0x0 0x0>;
};
