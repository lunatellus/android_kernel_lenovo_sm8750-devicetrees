// SPDX-License-Identifier: BSD-3-Clause
/*
 * Copyright (c) Qualcomm Technologies, Inc. and/or its subsidiaries.
 */

#include "chora-mtp.dtsi"

&qupv3_se4_spi {
	status = "disabled";
};

&qupv3_se4_i2c {
	#address-cells = <1>;
	#size-cells = <0>;

	qcom,i2c-touch-active = "focaltech,fts_ts";
	status = "ok";

	focaltech@38 {
		compatible = "focaltech,fts_ts";
		reg = <0x38>;

		interrupt-parent = <&tlmm>;
		interrupts = <0 0x2008>;
		focaltech,reset-gpio = <&tlmm 1 0x00>;
		focaltech,irq-gpio = <&tlmm 0 0x2008>;
		focaltech,display-coords = <0 0 1080 2408>;
		focaltech,max-touch-number = <10>;
		focaltech,ic-type = <0x8726081C>;
		focaltech,touch-type = "primary";

		pinctrl-names = "pmx_ts_active","pmx_ts_suspend","pmx_ts_release";
		pinctrl-0 = <&ts_active>;
		pinctrl-1 = <&ts_int_suspend &ts_reset_suspend>;
		pinctrl-2 = <&ts_release>;
	};
};
