// SPDX-License-Identifier: BSD-3-Clause
/*
 * Copyright (c) Qualcomm Technologies, Inc. and/or its subsidiaries.
 */

#include "waipio-v2.dtsi"

/ {
	model = "Qualcomm Technologies, Inc. Waipio LTE";
	compatible = "qcom,waipio";
	qcom,msm-id = <552 0x10000>;
};
