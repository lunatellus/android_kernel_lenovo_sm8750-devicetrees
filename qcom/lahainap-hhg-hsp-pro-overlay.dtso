// SPDX-License-Identifier: BSD-3-Clause
/*
 * Copyright (c) Qualcomm Technologies, Inc. and/or its subsidiaries.
 */

/dts-v1/;
/plugin/;

#include "lahainap-hhg-hsp-pro.dtsi"

/ {
	model = "Qualcomm Technologies, Inc. Lahainap HHG-HSP-PRO";
	compatible = "qcom,lahaina-hdk", "qcom,lahaina", "qcom,hdk";
	qcom,board-id = <0x1001f 0x02>;
};
