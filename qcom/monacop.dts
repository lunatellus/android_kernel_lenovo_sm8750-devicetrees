// SPDX-License-Identifier: BSD-3-Clause
/*
 * Copyright (c) Qualcomm Technologies, Inc. and/or its subsidiaries.
 */

/dts-v1/;

#include "monacop.dtsi"

/ {
	model = "Qualcomm Technologies, Inc. MonacoP SoC";
	compatible = "qcom,monacop";
	qcom,board-id = <0 0>;
};
