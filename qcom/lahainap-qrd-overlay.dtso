// SPDX-License-Identifier: BSD-3-Clause
/*
 * Copyright (c) Qualcomm Technologies, Inc. and/or its subsidiaries.
 */

/dts-v1/;
/plugin/;

#include "lahainap-qrd.dtsi"

/ {
	model = "Qualcomm Technologies, Inc. LahainaP QRD";
	compatible = "qcom,lahainap-qrd", "qcom,lahainap", "qcom,qrd";
	qcom,board-id = <0x1000B 0>;
};
