// SPDX-License-Identifier: BSD-3-Clause
/*
 * Copyright (c) Qualcomm Technologies, Inc. and/or its subsidiaries.
 */

/dts-v1/;
/plugin/;

#include <dt-bindings/clock/qcom,sm4450-gcc.h>
#include <dt-bindings/clock/qcom,sm4450-camcc.h>
#include <dt-bindings/interconnect/qcom,ravelin.h>
#include <dt-bindings/interrupt-controller/arm-gic.h>
#include <dt-bindings/regulator/qcom,rpmh-regulator-levels.h>
#include "bourtzi-camera-sensor-mtp.dtsi"

/ {
	model = "Qualcomm Technologies, Inc. Bourtzi RCM + WCN3998 + tioman";
	compatible = "qcom,bourtzi-rcm", "qcom,rcm", "qcom,bourtzi";
	qcom,msm-id = <776 0x10000>, <777 0x10000>;
	qcom,board-id = <0x10015 0x600>, <0x20015 0x0>, <0x30015 0x600>, <0x40015 0x0>;
};
