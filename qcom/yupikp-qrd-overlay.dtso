// SPDX-License-Identifier: BSD-3-Clause
/*
 * Copyright (c) Qualcomm Technologies, Inc. and/or its subsidiaries.
 */

/dts-v1/;
/plugin/;

#include "yupikp-qrd.dtsi"

/ {
	model = "Qualcomm Technologies, Inc. YupikP QRD";
	compatible = "qcom,yupikp-qrd", "qcom,yupikp", "qcom,qrd";
	qcom,msm-id = <499 0x10000>;
	qcom,board-id = <0x1000B 0>;
};
