// SPDX-License-Identifier: BSD-3-Clause
/*
 * Copyright (c) Qualcomm Technologies, Inc. and/or its subsidiaries.
 */

/dts-v1/;
/plugin/;

#include "chora-mtp.dtsi"
#include "chora-pmiv010x-pmd802x.dtsi"

/ {
	model = "Qualcomm Technologies, Inc. Chora MTP evros";
	compatible = "qcom,chora-mtp", "qcom,chora", "qcom,chorap-mtp", "qcom,chorap", "qcom,mtp";
	qcom,msm-id = <724 0x10000>, <744 0x10000>;
	qcom,board-id = <0x10008 0x0>;
};

&pmiv010x_eusb2_repeater {
	status = "ok";
	vdd18-supply = <&L7B_E0>;
	vdd3-supply = <&L17B_E0>;
};

&eusb2_phy0 {
	dummy-supply = <&pmiv010x_eusb2_repeater>;
	usb-repeater = <&pmiv010x_eusb2_repeater>;
};
