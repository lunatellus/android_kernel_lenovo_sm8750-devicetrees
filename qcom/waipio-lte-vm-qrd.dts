// SPDX-License-Identifier: BSD-3-Clause
/*
 * Copyright (c) Qualcomm Technologies, Inc. and/or its subsidiaries.
 */

/dts-v1/;

#include "waipio-lte-vm.dtsi"
#include "waipio-lte-vm-qrd.dtsi"

/ {
	model = "Qualcomm Technologies, Inc. Waipio LTE SVM QRD";
	compatible = "qcom,waipio-qrd", "qcom,waipio", "qcom,qrd";
	qcom,board-id = <0x1000B 0>;
};
