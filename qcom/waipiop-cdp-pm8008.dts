// SPDX-License-Identifier: BSD-3-Clause
/*
 * Copyright (c) Qualcomm Technologies, Inc. and/or its subsidiaries.
 */

/dts-v1/;

#include "waipiop.dtsi"
#include "waipio-cdp.dtsi"
#include "waipio-pm8008.dtsi"

/ {
	model = "Qualcomm Technologies, Inc. WaipioP CDP with PM8008";
	compatible = "qcom,waipiop-cdp", "qcom,waipiop", "qcom,cdp";
	qcom,board-id = <1 0>;
};
