// SPDX-License-Identifier: BSD-3-Clause
/*
 * Copyright (c) Qualcomm Technologies, Inc. and/or its subsidiaries.
 */

/dts-v1/;
/plugin/;

#include "seraph-vm-avf.dtsi"
#include "seraph-vm-idp-avf.dtsi"

/ {
	model = "Qualcomm Technologies, Inc. Seraph SVM IDP";
	compatible = "qcom,seraph-idp", "qcom,seraph", "qcom,idp";
	qcom,board-id = <0x10022 0>;

	host {
	};
};
