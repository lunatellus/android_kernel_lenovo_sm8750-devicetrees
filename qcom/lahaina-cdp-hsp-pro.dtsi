// SPDX-License-Identifier: BSD-3-Clause
/*
 * Copyright (c) Qualcomm Technologies, Inc. and/or its subsidiaries.
 */

#include "lahaina-cdp.dtsi"
&bluetooth {
	pinctrl-1 = <&wcnss_en_sleep>;
	qcom,xo-reset-gpio = <&tlmm 201 0>; /* XO */
};

&wlan {
	qcom,xo-clk-gpio = <&tlmm 201 0>;
};
