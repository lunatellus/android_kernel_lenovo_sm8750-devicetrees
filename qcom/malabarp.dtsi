// SPDX-License-Identifier: BSD-3-Clause
/*
 * Copyright (c) Qualcomm Technologies, Inc. and/or its subsidiaries.
 */

#include "malabar.dtsi"

/ {
	model = "Qualcomm Technologies, Inc. MalabarP";
	compatible = "qcom,malabarp";
	qcom,msm-id = <757 0x10000>;
};
