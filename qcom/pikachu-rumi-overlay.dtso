// SPDX-License-Identifier: BSD-3-Clause
/*
 * Copyright (c) Qualcomm Technologies, Inc. and/or its subsidiaries.
 */

/dts-v1/;
/plugin/;

#include "pikachu-rumi.dtsi"

/ {
	model = "Qualcomm Technologies, Inc. Pikachu RUMI";
	compatible = "qcom,pikachu-rumi", "qcom,pikachu", "qcom,rumi";
	qcom,msm-id = <736 0x10000>;
	qcom,board-id = <15 0>;
};
