// SPDX-License-Identifier: BSD-3-Clause
/*
 * Copyright (c) Qualcomm Technologies, Inc. and/or its subsidiaries.
 */

&soc {
	apss_cti1: cti@128f0000 {
		compatible = "arm,coresight-cti", "arm,primecell";
		reg = <0x128f0000 0x1000>;

		arm,primecell-periphid = <0x000bb922>;
		device-name = "cti_apss1";
		clocks = <&aoss_qmp>;
		clock-names = "apb_pclk";
	};

	apss_cti0: cti@128e0000 {
		compatible = "arm,coresight-cti", "arm,primecell";
		reg = <0x128e0000 0x1000>;

		arm,primecell-periphid = <0x000bb922>;
		device-name = "cti_apss0";
		clocks = <&aoss_qmp>;
		clock-names = "apb_pclk";
	};

	apss_cti2: cti@12900000 {
		compatible = "arm,coresight-cti", "arm,primecell";
		reg = <0x12900000 0x1000>;

		arm,primecell-periphid = <0x000bb922>;
		device-name = "cti_apss2";
		clocks = <&aoss_qmp>;
		clock-names = "apb_pclk";
	};

	riscv_cti: cti@1282b000 {
		compatible = "arm,coresight-cti", "arm,primecell";
		reg = <0x1282b000 0x1000>;

		arm,primecell-periphid = <0x000bb922>;
		device-name = "cti_riscv";
		status = "disabled";
		clocks = <&aoss_qmp>;
		clock-names = "apb_pclk";
	};

	gpu_isdb_cti: cti@11161000 {
		compatible = "arm,coresight-cti", "arm,primecell";
		reg = <0x11161000 0x1000>;

		arm,primecell-periphid = <0x000bb922>;
		device-name = "cti_gpu_isdb";
		status = "disabled";
		clocks = <&aoss_qmp>;
		clock-names = "apb_pclk";
	};

	gpu_cortex_m3: cti@11162000 {
		compatible = "arm,coresight-cti", "arm,primecell";
		reg = <0x11162000 0x1000>;

		arm,primecell-periphid = <0x000bb922>;
		device-name = "cti_gpu_cortex_m3";
		status = "disabled";
		clocks = <&aoss_qmp>;
		clock-names = "apb_pclk";
	};

	lpass_cti1: cti@11342000 {
		compatible = "arm,coresight-cti", "arm,primecell";
		reg = <0x11342000 0x1000>;

		arm,primecell-periphid = <0x000bb922>;
		device-name = "cti_lpass1";
		qcom,extended_cti;
		status = "disabled";
		clocks = <&aoss_qmp>;
		clock-names = "apb_pclk";
	};

	lpass_q6_cti: cti@1134b000 {
		compatible = "arm,coresight-cti", "arm,primecell";
		reg = <0x1134b000 0x1000>;

		arm,primecell-periphid = <0x000bb922>;
		device-name = "cti_lpass_q6";
		status = "disabled";
		clocks = <&aoss_qmp>;
		clock-names = "apb_pclk";
	};

	turing_q6_cti: cti@11193000 {
		compatible = "arm,coresight-cti", "arm,primecell";
		reg = <0x11193000 0x1000>;

		arm,primecell-periphid = <0x000bb922>;
		device-name = "cti_turing_q6";
		status = "disabled";
		clocks = <&aoss_qmp>;
		clock-names = "apb_pclk";
	};

	aop_rvss: cti@11321000 {
		compatible = "arm,coresight-cti", "arm,primecell";
		reg = <0x11321000 0x1000>;

		arm,primecell-periphid = <0x000bb922>;
		device-name = "cti_aop_rvss";
		status = "disabled";
		clocks = <&aoss_qmp>;
		clock-names = "apb_pclk";
	};

	ddrss_shrm2: cti@11511000 {
		compatible = "arm,coresight-cti", "arm,primecell";
		reg = <0x11511000 0x1000>;

		arm,primecell-periphid = <0x000bb922>;
		device-name = "cti_ddrss_shrm2";
		status = "disabled";
		clocks = <&aoss_qmp>;
		clock-names = "apb_pclk";
	};

	lpass_lpi_cti1: cti@11341000 {
		compatible = "arm,coresight-cti", "arm,primecell";
		reg = <0x11341000 0x1000>;

		arm,primecell-periphid = <0x000bb922>;
		device-name = "cti_lpass_lpi1";
		status = "disabled";
		clocks = <&aoss_qmp>;
		clock-names = "apb_pclk";
	};

	lpass_cti0: cti@11351000 {
		compatible = "arm,coresight-cti", "arm,primecell";
		reg = <0x11351000 0x1000>;

		arm,primecell-periphid = <0x000bb922>;
		device-name = "cti_lpass0";
		qcom,extended_cti;
		status = "disabled";
		clocks = <&aoss_qmp>;
		clock-names = "apb_pclk";
	};

	tmess_cpu: cti@114d1000 {
		compatible = "arm,coresight-cti", "arm,primecell";
		reg = <0x114d1000 0x1000>;

		arm,primecell-periphid = <0x000bb922>;
		device-name = "cti_tmess_cpu";
		status = "disabled";

		clocks = <&aoss_qmp>;
		clock-names = "apb_pclk";
	};

	swao_cti: cti@11300000 {
		compatible = "arm,coresight-cti", "arm,primecell";
		reg = <0x11300000 0x1000>;

		arm,primecell-periphid = <0x000bb922>;
		device-name = "cti_swao";
		qcom,extended_cti;
		clocks = <&aoss_qmp>;
		clock-names = "apb_pclk";
	};

	apss_atb_cti: cti@12862000 {
		compatible = "arm,coresight-cti", "arm,primecell";
		reg = <0x12862000 0x1000>;

		arm,primecell-periphid = <0x000bb922>;
		device-name = "cti_apss_atb";
		qcom,extended_cti;
		clocks = <&aoss_qmp>;
		clock-names = "apb_pclk";
	};

	ddr_lpi_cti: cti@11331000 {
		compatible = "arm,coresight-cti", "arm,primecell";
		reg = <0x11331000 0x1000>;

		arm,primecell-periphid = <0x000bb922>;
		device-name = "cti_lpi";
		status = "disabled";
		qcom,extended_cti;
		clocks = <&aoss_qmp>;
		clock-names = "apb_pclk";
	};

	ddr_cti0: cti@11502000 {
		compatible = "arm,coresight-cti", "arm,primecell";
		reg = <0x11502000 0x1000>;

		arm,primecell-periphid = <0x000bb922>;
		device-name = "cti_ddr0";
		qcom,extended_cti;
		status = "disabled";
		clocks = <&aoss_qmp>;
		clock-names = "apb_pclk";
	};

	ddr_cti1: cti@11508000 {
		compatible = "arm,coresight-cti", "arm,primecell";
		reg = <0x11508000 0x1000>;

		arm,primecell-periphid = <0x000bb922>;
		device-name = "cti_ddr1";
		qcom,extended_cti;
		status = "disabled";
		clocks = <&aoss_qmp>;
		clock-names = "apb_pclk";
	};

	ddr_ch02_dl_cti_0: cti@11521000 {
		compatible = "arm,coresight-cti", "arm,primecell";
		reg = <0x11521000 0x1000>;

		arm,primecell-periphid = <0x000bb922>;
		device-name = "cti_ddr_ch02_dl0";
		qcom,extended_cti;
		status = "disabled";
		clocks = <&aoss_qmp>;
		clock-names = "apb_pclk";
	};

	cti0: cti@1142a000 {
		compatible = "arm,coresight-cti", "arm,primecell";
		reg = <0x1142a000 0x1000>;

		arm,primecell-periphid = <0x000bb922>;
		device-name = "cti_cti0";
		qcom,extended_cti;
		status = "disabled";
		clocks = <&aoss_qmp>;
		clock-names = "apb_pclk";
	};

	dlct1_cti: cti@112c3000 {
		compatible = "arm,coresight-cti", "arm,primecell";
		reg = <0x112c3000 0x1000>;

		arm,primecell-periphid = <0x000bb922>;
		device-name = "cti_dlct1";
		qcom,extended_cti;
		clocks = <&aoss_qmp>;
		clock-names = "apb_pclk";
	};

	dlmm_cti0: cti@11409000 {
		compatible = "arm,coresight-cti", "arm,primecell";
		reg = <0x11409000 0x1000>;

		arm,primecell-periphid = <0x000bb922>;
		device-name = "cti_dlmm0";
		qcom,extended_cti;
		status = "disabled";
		clocks = <&aoss_qmp>;
		clock-names = "apb_pclk";
	};

	eva_cti: cti@11441000 {
		compatible = "arm,coresight-cti", "arm,primecell";
		reg = <0x11441000 0x1000>;

		arm,primecell-periphid = <0x000bb922>;
		device-name = "cti_eva";
		qcom,extended_cti;
		status = "disabled";
		clocks = <&aoss_qmp>;
		clock-names = "apb_pclk";
	};

	iris_dl_cti: cti@11031000 {
		compatible = "arm,coresight-cti", "arm,primecell";
		reg = <0x11031000 0x1000>;

		arm,primecell-periphid = <0x000bb922>;
		device-name = "cti_iris_dl";
		qcom,extended_cti;
		status = "disabled";
		clocks = <&aoss_qmp>;
		clock-names = "apb_pclk";
	};

	qdss_cti: cti@10010000 {
		compatible = "arm,coresight-cti", "arm,primecell";
		reg = <0x10010000 0x1000>;

		arm,primecell-periphid = <0x000bb922>;
		device-name = "cti-qdss";
		qcom,extended_cti;
		clocks = <&aoss_qmp>;
		clock-names = "apb_pclk";

//		qcom,cti-gpio-trigout = <20>;
//		pinctrl-names = "cti-trigout-pctrl";
//		pinctrl-0 = <&trigout_a>;
	};

	soccp_cti: cti@11381000 {
		compatible = "arm,coresight-cti", "arm,primecell";
		reg = <0x11381000 0x1000>;

		arm,primecell-periphid = <0x000bb922>;
		device-name = "cti-soccp";
		qcom,extended_cti;
		status = "disabled";
		clocks = <&aoss_qmp>;
		clock-names = "apb_pclk";
	};

	tmess_cti_0: cti@114c3000 {
		compatible = "arm,coresight-cti", "arm,primecell";
		reg = <0x114c3000 0x1000>;

		arm,primecell-periphid = <0x000bb922>;
		device-name = "cti-tmess";
		qcom,extended_cti;
		status = "disabled";
		clocks = <&aoss_qmp>;
		clock-names = "apb_pclk";
	};

	turing_dl_cti_0: cti@11187000 {
		compatible = "arm,coresight-cti", "arm,primecell";
		reg = <0x11187000 0x1000>;

		arm,primecell-periphid = <0x000bb922>;
		device-name = "cti-turing_dl0";
		qcom,extended_cti;
		status = "disabled";
		clocks = <&aoss_qmp>;
		clock-names = "apb_pclk";
	};

	mdss_cti: cti@11461000 {
		compatible = "arm,coresight-cti", "arm,primecell";
		reg = <0x11461000 0x1000>;

		arm,primecell-periphid = <0x000bb922>;
		device-name = "cti-mdss";
		qcom,extended_cti;
		clocks = <&aoss_qmp>;
		clock-names = "apb_pclk";
	};

	ipcb_tgu: tgu@1130e000 {
		compatible = "arm,primecell";
		arm,primecell-periphid = <0x000bb999>;
		reg = <0x1130e000 0x1000>;
		reg-names = "tgu-base";
		tgu-steps = <2>;
		tgu-conditions = <4>;
		tgu-regs = <4>;

		device-name = "tgu_ipcb";

		clocks = <&aoss_qmp>;
		clock-names = "apb_pclk";
	};

	spmi_tgu0: tgu@1130f000 {
		compatible = "arm,primecell";
		arm,primecell-periphid = <0x000bb999>;

		reg = <0x1130f000 0x1000>;
		reg-names = "tgu-base";

		tgu-steps = <3>;
		tgu-conditions = <4>;
		tgu-regs = <8>;

		device-name = "tgu_spmi0";

		clocks = <&aoss_qmp>;
		clock-names = "apb_pclk";
	};

	spmi_tgu1: tgu@11310000 {
		compatible = "arm,primecell";
		arm,primecell-periphid = <0x000bb999>;

		reg = <0x11310000 0x1000>;
		reg-names = "tgu-base";

		tgu-steps = <2>;
		tgu-conditions = <4>;
		tgu-regs = <8>;

		device-name = "tgu_spmi1";

		clocks = <&aoss_qmp>;
		clock-names = "apb_pclk";
	};

	csr: csr@10001000 {
		compatible = "qcom,coresight-csr";
		reg = <0x10001000 0x1000>;
		reg-names = "csr-base";

		device-name = "csr";

		qcom,hwctrl-set-support;
		qcom,set-byte-cntr-support;
		qcom,blk-size = <1>;
	};

	swao_csr: csr@11311000 {
		compatible = "qcom,coresight-csr";
		reg = <0x11311000 0x1000>,
			<0x113110f8 0x90>;
		reg-names = "csr-base", "msr-base";

		device-name = "swao_csr";

		qcom,timestamp-support;
		qcom,msr-support;
		qcom,blk-size = <1>;

		clocks = <&aoss_qmp>;
		clock-names = "apb_pclk";
	};

	gpu_tpdm_gpu: tpdm@11100000 {
		compatible = "qcom,coresight-tpdm","arm,primecell";
		reg = <0x11100000 0x1000>;

		reg-names = "tpdm-base";
		device-name = "tpdm_gpu";

		status = "disabled";
		qcom,dsb-element-bits = <32>;
		qcom,dsb-msrs-num = <8>;

		clocks = <&aoss_qmp>;
		clock-names = "apb_pclk";
		out-ports {
			port {
				gpu_tpdm_gpu_out_gpu_dl_0: endpoint {
					remote-endpoint =
						<&gpu_dl_0_in_gpu_tpdm_gpu>;
				};
			};
		};
	};

	gpu_dl: funnel@11102000 {
		compatible = "arm,coresight-dynamic-funnel","arm,primecell";
		reg = <0x11102000 0x1000>;

		reg-names = "funnel-base";
		device-name = "funnel_gpu";

		clocks = <&aoss_qmp>;
		clock-names = "apb_pclk";
		status = "disabled";
		in-ports {
			port@0 {
				gpu_dl_0_in_gpu_tpdm_gpu: endpoint {
					remote-endpoint =
						<&gpu_tpdm_gpu_out_gpu_dl_0>;
				};
			};
		};

		out-ports {
			port@0 {
				gpu_dl_out_tpda_dlct_0_19: endpoint {
					remote-endpoint =
						<&tpda_dlct_0_19_in_gpu_dl>;
				};
			};
		};
	};

	ddr_tpdm_lpicc_dsb: tpdm@11330000 {
		compatible = "arm,coresight-dummy-source";
		device-name = "tpdm_ddr_lpi";
		trace-name = "tpda-ddr-lpi";
		out-ports {
			#address-cells = <1>;
			#size-cells = <0>;
			port@0 {
				reg = <0>;
				ddr_tpdm_lpicc_dsb_out_ddr_lpi_funnel_0: endpoint {
					remote-endpoint =
						<&ddr_lpi_funnel_0_in_ddr_tpdm_lpicc_dsb>;
				};
			};

			port@1 {
				reg = <1>;
				ddr_lpi_out_qmi: endpoint {
					remote-endpoint =
					<&qmi_in_ddr_lpi>;
				};
			};
		};
	};

	ddr_lpi_funnel: funnel@11333000 {
		compatible = "arm,coresight-static-funnel";
		device-name = "funnel_ddr_lpi";

		in-ports {
			port@0 {
				ddr_lpi_funnel_0_in_ddr_tpdm_lpicc_dsb: endpoint {
					remote-endpoint =
						<&ddr_tpdm_lpicc_dsb_out_ddr_lpi_funnel_0>;
				};
			};
		};

		out-ports {
			port {
				ddr_lpi_funnel_out_aoss_3: endpoint {
					remote-endpoint =
						<&aoss_3_in_ddr_lpi_funnel>;
				};
			};
		};
	};

	ddr_tpdm_channel_0_2: tpdm@11520000 {
		compatible = "qcom,coresight-tpdm","arm,primecell";
		reg = <0x11520000 0x1000>;

		reg-names = "tpdm-base";
		device-name = "tpdm_ddr_ch02";

		qcom,cmb-element-bits = <32>;
		qcom,dsb-element-bits = <32>;
		qcom,dsb-msrs-num = <16>;

		clocks = <&aoss_qmp>;
		clock-names = "apb_pclk";

		out-ports {
			port {
				ddr_tpdm_channel_0_2_out_ddr_ch_0_2_dl_0: endpoint {
					remote-endpoint =
						<&ddr_ch_0_2_dl_0_in_ddr_tpdm_channel_0_2>;
				};
			};
		};
	};

	ddr_ch_0_2_dl: funnel@11522000 {
		compatible = "arm,coresight-dynamic-funnel","arm,primecell";
		reg = <0x11522000 0x1000>;

		reg-names = "funnel-base";
		device-name = "funnel_ddr_ch02";
		clocks = <&aoss_qmp>;
		clock-names = "apb_pclk";
		in-ports {
			port@0 {
				ddr_ch_0_2_dl_0_in_ddr_tpdm_channel_0_2: endpoint {
					remote-endpoint =
						<&ddr_tpdm_channel_0_2_out_ddr_ch_0_2_dl_0>;
				};
			};
		};

		out-ports {
			port {
				ddr_ch_0_2_dl_out_dl_0_ddr_0: endpoint {
					remote-endpoint =
						<&dl_0_ddr_0_in_ddr_ch_0_2_dl>;
				};
			};
		};
	};

	ddr_tpdm_ddr_dl_0_dsb_cmb: tpdm@11500000 {
		compatible = "qcom,coresight-tpdm","arm,primecell";
		reg = <0x11500000 0x1000>;

		reg-names = "tpdm-base";
		device-name = "tpdm_ddr_dl0";

		qcom,cmb-element-bits = <32>;
		qcom,dsb-element-bits = <32>;
		qcom,dsb-msrs-num = <32>;

		clocks = <&aoss_qmp>;
		clock-names = "apb_pclk";

		out-ports {
			port {
				ddr_tpdm_ddr_dl_0_dsb_cmb_out_dl_0_ddr_2: endpoint {
					remote-endpoint =
						<&dl_0_ddr_2_in_ddr_tpdm_ddr_dl_0_dsb_cmb>;
				};
			};
		};
	};

	ddr_tpdm_ddr_dpm: tpdm@11501000 {
		compatible = "qcom,coresight-tpdm","arm,primecell";
		reg = <0x11501000 0x1000>;

		reg-names = "tpdm-base";
		device-name = "tpdm_ddr_dpm";

		qcom,cmb-element-bits = <64>;

		clocks = <&aoss_qmp>;
		clock-names = "apb_pclk";

		out-ports {
			port {
				ddr_tpdm_ddr_dpm_out_dl_0_ddr_3: endpoint {
					remote-endpoint =
						<&dl_0_ddr_3_in_ddr_tpdm_ddr_dpm>;
				};
			};
		};
	};

	gladiator: gladiator {
		compatible = "arm,coresight-dummy-source";
		device-name = "gladiator";
		atid = <96>;

		out-ports {
			port {
				gladiator_out_dl_1_ddr: endpoint {
					remote-endpoint =
					<&dl_1_ddr_in_gladiator>;
				};
			};
		};
	};

	tpda_llcc: tpda@11509000 {
		compatible = "qcom,coresight-tpda","arm,primecell";
		reg = <0x11509000 0x1000>;

		reg-names = "tpda-base";
		device-name = "tpda_ddr_llcc";

		clocks = <&aoss_qmp>;
		clock-names = "apb_pclk";
		in-ports {
			#address-cells = <1>;
			#size-cells = <0>;
			port@0 {
				reg = <0>;
				tpda_llcc_0_in_ddr_tpdm_llcc_0: endpoint {
					remote-endpoint =
						<&ddr_tpdm_llcc_0_out_tpda_llcc_0>;
				};
			};

			port@1 {
				reg = <1>;
				tpda_llcc_1_in_ddr_tpdm_llcc_1: endpoint {
					remote-endpoint =
						<&ddr_tpdm_llcc_1_out_tpda_llcc_1>;
				};
			};
		};

		out-ports {
			port {
				tpda_llcc_out_dl_1_ddr_0: endpoint {
					remote-endpoint =
						<&dl_1_ddr_0_in_tpda_llcc>;
				};
			};
		};
	};

	dl_1_ddr: funnel@1150a000 {
		compatible = "arm,coresight-dynamic-funnel","arm,primecell";
		reg = <0x1150a000 0x1000>;

		reg-names = "funnel-base";
		device-name = "funnel_ddr_dl1";

		clocks = <&aoss_qmp>;
		clock-names = "apb_pclk";
		in-ports {
			#address-cells = <1>;
			#size-cells = <0>;
			port@0 {
				reg = <0>;
				dl_1_ddr_0_in_tpda_llcc: endpoint {
					remote-endpoint =
						<&tpda_llcc_out_dl_1_ddr_0>;
				};
			};

			port@3 {
				reg = <3>;
				dl_1_ddr_in_gladiator: endpoint {
					remote-endpoint =
					<&gladiator_out_dl_1_ddr>;
				};
			};
		};

		out-ports {
			port {
				dl_1_ddr_out_dl_0_ddr_4: endpoint {
					remote-endpoint =
						<&dl_0_ddr_4_in_dl_1_ddr>;
				};
			};
		};
	};

	dl_0_ddr: funnel@11503000 {
		compatible = "arm,coresight-dynamic-funnel","arm,primecell";
		reg = <0x11503000 0x1000>;

		reg-names = "funnel-base";
		device-name = "funnel_ddr_dl0";

		clocks = <&aoss_qmp>;
		clock-names = "apb_pclk";
		in-ports {
			#address-cells = <1>;
			#size-cells = <0>;
			port@0 {
				reg = <0>;
				dl_0_ddr_0_in_ddr_ch_0_2_dl: endpoint {
					remote-endpoint =
						<&ddr_ch_0_2_dl_out_dl_0_ddr_0>;
				};
			};

			port@2 {
				reg = <2>;
				dl_0_ddr_2_in_ddr_tpdm_ddr_dl_0_dsb_cmb: endpoint {
					remote-endpoint =
						<&ddr_tpdm_ddr_dl_0_dsb_cmb_out_dl_0_ddr_2>;
				};
			};

			port@3 {
				reg = <3>;
				dl_0_ddr_3_in_ddr_tpdm_ddr_dpm: endpoint {
					remote-endpoint =
						<&ddr_tpdm_ddr_dpm_out_dl_0_ddr_3>;
				};
			};

			port@4 {
				reg = <4>;
				dl_0_ddr_4_in_dl_1_ddr: endpoint {
					remote-endpoint =
						<&dl_1_ddr_out_dl_0_ddr_4>;
				};
			};
		};

		out-ports {
			#address-cells = <1>;
			#size-cells = <0>;

			port@0 {
				reg = <0>;
				dl_0_ddr_out_tpda_dlct_0_4: endpoint {
					remote-endpoint =
						<&tpda_dlct_0_4_in_dl_0_ddr>;
					filter-source = <&ddr_tpdm_channel_0_2>;
				};
			};

			port@1 {
				reg = <1>;
				dl_0_ddr_out_tpda_dlct_0_6: endpoint {
					remote-endpoint =
						<&tpda_dlct_0_6_in_dl_0_ddr>;
					filter-source = <&ddr_tpdm_ddr_dl_0_dsb_cmb>;
				};
			};

			port@2 {
				reg = <2>;
				dl_0_ddr_out_tpda_dlct_0_7: endpoint {
					remote-endpoint =
						<&tpda_dlct_0_7_in_dl_0_ddr>;
					filter-source = <&ddr_tpdm_ddr_dpm>;
				};
			};

			port@3 {
				reg = <3>;
				dl_0_ddr_out_dlct_0_2: endpoint {
					remote-endpoint =
						<&dlct_0_2_in_dl_0_ddr>;
				};
			};
		};
	};

	ddr_tpdm_llcc_0: tpdm@11540000 {
		compatible = "qcom,coresight-tpdm","arm,primecell";
		reg = <0x11540000 0x1000>;

		reg-names = "tpdm-base";
		device-name = "tpdm_llcc0";

		qcom,cmb-element-bits = <32>;

		clocks = <&aoss_qmp>;
		clock-names = "apb_pclk";
		out-ports {
			port {
				ddr_tpdm_llcc_0_out_tpda_llcc_0: endpoint {
					remote-endpoint =
						<&tpda_llcc_0_in_ddr_tpdm_llcc_0>;
				};
			};
		};
	};

	ddr_tpdm_llcc_1: tpdm@11541000 {
		compatible = "qcom,coresight-tpdm","arm,primecell";
		reg = <0x11541000 0x1000>;

		reg-names = "tpdm-base";
		device-name = "tpdm_llcc1";

		qcom,cmb-element-bits = <32>;

		clocks = <&aoss_qmp>;
		clock-names = "apb_pclk";
		out-ports {
			port {
				ddr_tpdm_llcc_1_out_tpda_llcc_1: endpoint {
					remote-endpoint =
						<&tpda_llcc_1_in_ddr_tpdm_llcc_1>;
				};
			};
		};
	};

	qm_tpdm_qm: tpdm@111d0000 {
		compatible = "qcom,coresight-tpdm","arm,primecell";
		reg = <0x111d0000 0x1000>;

		reg-names = "tpdm-base";
		device-name = "tpdm_qm";

		qcom,dsb-element-bits = <32>;

		clocks = <&aoss_qmp>;
		clock-names = "apb_pclk";

		out-ports {
			port {
				qm_tpdm_qm_out_tpda_dlct_0_22: endpoint {
					remote-endpoint =
						<&tpda_dlct_0_22_in_qm_tpdm_qm>;
				};
			};
		};
	};

	gcc_tpdm_gcc_dsb: tpdm@1102c000 {
		compatible = "qcom,coresight-tpdm","arm,primecell";
		reg = <0x1102c000 0x1000>;

		reg-names = "tpdm-base";
		device-name = "tpdm_gcc";

		qcom,dsb-element-bits = <32>;
		qcom,dsb-msrs-num = <32>;

		clocks = <&aoss_qmp>;
		clock-names = "apb_pclk";
		out-ports {
			port {
				gcc_tpdm_gcc_dsb_out_tpda_dlct_0_23: endpoint {
					remote-endpoint =
						<&tpda_dlct_0_23_in_gcc_tpdm_gcc_dsb>;
				};
			};
		};
	};

	vsense_tpdm_vsense: tpdm@11040000 {
		compatible = "qcom,coresight-tpdm","arm,primecell";
		reg = <0x11040000 0x1000>;

		reg-names = "tpdm-base";
		device-name = "tpdm_vsense";

		qcom,cmb-element-bits = <32>;

		clocks = <&aoss_qmp>;
		clock-names = "apb_pclk";

		status = "disabled";
		out-ports {
			port {
				vsense_tpdm_vsense_out_tpda_dlct_0_24: endpoint {
					remote-endpoint =
						<&tpda_dlct_0_24_in_vsense_tpdm_vsense>;
				};
			};
		};
	};

	ipa_tpdm_ipa: tpdm@11422000 {
		compatible = "qcom,coresight-tpdm","arm,primecell";
		reg = <0x11422000 0x1000>;

		reg-names = "tpdm-base";
		device-name = "tpdm_ipa";

		qcom,cmb-element-bits = <64>;
		qcom,dsb-element-bits = <32>;
		qcom,dsb-msrs-num = <32>;
		qcom,cmb-msrs-num = <1>;

		clocks = <&aoss_qmp>;
		clock-names = "apb_pclk";

		status = "disabled";
		out-ports {
			port {
				ipa_tpdm_ipa_out_tpda_dlct_0_26: endpoint {
					remote-endpoint =
						<&tpda_dlct_0_26_in_ipa_tpdm_ipa>;
				};
			};
		};
	};

	video_tpdm_iris_mvp_dsb: tpdm@11030000 {
		compatible = "qcom,coresight-tpdm","arm,primecell";
		reg = <0x11030000 0x1000>;

		reg-names = "tpdm-base";
		device-name = "tpdm_video";

		qcom,dsb-element-bits = <32>;

		clocks = <&aoss_qmp>;
		clock-names = "apb_pclk";

		status = "disabled";
		out-ports {
			port {
				video_tpdm_iris_mvp_dsb_out_video_0: endpoint {
					remote-endpoint =
						<&video_0_in_video_tpdm_iris_mvp_dsb>;
				};
			};
		};
	};

	video: funnel@11032000 {
		compatible = "arm,coresight-dynamic-funnel","arm,primecell";
		reg = <0x11032000 0x1000>;

		reg-names = "funnel-base";
		device-name = "funnel_video";

		clocks = <&aoss_qmp>;
		clock-names = "apb_pclk";
		status = "disabled";
		in-ports {
			port@0 {
				video_0_in_video_tpdm_iris_mvp_dsb: endpoint {
					remote-endpoint =
						<&video_tpdm_iris_mvp_dsb_out_video_0>;
				};
			};
		};

		out-ports {
			port@0 {
				video_out_tpda_dlmm_0: endpoint {
					remote-endpoint =
						<&tpda_dlmm_0_in_video>;
				};
			};
		};
	};

	mdss_tpdm_mdss: tpdm@11460000 {
		compatible = "qcom,coresight-tpdm","arm,primecell";
		reg = <0x11460000 0x1000>;

		reg-names = "tpdm-base";
		device-name = "tpdm_mdss";

		qcom,cmb-element-bits = <32>;
		qcom,dsb-element-bits = <32>;
		qcom,dsb-msrs-num = <16>;

		clocks = <&aoss_qmp>;
		clock-names = "apb_pclk";

		status = "disabled";
		out-ports {
			port {
				mdss_tpdm_mdss_out_mdss_dl_funnel_0: endpoint {
					remote-endpoint =
						<&mdss_dl_funnel_0_in_mdss_tpdm_mdss>;
				};
			};
		};
	};

	mdss_dl_funnel: funnel@11462000 {
		compatible = "arm,coresight-dynamic-funnel","arm,primecell";
		reg = <0x11462000 0x1000>;

		reg-names = "funnel-base";
		device-name = "funnel_mdss";

		clocks = <&aoss_qmp>;
		clock-names = "apb_pclk";
		status = "disabled";
		in-ports {
			port@0 {
				mdss_dl_funnel_0_in_mdss_tpdm_mdss: endpoint {
					remote-endpoint =
						<&mdss_tpdm_mdss_out_mdss_dl_funnel_0>;
				};
			};
		};

		out-ports {
			port@0 {
				mdss_dl_funnel_out_tpda_dlmm_2: endpoint {
					remote-endpoint =
						<&tpda_dlmm_2_in_mdss_dl_funnel>;
				};
			};
		};
	};

	eva: funnel@11442000 {
		compatible = "arm,coresight-dynamic-funnel","arm,primecell";
		reg = <0x11442000 0x1000>;

		reg-names = "funnel-base";
		device-name = "funnel_eva";

		clocks = <&aoss_qmp>;
		clock-names = "apb_pclk";
		status = "disabled";
		in-ports {
			port@0 {
				eva_0_in_eva_tpdm_eva_cvp_dsb: endpoint {
					remote-endpoint =
						<&eva_tpdm_eva_cvp_dsb_out_eva_0>;
				};
			};
		};

		out-ports {
			port@0 {
				eva_out_tpda_dlmm_8: endpoint {
					remote-endpoint =
						<&tpda_dlmm_8_in_eva>;
				};
			};
		};
	};

	eva_tpdm_eva_cvp_dsb: tpdm@11440000 {
		compatible = "qcom,coresight-tpdm","arm,primecell";
		reg = <0x11440000 0x1000>;

		reg-names = "tpdm-base";
		device-name = "tpdm_eva";

		qcom,dsb-element-bits = <32>;

		clocks = <&aoss_qmp>;
		clock-names = "apb_pclk";
		status = "disabled";
		out-ports {
			port {
				eva_tpdm_eva_cvp_dsb_out_eva_0: endpoint {
					remote-endpoint =
						<&eva_0_in_eva_tpdm_eva_cvp_dsb>;
				};
			};
		};
	};


	soccp_tpdm_crdl_dsb: tpdm@11380000 {
		compatible = "qcom,coresight-tpdm","arm,primecell";
		reg = <0x11380000 0x1000>;

		reg-names = "tpdm-base";
		device-name = "tpdm_soccp";

		qcom,dsb-element-bits = <32>;
		qcom,dsb-msrs-num = <16>;

		clocks = <&aoss_qmp>;
		clock-names = "apb_pclk";

		out-ports {
			port {
				soccp_tpdm_crdl_dsb_out_soccp_dl_0: endpoint {
					remote-endpoint =
						<&soccp_dl_0_in_soccp_tpdm_crdl_dsb>;
				};
			};
		};
	};

	soccp_dl: funnel@11382000 {
		compatible = "arm,coresight-dynamic-funnel","arm,primecell";
		reg = <0x11382000 0x1000>;

		reg-names = "funnel-base";
		device-name = "funnel_soccp";

		clocks = <&aoss_qmp>;
		clock-names = "apb_pclk";
		in-ports {
			port@0 {
				soccp_dl_0_in_soccp_tpdm_crdl_dsb: endpoint {
					remote-endpoint =
						<&soccp_tpdm_crdl_dsb_out_soccp_dl_0>;
				};
			};
		};

		out-ports {
			port@0 {
				soccp_dl_out_tpda_dlct_1_0: endpoint {
					remote-endpoint =
						<&tpda_dlct_1_0_in_soccp_dl>;
				};
			};
		};
	};

	dl_west_tpdm_dl_west_dsb: tpdm@11438000 {
		compatible = "qcom,coresight-tpdm","arm,primecell";
		reg = <0x11438000 0x1000>;

		reg-names = "tpdm-base";
		device-name = "tpdm_dl_west";

		qcom,dsb-element-bits = <32>;
		qcom,dsb-msrs-num = <16>;

		clocks = <&aoss_qmp>;
		clock-names = "apb_pclk";
		out-ports {
			port {
				dl_west_tpdm_dl_west_dsb_out_tpda_dl_west_3: endpoint {
					remote-endpoint =
						<&tpda_dl_west_3_in_dl_west_tpdm_dl_west_dsb>;
				};
			};
		};
	};

	tpda_dl_west: tpda@11439000 {
		compatible = "qcom,coresight-tpda","arm,primecell";
		reg = <0x11439000 0x1000>;

		reg-names = "tpda-base";
		device-name = "tpda_dl_west";

		clocks = <&aoss_qmp>;
		clock-names = "apb_pclk";
		in-ports {
			port@3 {
				reg = <3>;
				tpda_dl_west_3_in_dl_west_tpdm_dl_west_dsb: endpoint {
					remote-endpoint =
						<&dl_west_tpdm_dl_west_dsb_out_tpda_dl_west_3>;
				};
			};
		};

		out-ports {
			port {
				tpda_dl_west_out_dl_west_0: endpoint {
					remote-endpoint =
						<&dl_west_0_in_tpda_dl_west>;
				};
			};
		};
	};

	dl_west: funnel@1143a000 {
		compatible = "arm,coresight-dynamic-funnel","arm,primecell";
		reg = <0x1143a000 0x1000>;

		reg-names = "funnel-base";
		device-name = "funnel_dl_west";

		clocks = <&aoss_qmp>;
		clock-names = "apb_pclk";
		in-ports {
			port@0 {
				dl_west_0_in_tpda_dl_west: endpoint {
					remote-endpoint =
						<&tpda_dl_west_out_dl_west_0>;
				};
			};
		};

		out-ports {
			port {
				dl_west_out_fun_in1_qdss_1: endpoint {
					remote-endpoint =
						<&fun_in1_qdss_1_in_dl_west>;
				};
			};
		};
	};

	tpda_dlct_1: tpda@112c4000 {
		compatible = "qcom,coresight-tpda","arm,primecell";
		reg = <0x112c4000 0x1000>;

		reg-names = "tpda-base";
		device-name = "tpda_dlct1";

		clocks = <&aoss_qmp>;
		clock-names = "apb_pclk";
		in-ports {
			#address-cells = <1>;
			#size-cells = <0>;
			port@0 {
				reg = <0>;
				tpda_dlct_1_0_in_soccp_dl: endpoint {
					remote-endpoint =
						<&soccp_dl_out_tpda_dlct_1_0>;
				};
			};

			port@19 {
				reg = <25>;
				tpda_dlct_1_25_in_dlct_1_tpdm_dlct_1_dsb: endpoint {
					remote-endpoint =
						<&dlct_1_tpdm_dlct_1_dsb_out_tpda_dlct_1_25>;
				};
			};

			port@1a {
				reg = <26>;
				tpda_dlct_1_26_in_dlct_1_tpdm_pmu: endpoint {
					remote-endpoint =
						<&dlct_1_tpdm_pmu_out_tpda_dlct_1_26>;
				};
			};

			port@1b {
				reg = <27>;
				tpda_dlct_1_27_in_dlct_1_tpdm_qrng: endpoint {
					remote-endpoint =
						<&dlct_1_tpdm_qrng_out_tpda_dlct_1_27>;
				};
			};
		};

		out-ports {
			port {
				tpda_dlct_1_out_dlct_1_0: endpoint {
					remote-endpoint =
						<&dlct_1_0_in_tpda_dlct_1>;
				};
			};
		};
	};

	dlct_1: funnel@112c5000 {
		compatible = "arm,coresight-dynamic-funnel","arm,primecell";
		reg = <0x112c5000 0x1000>;

		reg-names = "funnel-base";
		device-name = "funnel_dlct1";

		clocks = <&aoss_qmp>;
		clock-names = "apb_pclk";
		in-ports {
			port@0 {
				dlct_1_0_in_tpda_dlct_1: endpoint {
					remote-endpoint =
						<&tpda_dlct_1_out_dlct_1_0>;
				};
			};
		};

		out-ports {
			port {
				dlct_1_out_fun_in1_qdss_5: endpoint {
					remote-endpoint =
						<&fun_in1_qdss_5_in_dlct_1>;
				};
			};
		};
	};

	dlct_1_tpdm_dlct_1_dsb: tpdm@112c0000 {
		compatible = "qcom,coresight-tpdm","arm,primecell";
		reg = <0x112c0000 0x1000>;

		reg-names = "tpdm-base";
		device-name = "tpdm_dlct1";

		qcom,dsb-element-bits = <32>;
		qcom,dsb-msrs-num = <32>;

		clocks = <&aoss_qmp>;
		clock-names = "apb_pclk";
		out-ports {
			port {
				dlct_1_tpdm_dlct_1_dsb_out_tpda_dlct_1_25: endpoint {
					remote-endpoint =
						<&tpda_dlct_1_25_in_dlct_1_tpdm_dlct_1_dsb>;
				};
			};
		};
	};

	dlct_1_tpdm_pmu: tpdm@112c1000 {
		compatible = "qcom,coresight-tpdm","arm,primecell";
		reg = <0x112c1000 0x1000>;

		reg-names = "tpdm-base";
		device-name = "tpdm_pmu";

		qcom,cmb-element-bits = <64>;
		qcom,cmb-msrs-num = <1>;

		clocks = <&aoss_qmp>;
		clock-names = "apb_pclk";
		out-ports {
			port {
				dlct_1_tpdm_pmu_out_tpda_dlct_1_26: endpoint {
					remote-endpoint =
						<&tpda_dlct_1_26_in_dlct_1_tpdm_pmu>;
				};
			};
		};
	};

	dlct_1_tpdm_qrng: tpdm@112c2000 {
		compatible = "qcom,coresight-tpdm","arm,primecell";
		reg = <0x112c2000 0x1000>;

		reg-names = "tpdm-base";
		device-name = "tpdm_qrng";

		qcom,cmb-element-bits = <32>;

		clocks = <&aoss_qmp>;
		clock-names = "apb_pclk";
		out-ports {
			port {
				dlct_1_tpdm_qrng_out_tpda_dlct_1_27: endpoint {
					remote-endpoint =
						<&tpda_dlct_1_27_in_dlct_1_tpdm_qrng>;
				};
			};
		};
	};

	dlmm_tpdm_mm_dsb_tpdm: tpdm@11408000 {
		compatible = "qcom,coresight-tpdm","arm,primecell";
		reg = <0x11408000 0x1000>;

		reg-names = "tpdm-base";
		device-name = "tpdm_dlmm";

		qcom,dsb-element-bits = <32>;
		qcom,dsb-msrs-num = <16>;

		clocks = <&aoss_qmp>;
		clock-names = "apb_pclk";
		status = "disabled";
		out-ports {
			port {
				dlmm_tpdm_mm_dsb_tpdm_out_tpda_dlmm_15: endpoint {
					remote-endpoint =
						<&tpda_dlmm_15_in_dlmm_tpdm_mm_dsb_tpdm>;
				};
			};
		};
	};

	tpda_dlmm: tpda@1140b000 {
		compatible = "qcom,coresight-tpda","arm,primecell";
		reg = <0x1140b000 0x1000>;

		reg-names = "tpda-base";
		device-name = "tpda_dlmm";

		clocks = <&aoss_qmp>;
		clock-names = "apb_pclk";
		status = "disabled";
		in-ports {
			#address-cells = <1>;
			#size-cells = <0>;
			port@0 {
				reg = <0>;
				tpda_dlmm_0_in_video: endpoint {
					remote-endpoint =
						<&video_out_tpda_dlmm_0>;
				};
			};

			port@2 {
				reg = <2>;
				tpda_dlmm_2_in_mdss_dl_funnel: endpoint {
					remote-endpoint =
						<&mdss_dl_funnel_out_tpda_dlmm_2>;
				};
			};

			port@8 {
				reg = <8>;
				tpda_dlmm_8_in_eva: endpoint {
					remote-endpoint =
						<&eva_out_tpda_dlmm_8>;
				};
			};

			port@a {
				reg = <10>;
				tpda_dlmm_10_in_sdcc5_tpdm_sdcc5_wrapper_1: endpoint {
					remote-endpoint =
						<&sdcc5_tpdm_sdcc5_wrapper_1_out_tpda_dlmm_10>;
				};
			};

			port@f {
				reg = <15>;
				tpda_dlmm_15_in_dlmm_tpdm_mm_dsb_tpdm: endpoint {
					remote-endpoint =
						<&dlmm_tpdm_mm_dsb_tpdm_out_tpda_dlmm_15>;
				};
			};
		};

		out-ports {
			port {
				tpda_dlmm_out_dlmm_0: endpoint {
					remote-endpoint =
						<&dlmm_0_in_tpda_dlmm>;
				};
			};
		};
	};

	dlmm: funnel@1140c000 {
		compatible = "arm,coresight-dynamic-funnel","arm,primecell";
		reg = <0x1140c000 0x1000>;

		reg-names = "funnel-base";
		device-name = "funnel_dlmm";

		clocks = <&aoss_qmp>;
		clock-names = "apb_pclk";
		status = "disabled";
		in-ports {
			port@0 {
				dlmm_0_in_tpda_dlmm: endpoint {
					remote-endpoint =
						<&tpda_dlmm_out_dlmm_0>;
				};
			};
		};

		out-ports {
			port {
				dlmm_out_fun_in1_qdss_7: endpoint {
					remote-endpoint =
						<&fun_in1_qdss_7_in_dlmm>;
				};
			};
		};
	};

	sdcc5_tpdm_sdcc5_wrapper_1: tpdm@11420000 {
		compatible = "qcom,coresight-tpdm","arm,primecell";
		reg = <0x11420000 0x1000>;

		reg-names = "tpdm-base";
		device-name = "tpdm_sdcc1";

		qcom,cmb-element-bits = <32>;

		status = "disabled";
		clocks = <&aoss_qmp>;
		clock-names = "apb_pclk";
		out-ports {
			port {
				sdcc5_tpdm_sdcc5_wrapper_1_out_tpda_dlmm_10: endpoint {
					remote-endpoint =
						<&tpda_dlmm_10_in_sdcc5_tpdm_sdcc5_wrapper_1>;
				};
			};
		};
	};

	sdcc5_tpdm_sdcc5_wrapper_2: tpdm@11421000 {
		compatible = "qcom,coresight-tpdm","arm,primecell";
		reg = <0x11421000 0x1000>;

		reg-names = "tpdm-base";
		device-name = "tpdm_sdcc2";

		qcom,cmb-element-bits = <32>;

		clocks = <&aoss_qmp>;
		clock-names = "apb_pclk";
		status = "disabled";
		out-ports {
			port {
				sdcc5_tpdm_sdcc5_wrapper_2_out_tpda_dlct_0_27: endpoint {
					remote-endpoint =
						<&tpda_dlct_0_27_in_sdcc5_tpdm_sdcc5_wrapper_2>;
				};
			};
		};
	};

	dlct_0: funnel@1142d000 {
		compatible = "arm,coresight-dynamic-funnel","arm,primecell";
		reg = <0x1142d000 0x1000>;

		reg-names = "funnel-base";
		device-name = "funnel_dlct0";

		clocks = <&aoss_qmp>;
		clock-names = "apb_pclk";
		in-ports {
			#address-cells = <1>;
			#size-cells = <0>;
			port@0 {
				reg = <0>;
				dlct_0_0_in_tpda_dlct_0: endpoint {
					remote-endpoint =
						<&tpda_dlct_0_out_dlct_0_0>;
				};
			};

			port@2 {
				reg = <2>;
				dlct_0_2_in_dl_0_ddr: endpoint {
					remote-endpoint =
						<&dl_0_ddr_out_dlct_0_2>;
				};
			};

			port@4 {
				reg = <4>;
				dlct_0_4_in_turing_funnel: endpoint {
					remote-endpoint =
						<&turing_funnel_out_dlct_0_4>;
				};
			};
		};

		out-ports {
			port {
				dlct_0_out_fun_in1_qdss_6: endpoint {
					remote-endpoint =
						<&fun_in1_qdss_6_in_dlct_0>;
				};
			};
		};
	};

	dlct_0_tpdm_ipcc_cmb: tpdm@11429000 {
		compatible = "qcom,coresight-tpdm","arm,primecell";
		reg = <0x11429000 0x1000>;

		reg-names = "tpdm-base";
		device-name = "tpdm_ipcc";

		qcom,cmb-element-bits = <64>;
		qcom,cmb-msrs-num = <1>;

		clocks = <&aoss_qmp>;
		clock-names = "apb_pclk";
		out-ports {
			port {
				dlct_0_tpdm_ipcc_cmb_out_tpda_dlct_0_30: endpoint {
					remote-endpoint =
						<&tpda_dlct_0_30_in_dlct_0_tpdm_ipcc_cmb>;
				};
			};
		};
	};

	tpda_dlct_0: tpda@1142c000 {
		compatible = "qcom,coresight-tpda","arm,primecell";
		reg = <0x1142c000 0x1000>;

		reg-names = "tpda-base";
		device-name = "tpda_dlct0";

		clocks = <&aoss_qmp>;
		clock-names = "apb_pclk";
		in-ports {
			#address-cells = <1>;
			#size-cells = <0>;
			port@0 {
				reg = <0>;
				tpda_dlct_0_0_in_lpass_cx_dl: endpoint {
					remote-endpoint =
						<&lpass_cx_dl_out_tpda_dlct_0_0>;
				};
			};

			port@4 {
				reg = <4>;
				tpda_dlct_0_4_in_dl_0_ddr: endpoint {
					remote-endpoint =
						<&dl_0_ddr_out_tpda_dlct_0_4>;
				};
			};

			port@6 {
				reg = <6>;
				tpda_dlct_0_6_in_dl_0_ddr: endpoint {
					remote-endpoint =
						<&dl_0_ddr_out_tpda_dlct_0_6>;
				};
			};

			port@7 {
				reg = <7>;
				tpda_dlct_0_7_in_dl_0_ddr: endpoint {
					remote-endpoint =
						<&dl_0_ddr_out_tpda_dlct_0_7>;
				};
			};

			port@13 {
				reg = <19>;
				tpda_dlct_0_19_in_gpu_dl: endpoint {
					remote-endpoint =
						<&gpu_dl_out_tpda_dlct_0_19>;
				};
			};

			port@16 {
				reg = <22>;
				tpda_dlct_0_22_in_qm_tpdm_qm: endpoint {
					remote-endpoint =
						<&qm_tpdm_qm_out_tpda_dlct_0_22>;
				};
			};

			port@17 {
				reg = <23>;
				tpda_dlct_0_23_in_gcc_tpdm_gcc_dsb: endpoint {
					remote-endpoint =
						<&gcc_tpdm_gcc_dsb_out_tpda_dlct_0_23>;
				};
			};

			port@18 {
				reg = <24>;
				tpda_dlct_0_24_in_vsense_tpdm_vsense: endpoint {
					remote-endpoint =
						<&vsense_tpdm_vsense_out_tpda_dlct_0_24>;
				};
			};

			port@1a {
				reg = <26>;
				tpda_dlct_0_26_in_ipa_tpdm_ipa: endpoint {
					remote-endpoint =
						<&ipa_tpdm_ipa_out_tpda_dlct_0_26>;
				};
			};

			port@1b {
				reg = <27>;
				tpda_dlct_0_27_in_sdcc5_tpdm_sdcc5_wrapper_2: endpoint {
					remote-endpoint =
						<&sdcc5_tpdm_sdcc5_wrapper_2_out_tpda_dlct_0_27>;
				};
			};

			port@1d {
				reg = <29>;
				tpda_dlct_0_29_in_dlct_0_tpdm_dlct_0_dsb: endpoint {
					remote-endpoint =
						<&dlct_0_tpdm_dlct_0_dsb_out_tpda_dlct_0_29>;
				};
			};

			port@1e {
				reg = <30>;
				tpda_dlct_0_30_in_dlct_0_tpdm_ipcc_cmb: endpoint {
					remote-endpoint =
						<&dlct_0_tpdm_ipcc_cmb_out_tpda_dlct_0_30>;
				};
			};
		};

		out-ports {
			port {
				tpda_dlct_0_out_dlct_0_0: endpoint {
					remote-endpoint =
						<&dlct_0_0_in_tpda_dlct_0>;
				};
			};
		};
	};

	dlct_0_tpdm_dlct_0_dsb: tpdm@11428000 {
		compatible = "qcom,coresight-tpdm","arm,primecell";
		reg = <0x11428000 0x1000>;

		reg-names = "tpdm-base";
		device-name = "tpdm_dlct0_dsb";

		qcom,dsb-element-bits = <32>;
		qcom,dsb-msrs-num = <32>;

		clocks = <&aoss_qmp>;
		clock-names = "apb_pclk";
		out-ports {
			port {
				dlct_0_tpdm_dlct_0_dsb_out_tpda_dlct_0_29: endpoint {
					remote-endpoint =
						<&tpda_dlct_0_29_in_dlct_0_tpdm_dlct_0_dsb>;
				};
			};
		};
	};

	tpda_pcie_rscc_crm: tpda@11471000 {
		compatible = "qcom,coresight-tpda","arm,primecell";
		reg = <0x11471000 0x1000>;

		reg-names = "tpda-base";
		device-name = "tpda_pcie";

		status = "disabled";
		clocks = <&aoss_qmp>;
		clock-names = "apb_pclk";
		in-ports {
			port@0 {
				tpda_pcie_rscc_crm_0_in_pcie_rscc_tpdm_pcie_rscc_crm: endpoint {
					remote-endpoint =
						<&pcie_rscc_tpdm_pcie_rscc_crm_out_tpda_pcie_rscc_crm_0>;
				};
			};
		};

		out-ports {
			port {
				tpda_pcie_rscc_crm_out_fun_in0_qdss_5: endpoint {
					remote-endpoint =
						<&fun_in0_qdss_5_in_tpda_pcie_rscc_crm>;
				};
			};
		};
	};

	pcie_rscc_tpdm_pcie_rscc_crm: tpdm@11470000 {
		compatible = "qcom,coresight-tpdm","arm,primecell";
		reg = <0x11470000 0x1000>;

		reg-names = "tpdm-base";
		device-name = "tpdm_pcie";

		qcom,cmb-element-bits = <32>;

		clocks = <&aoss_qmp>;
		clock-names = "apb_pclk";

		status = "disabled";
		out-ports {
			port {
				pcie_rscc_tpdm_pcie_rscc_crm_out_tpda_pcie_rscc_crm_0: endpoint {
					remote-endpoint =
						<&tpda_pcie_rscc_crm_0_in_pcie_rscc_tpdm_pcie_rscc_crm>;
				};
			};
		};
	};

	tpda_tme: tpda@114c5000 {
		compatible = "qcom,coresight-tpda","arm,primecell";
		reg = <0x114c5000 0x1000>;

		reg-names = "tpda-base";
		device-name = "tpda_tme";
		clocks = <&aoss_qmp>;
		clock-names = "apb_pclk";

		status = "disabled";
		in-ports {
			#address-cells = <1>;
			#size-cells = <0>;
			port@2 {
				reg = <2>;
				tpda_tme_2_in_tmess_tpdm_rvss_e21_cmb: endpoint {
					remote-endpoint =
						<&tmess_tpdm_rvss_e21_cmb_out_tpda_tme_2>;
				};
			};

			port@3 {
				reg = <3>;
				tpda_tme_3_in_tmess_tpdm_qrng_cmb: endpoint {
					remote-endpoint =
						<&tmess_tpdm_qrng_cmb_out_tpda_tme_3>;
				};
			};

			port@4 {
				reg = <4>;
				tpda_tme_4_in_tmess_tpdm_dl_cmb_dsb: endpoint {
					remote-endpoint =
						<&tmess_tpdm_dl_cmb_dsb_out_tpda_tme_4>;
				};
			};
		};

		out-ports {
			port {
				tpda_tme_out_tme_0: endpoint {
					remote-endpoint =
						<&tme_0_in_tpda_tme>;
				};
			};
		};
	};

	tmess_tpdm_rvss_e21_cmb: tpdm@114c0000 {
		compatible = "qcom,coresight-tpdm","arm,primecell";
		reg = <0x114c0000 0x1000>;

		reg-names = "tpdm-base";
		device-name = "tpdm_tmess_rvss";

		qcom,cmb-element-bits = <32>;
		qcom,cmb-msrs-num = <12>;

		clocks = <&aoss_qmp>;
		clock-names = "apb_pclk";

		qcom,hw-enable-check;
		status = "disabled";
		out-ports {
			port {
				tmess_tpdm_rvss_e21_cmb_out_tpda_tme_2: endpoint {
					remote-endpoint =
						<&tpda_tme_2_in_tmess_tpdm_rvss_e21_cmb>;
				};
			};
		};
	};

	tmess_tpdm_qrng_cmb: tpdm@114c1000 {
		compatible = "qcom,coresight-tpdm","arm,primecell";
		reg = <0x114c1000 0x1000>;

		reg-names = "tpdm-base";
		device-name = "tpdm_tmess_qrng";

		qcom,cmb-element-bits = <32>;

		clocks = <&aoss_qmp>;
		clock-names = "apb_pclk";

		status = "disabled";

		qcom,hw-enable-check;
		out-ports {
			port {
				tmess_tpdm_qrng_cmb_out_tpda_tme_3: endpoint {
					remote-endpoint =
						<&tpda_tme_3_in_tmess_tpdm_qrng_cmb>;
				};
			};
		};
	};

	tmess_tpdm_dl_cmb_dsb: tpdm@114c2000 {
		compatible = "qcom,coresight-tpdm","arm,primecell";
		reg = <0x114c2000 0x1000>;

		reg-names = "tpdm-base";
		device-name = "tpdm_tmess_dl";

		qcom,cmb-element-bits = <64>;
		qcom,dsb-element-bits = <64>;
		qcom,dsb-msrs-num = <32>;
		qcom,cmb-msrs-num = <1>;
		qcom,hw-enable-check;

		clocks = <&aoss_qmp>;
		clock-names = "apb_pclk";
		status = "disabled";
		out-ports {
			port {
				tmess_tpdm_dl_cmb_dsb_out_tpda_tme_4: endpoint {
					remote-endpoint =
						<&tpda_tme_4_in_tmess_tpdm_dl_cmb_dsb>;
				};
			};
		};
	};

	tme: funnel@114c6000 {
		compatible = "arm,coresight-dynamic-funnel","arm,primecell";
		reg = <0x114c6000 0x1000>;

		reg-names = "funnel-base";
		device-name = "funnel_tme";

		clocks = <&aoss_qmp>;
		clock-names = "apb_pclk";
		status = "disabled";
		in-ports {
			port@0 {
				tme_0_in_tpda_tme: endpoint {
					remote-endpoint =
						<&tpda_tme_out_tme_0>;
				};
			};
		};

		out-ports {
			port {
				tme_out_fun_in1_qdss_0: endpoint {
					remote-endpoint =
						<&fun_in1_qdss_0_in_tme>;
				};
			};
		};
	};

	qdss_tpdm_dcc: tpdm@10003000 {
		compatible = "arm,primecell";
		arm,primecell-periphid = <0x000f0e00>;
		reg = <0x10003000 0x1000>;

		reg-names = "tpdm-base";
		device-name = "tpdm_dcc";

		qcom,cmb-element-bits = <32>;

		clocks = <&aoss_qmp>;
		clock-names = "apb_pclk";
		qcom,hw-enable-check;
		out-ports {
			port {
				qdss_tpdm_dcc_out_tpda_qdss_0: endpoint {
					remote-endpoint =
						<&tpda_qdss_0_in_qdss_tpdm_dcc>;
				};
			};
		};
	};

	qdss_tpdm_spdm_cmb: tpdm@1000f000 {
		compatible = "qcom,coresight-tpdm","arm,primecell";
		reg = <0x1000f000 0x1000>;

		reg-names = "tpdm-base";
		device-name = "tpdm_spdm";

		qcom,cmb-element-bits = <32>;
		clocks = <&aoss_qmp>;
		clock-names = "apb_pclk";
		out-ports {
			port {
				qdss_tpdm_spdm_cmb_out_tpda_qdss_1: endpoint {
					remote-endpoint =
						<&tpda_qdss_1_in_qdss_tpdm_spdm_cmb>;
				};
			};
		};
	};

	tpda_qdss: tpda@10004000 {
		compatible = "qcom,coresight-tpda","arm,primecell";
		reg = <0x10004000 0x1000>;

		reg-names = "tpda-base";
		device-name = "tpda_qdss";

		clocks = <&aoss_qmp>;
		clock-names = "apb_pclk";
		in-ports {
			#address-cells = <1>;
			#size-cells = <0>;
			port@0 {
				reg = <0>;
				tpda_qdss_0_in_qdss_tpdm_dcc: endpoint {
					remote-endpoint =
						<&qdss_tpdm_dcc_out_tpda_qdss_0>;
				};
			};

			port@1 {
				reg = <1>;
				tpda_qdss_1_in_qdss_tpdm_spdm_cmb: endpoint {
					remote-endpoint =
						<&qdss_tpdm_spdm_cmb_out_tpda_qdss_1>;
				};
			};
		};

		out-ports {
			port {
				tpda_qdss_out_fun_in0_qdss_6: endpoint {
					remote-endpoint =
						<&fun_in0_qdss_6_in_tpda_qdss>;
				};
			};
		};
	};

	fun_in0_qdss: funnel@10041000 {
		compatible = "arm,coresight-dynamic-funnel","arm,primecell";
		reg = <0x10041000 0x1000>;

		reg-names = "funnel-base";
		device-name = "funnel_fun_in0";

		clocks = <&aoss_qmp>;
		clock-names = "apb_pclk";
		in-ports {
			#address-cells = <1>;
			#size-cells = <0>;
			port@5 {
				reg = <5>;
				fun_in0_qdss_5_in_tpda_pcie_rscc_crm: endpoint {
					remote-endpoint =
						<&tpda_pcie_rscc_crm_out_fun_in0_qdss_5>;
				};
			};

			port@6 {
				reg = <6>;
				fun_in0_qdss_6_in_tpda_qdss: endpoint {
					remote-endpoint =
						<&tpda_qdss_out_fun_in0_qdss_6>;
				};
			};

			port@7 {
				reg = <7>;
				fun_in0_qdss_7_in_qdss_atb_stm_ss: endpoint {
					remote-endpoint =
						<&qdss_atb_stm_ss_out_fun_in0_qdss_7>;
				};
			};
		};

		out-ports {
			port {
				fun_in0_qdss_out_merge_funnel_qdss_0: endpoint {
					remote-endpoint =
						<&merge_funnel_qdss_0_in_fun_in0_qdss>;
				};
			};
		};
	};

	qdss_atb_stm_ss:stm@10002000 {
		compatible = "arm,coresight-stm", "arm,primecell";
		reg = <0x10002000 0x1000>,
			<0x16280000 0x180000>;
		reg-names = "stm-base", "stm-stimulus-base";
		atid = <16>;

		clocks = <&aoss_qmp>;
		clock-names = "apb_pclk";
		out-ports {
			port {
				qdss_atb_stm_ss_out_fun_in0_qdss_7: endpoint {
					remote-endpoint =
						<&fun_in0_qdss_7_in_qdss_atb_stm_ss>;
				};
			};
		};
	};

	merge_funnel_qdss: funnel@10045000 {
		compatible = "arm,coresight-dynamic-funnel","arm,primecell";
		reg = <0x10045000 0x1000>;

		reg-names = "funnel-base";
		device-name = "funnel_merge";

		clocks = <&aoss_qmp>;
		clock-names = "apb_pclk";
		in-ports {
			#address-cells = <1>;
			#size-cells = <0>;
			port@0 {
				reg = <0>;
				merge_funnel_qdss_0_in_fun_in0_qdss: endpoint {
					remote-endpoint =
						<&fun_in0_qdss_out_merge_funnel_qdss_0>;
				};
			};

			port@1 {
				reg = <1>;
				merge_funnel_qdss_1_in_fun_in1_qdss: endpoint {
					remote-endpoint =
						<&fun_in1_qdss_out_merge_funnel_qdss_1>;
				};
			};
		};

		out-ports {
			port {
				merge_funnel_qdss_out_aoss_7: endpoint {
					remote-endpoint =
						<&aoss_7_in_merge_funnel_qdss>;
				};
			};
		};
	};

	fun_in1_qdss: funnel@10042000 {
		compatible = "arm,coresight-dynamic-funnel","arm,primecell";
		reg = <0x10042000 0x1000>;

		reg-names = "funnel-base";
		device-name = "funnel_fun_in1";

		clocks = <&aoss_qmp>;
		clock-names = "apb_pclk";
		in-ports {
			#address-cells = <1>;
			#size-cells = <0>;

			port@0 {
				reg = <0>;
				fun_in1_qdss_0_in_tme: endpoint {
					remote-endpoint =
						<&tme_out_fun_in1_qdss_0>;
				};
			};

			port@1 {
				reg = <1>;
				fun_in1_qdss_1_in_dl_west: endpoint {
					remote-endpoint =
						<&dl_west_out_fun_in1_qdss_1>;
				};
			};

			port@4 {
				reg = <4>;
				fun_in1_qdss_4_in_top_apss: endpoint {
					remote-endpoint =
						<&top_apss_out_fun_in1_qdss_4>;
				};
			};

			port@5 {
				reg = <5>;
				fun_in1_qdss_5_in_dlct_1: endpoint {
					remote-endpoint =
						<&dlct_1_out_fun_in1_qdss_5>;
				};
			};

			port@6 {
				reg = <6>;
				fun_in1_qdss_6_in_dlct_0: endpoint {
					remote-endpoint =
						<&dlct_0_out_fun_in1_qdss_6>;
				};
			};

			port@7 {
				reg = <7>;
				fun_in1_qdss_7_in_dlmm: endpoint {
					remote-endpoint =
						<&dlmm_out_fun_in1_qdss_7>;
				};
			};
		};

		out-ports {
			port {
				fun_in1_qdss_out_merge_funnel_qdss_1: endpoint {
					remote-endpoint =
						<&merge_funnel_qdss_1_in_fun_in1_qdss>;
				};
			};
		};
	};

	qdss_repl: replicator@10046000 {
		compatible = "arm,primecell";
		arm,primecell-periphid = <0x000bb909>;
		reg = <0x10046000 0x1000>;
		reg-names = "replicator-base";

		device-name = "replicator_qdss";

		clocks = <&aoss_qmp>;
		clock-names = "apb_pclk";
		in-ports {
			port {
				qdss_repl_in_swao_repl_0: endpoint {
					remote-endpoint =
						<&swao_repl_0_out_qdss_repl>;
				};
			};
		};

		out-ports {
			port@0 {
				qdss_repl_0_out_etr_repl: endpoint {
					remote-endpoint =
						<&etr_repl_in_qdss_repl_0>;
				};
			};
		};
	};

	replicator_etr: replicator@1004e000 {
		compatible = "arm,primecell";
		arm,primecell-periphid = <0x000bb909>;
		reg = <0x1004e000 0x1000>;
		reg-names = "replicator-base";

		device-name = "replicator_etr";

		clocks = <&aoss_qmp>;
		clock-names = "apb_pclk";

		in-ports {
			port {
				etr_repl_in_qdss_repl_0: endpoint {
					remote-endpoint =
					<&qdss_repl_0_out_etr_repl>;
				};
			};
		};

		out-ports {
			#address-cells = <1>;
			#size-cells = <0>;

			port@0 {
				reg = <0>;
				replicator_etr_out_tmc_etr: endpoint {
					remote-endpoint =
					<&tmc_etr_in_replicator_etr>;
				};
			};

			port@1 {
				reg = <1>;
				replicator_etr_out_tmc_etr1: endpoint {
					remote-endpoint =
					<&tmc_etr1_in_replicator_etr>;
				};
			};
		};
	};

	tmc_etr: tmc@10048000 {
		compatible = "arm,coresight-tmc", "arm,primecell";
		reg = <0x10048000 0x1000>;
		reg-names = "tmc-base";

		device-name = "tmc_etr0";

		qcom,iommu-dma = "bypass";
		iommus = <&apps_smmu 0x00e0 0x20>;
		dma-coherent;
		arm,scatter-gather;

		qcom,sw-usb;
		coresight-csr = <&csr>;
		csr-atid-offset = <0xf8>;
		csr-irqctrl-offset = <0x6c>;
		byte-cntr-name = "byte-cntr";
		byte-cntr-class-name = "coresight-tmc-etr-stream";
		interrupts = <GIC_SPI 270 IRQ_TYPE_EDGE_RISING>;
		interrupt-names = "byte-cntr-irq";

		clocks = <&aoss_qmp>;
		clock-names = "apb_pclk";

		in-ports {
			port {
				tmc_etr_in_replicator_etr: endpoint {
					remote-endpoint =
					<&replicator_etr_out_tmc_etr>;
				};
			};
		};
	};

	tmc_etr1: tmc@1004f000 {
		compatible = "arm,coresight-tmc", "arm,primecell";
		reg = <0x1004f000 0x1000>;
		reg-names = "tmc-base";

		device-name = "tmc_etr1";

		iommus = <&apps_smmu 0x0100 0x0>;
		memory-region = <&tmc_etr1_region>;
		dma-coherent;
		arm,scatter-gather;

		qcom,iommu-dma = "bypass";
		coresight-csr = <&csr>;
		csr-atid-offset = <0x108>;
		csr-irqctrl-offset = <0x70>;
		byte-cntr-name = "byte-cntr1";
		byte-cntr-class-name = "coresight-tmc-etr1-stream";
		interrupts = <GIC_SPI 269 IRQ_TYPE_EDGE_RISING>;
		interrupt-names = "byte-cntr-irq";

		clocks = <&aoss_qmp>;
		clock-names = "apb_pclk";

		in-ports {
			port {
				tmc_etr1_in_replicator_etr: endpoint {
					remote-endpoint =
					<&replicator_etr_out_tmc_etr1>;
				};
			};
		};

		tmc_etr1_region: tmc_etr1_region {
			iommu-addresses = <&tmc_etr1 0x1 0x0 0xfe 0x0>;
		};
	};


	tpda_aoss: tpda@11308000 {
		compatible = "qcom,coresight-tpda","arm,primecell";
		reg = <0x11308000 0x1000>;

		reg-names = "tpda-base";
		device-name = "tpda_aoss";

		clocks = <&aoss_qmp>;
		clock-names = "apb_pclk";
		in-ports {
			#address-cells = <1>;
			#size-cells = <0>;

			port@0 {
				reg = <0>;
				tpda_aoss_0_in_aoss_tpdm_swao_cmb_0: endpoint {
					remote-endpoint =
						<&aoss_tpdm_swao_cmb_0_out_tpda_aoss_0>;
				};
			};

			port@1 {
				reg = <1>;
				tpda_aoss_1_in_aoss_tpdm_swao_cmb_1: endpoint {
					remote-endpoint =
						<&aoss_tpdm_swao_cmb_1_out_tpda_aoss_1>;
				};
			};

			port@2 {
				reg = <2>;
				tpda_aoss_2_in_aoss_tpdm_swao_cmb_2: endpoint {
					remote-endpoint =
						<&aoss_tpdm_swao_cmb_2_out_tpda_aoss_2>;
				};
			};

			port@3 {
				reg = <3>;
				tpda_aoss_3_in_aoss_tpdm_swao_cmb_3: endpoint {
					remote-endpoint =
						<&aoss_tpdm_swao_cmb_3_out_tpda_aoss_3>;
				};
			};

			port@4 {
				reg = <4>;
				tpda_aoss_4_in_aoss_tpdm_swao_dsb: endpoint {
					remote-endpoint =
						<&aoss_tpdm_swao_dsb_out_tpda_aoss_4>;
				};
			};
		};

		out-ports {
			port {
				tpda_aoss_out_aoss_6: endpoint {
					remote-endpoint =
						<&aoss_6_in_tpda_aoss>;
				};
			};
		};
	};

	aoss_tpdm_swao_cmb_0: tpdm@11309000 {
		compatible = "qcom,coresight-tpdm","arm,primecell";
		reg = <0x11309000 0x1000>;

		reg-names = "tpdm-base";
		device-name = "tpdm_swao_prio_0";

		qcom,cmb-element-bits = <64>;
		clocks = <&aoss_qmp>;
		clock-names = "apb_pclk";
		out-ports {
			port {
				aoss_tpdm_swao_cmb_0_out_tpda_aoss_0: endpoint {
					remote-endpoint =
						<&tpda_aoss_0_in_aoss_tpdm_swao_cmb_0>;
				};
			};
		};
	};

	aoss_tpdm_swao_cmb_1: tpdm@1130a000 {
		compatible = "qcom,coresight-tpdm","arm,primecell";
		reg = <0x1130a000 0x1000>;

		reg-names = "tpdm-base";
		device-name = "tpdm_swao_prio_1";

		qcom,cmb-element-bits = <64>;
		clocks = <&aoss_qmp>;
		clock-names = "apb_pclk";
		out-ports {
			port {
				aoss_tpdm_swao_cmb_1_out_tpda_aoss_1: endpoint {
					remote-endpoint =
						<&tpda_aoss_1_in_aoss_tpdm_swao_cmb_1>;
				};
			};
		};
	};

	aoss_tpdm_swao_cmb_2: tpdm@1130b000 {
		compatible = "qcom,coresight-tpdm","arm,primecell";
		reg = <0x1130b000 0x1000>;

		reg-names = "tpdm-base";
		device-name = "tpdm_swao_prio_2";

		qcom,cmb-element-bits = <64>;
		clocks = <&aoss_qmp>;
		clock-names = "apb_pclk";
		out-ports {
			port {
				aoss_tpdm_swao_cmb_2_out_tpda_aoss_2: endpoint {
					remote-endpoint =
						<&tpda_aoss_2_in_aoss_tpdm_swao_cmb_2>;
				};
			};
		};
	};

	aoss_tpdm_swao_cmb_3: tpdm@1130c000 {
		compatible = "qcom,coresight-tpdm","arm,primecell";
		reg = <0x1130c000 0x1000>;

		reg-names = "tpdm-base";
		device-name = "tpdm_swao_prio_3";

		qcom,cmb-element-bits = <64>;
		clocks = <&aoss_qmp>;
		clock-names = "apb_pclk";
		out-ports {
			port {
				aoss_tpdm_swao_cmb_3_out_tpda_aoss_3: endpoint {
					remote-endpoint =
						<&tpda_aoss_3_in_aoss_tpdm_swao_cmb_3>;
				};
			};
		};
	};

	aoss_tpdm_swao_dsb: tpdm@1130d000 {
		compatible = "qcom,coresight-tpdm","arm,primecell";
		reg = <0x1130d000 0x1000>;

		reg-names = "tpdm-base";
		device-name = "tpdm_swao";

		qcom,dsb-element-bits = <32>;
		qcom,dsb-msrs-num = <32>;
		clocks = <&aoss_qmp>;
		clock-names = "apb_pclk";
		out-ports {
			port {
				aoss_tpdm_swao_dsb_out_tpda_aoss_4: endpoint {
					remote-endpoint =
						<&tpda_aoss_4_in_aoss_tpdm_swao_dsb>;
				};
			};
		};
	};

	aoss: funnel@11304000 {
		compatible = "arm,coresight-dynamic-funnel","arm,primecell";
		reg = <0x11304000 0x1000>;

		reg-names = "funnel-base";
		device-name = "funnel_aoss";

		clocks = <&aoss_qmp>;
		clock-names = "apb_pclk";

		in-ports {
			#address-cells = <1>;
			#size-cells = <0>;

			port@3 {
				reg = <3>;
				aoss_3_in_ddr_lpi_funnel: endpoint {
					remote-endpoint =
						<&ddr_lpi_funnel_out_aoss_3>;
				};
			};

			port@5 {
				reg = <5>;
				funnel_aoss_in_funnel_lpass_lpi_2: endpoint {
					remote-endpoint =
						<&funnel_lpass_lpi_2_out_funnel_aoss>;
				};
			};

			port@6 {
				reg = <6>;
				aoss_6_in_tpda_aoss: endpoint {
					remote-endpoint =
						<&tpda_aoss_out_aoss_6>;
				};
			};

			port@7 {
				reg = <7>;
				aoss_7_in_merge_funnel_qdss: endpoint {
					remote-endpoint =
						<&merge_funnel_qdss_out_aoss_7>;
				};
			};
		};

		out-ports {
			port {
				aoss_out_etf_0: endpoint {
					remote-endpoint =
						<&etf_0_in_aoss>;
				};
			};
		};
	};

	etf: tmc@11305000 {
		compatible = "arm,coresight-tmc","arm,primecell";
		reg = <0x11305000 0x1000>;

		reg-names = "tmc-base";

		clocks = <&aoss_qmp>;
		clock-names = "apb_pclk";
		in-ports {
			port@0 {
				etf_0_in_aoss: endpoint {
					remote-endpoint =
						<&aoss_out_etf_0>;
				};
			};
		};

		out-ports {
			port {
				etf_out_swao_repl: endpoint {
					remote-endpoint =
						<&swao_repl_in_etf>;
				};
			};
		};
	};

	swao_repl: replicator@11306000 {
		compatible = "arm,primecell";
		arm,primecell-periphid = <0x000bb909>;
		reg = <0x11306000 0x1000>;
		reg-names = "replicator-base";

		device-name = "replicator_swao";

		qcom,replicator-loses-context;
		clocks = <&aoss_qmp>;
		clock-names = "apb_pclk";

		in-ports {
			port {
				swao_repl_in_etf: endpoint {
					remote-endpoint =
						<&etf_out_swao_repl>;
				};
			};
		};

		out-ports {
			#address-cells = <1>;
			#size-cells = <0>;
			port@0 {
				reg = <0>;
				swao_repl_0_out_qdss_repl: endpoint {
					remote-endpoint =
						<&qdss_repl_in_swao_repl_0>;
				};
			};

			port@1 {
				reg = <1>;
				swao_repl_1_out_eud: endpoint {
					remote-endpoint =
						<&eud_in_swao_repl_1>;
				};
			};
		};
	};

	dummy_eud: dummy-eud {
		compatible = "arm,coresight-dummy-sink";

		device-name = "eud";

		in-ports {
			port {
				eud_in_swao_repl_1: endpoint {
					remote-endpoint =
						<&swao_repl_1_out_eud>;
				};
			};
		};
	};


	tpdm_turing: tpdm@11180000 {
		compatible = "qcom,coresight-tpdm", "arm,primecell";
		reg = <0x11180000 0x1000>;
		reg-names = "tpdm-base";
		qcom,dsb-element-bits = <32>;
		qcom,dsb-msrs-num = <16>;

		device-name = "tpdm_turing_dsb";
		clocks = <&aoss_qmp>;
		clock-names = "apb_pclk";

		out-ports {
			port {
				tpdm_turing_dsb_out_tpda_turing: endpoint {
					remote-endpoint =
					<&tpda_turing_in_tpdm_turing_dsb>;
				};
			};
		};
	};

	tpdm_turing_llm: tpdm@11181000 {
		compatible = "qcom,coresight-static-tpdm";
		device-name = "tpdm_turing_llm";
		qcom,cmb-element-bits = <32>;
		qcom,dsb-msrs-num = <12>;
		out-ports {
			port {
				tpdm_turing_llm_out_tpda_turing: endpoint {
					remote-endpoint =
					<&tpda_turing_in_tpdm_turing_llm>;
				};
			};
		};
	};

	tpdm_turing_llm2: tpdm@11182000 {
		compatible = "qcom,coresight-static-tpdm";
		device-name = "tpdm_turing_llm2";
		qcom,cmb-element-bits = <32>;
		out-ports {
			port {
				tpdm_turing_llm2_out_tpda_turing: endpoint {
					remote-endpoint =
					<&tpda_turing_in_tpdm_turing_llm2>;
				};
			};
		};
	};

	tpdm_turing_cmsr1: tpdm@11183000 {
		compatible = "qcom,coresight-static-tpdm";
		qcom,dsb-element-bits = <32>;
		qcom,cmb-element-bits = <32>;

		device-name = "tpdm_turing_cmsr1";

		out-ports {
			port {
				tpdm_turing_cmsr1_out_tpda_turing: endpoint {
					remote-endpoint =
					<&tpda_turing_in_tpdm_turing_cmsr1>;
				};
			};
		};
	};

	tpdm_turing_cmsr2: tpdm@11184000 {
		compatible = "qcom,coresight-static-tpdm";
		qcom,dsb-element-bits = <32>;
		qcom,cmb-element-bits = <32>;

		device-name = "tpdm_turing_cmsr2";

		out-ports {
			port {
				tpdm_turing_cmsr2_out_tpda_turing: endpoint {
					remote-endpoint =
					<&tpda_turing_in_tpdm_turing_cmsr2>;
				};
			};
		};
	};

	tpdm_turing_dpm1: tpdm@11185000 {
		compatible = "qcom,coresight-static-tpdm";
		qcom,cmb-element-bits = <64>;

		device-name = "tpdm_turing_dpm1";

		out-ports {
			port {
				tpdm_turing_dpm1_out_tpda_turing: endpoint {
					remote-endpoint =
					<&tpda_turing_in_tpdm_turing_dpm1>;
				};
			};
		};
	};

	tpdm_turing_dpm2: tpdm@11186000 {
		compatible = "qcom,coresight-static-tpdm";
		qcom,cmb-element-bits = <64>;

		device-name = "tpdm_turing_dpm2";

		out-ports {
			port {
				tpdm_turing_dpm2_out_tpda_turing: endpoint {
					remote-endpoint =
					<&tpda_turing_in_tpdm_turing_dpm2>;
				};
			};
		};
	};

	tpda_turing: tpda@11188000 {
		compatible = "qcom,coresight-tpda", "arm,primecell";
		reg = <0x11188000 0x1000>;
		reg-names = "tpda-base";

		device-name = "tpda_turing";

		clocks = <&aoss_qmp>;
		clock-names = "apb_pclk";
		in-ports {
			#address-cells = <1>;
			#size-cells = <0>;

			port@0 {
				reg = <0>;
				tpda_turing_in_tpdm_turing_dsb: endpoint {
					remote-endpoint =
					<&tpdm_turing_dsb_out_tpda_turing>;
				};
			};

			port@1 {
				reg = <1>;
				tpda_turing_in_tpdm_turing_llm: endpoint {
					remote-endpoint =
					<&tpdm_turing_llm_out_tpda_turing>;
				};
			};

			port@2 {
				reg = <2>;
				tpda_turing_in_tpdm_turing_llm2: endpoint {
					remote-endpoint =
					<&tpdm_turing_llm2_out_tpda_turing>;
				};
			};

			port@3 {
				reg = <3>;
				tpda_turing_in_tpdm_turing_cmsr1: endpoint {
					remote-endpoint =
					<&tpdm_turing_cmsr1_out_tpda_turing>;
				};
			};

			port@4 {
				reg = <4>;
				tpda_turing_in_tpdm_turing_cmsr2: endpoint {
					remote-endpoint =
					<&tpdm_turing_cmsr2_out_tpda_turing>;
				};
			};

			port@5 {
				reg = <5>;
				tpda_turing_in_tpdm_turing_dpm1: endpoint {
					remote-endpoint =
					<&tpdm_turing_dpm1_out_tpda_turing>;
				};
			};

			port@6 {
				reg = <6>;
				tpda_turing_in_tpdm_turing_dpm2: endpoint {
					remote-endpoint =
					<&tpdm_turing_dpm2_out_tpda_turing>;
				};
			};
		};

		out-ports {
			port@0 {
				tpda_turing_out_funnel_turing: endpoint {
					remote-endpoint =
					<&funnel_turing_in_tpda_turing>;
				};
			};
		};
	};

	turing_etm0: turing-etm0 {
		compatible = "qcom,coresight-remote-etm";

		device-name = "turing_etm0";

		qcom,atid-num = <2>;
		atid = <38 39>;
		trace-name = "turing-etm0";

		out-ports {
			#address-cells = <1>;
			#size-cells = <0>;
			port@0 {
				reg = <0>;
				turing_etm0_out_funnel_turing_dup: endpoint {
					remote-endpoint =
						<&funnel_turing_dup_in_turing_etm0>;
				};
			};

			port@1 {
				reg = <1>;
				turing_etm0_out_qmi: endpoint {
					remote-endpoint =
						<&qmi_in_turing_etm0>;
				};
			};
		};
	};

	turing-qmi {
		compatible = "qcom,coresight-qmi";

		device-name = "qmi_turing";
		qcom,inst-id = <13>;

		in-ports {
			port {
				qmi_in_turing_etm0: endpoint {
					remote-endpoint =
						<&turing_etm0_out_qmi>;
				};
			};
		};
	};

	funnel_turing_dup1: funnel@1118a000 {
		compatible = "arm,primecell";
		arm,primecell-periphid = <0x000bb908>;
		reg = <0x1118a000 0x1000>,
			<0x11189000 0x1000>;
		reg-names = "funnel-base-dummy", "funnel-base-real";

		device-name = "funnel_turing_dup1";

		qcom,duplicate-funnel;
		clocks = <&aoss_qmp>;
		clock-names = "apb_pclk";

		in-ports {
			#address-cells = <1>;
			#size-cells = <0>;
			port@3 {
				reg = <3>;
				funnel_turing_dup_in_turing_etm0: endpoint {
					remote-endpoint =
					<&turing_etm0_out_funnel_turing_dup>;
				};
			};
		};

		out-ports {
			port {
				funnel_turing_dup_out_funnel_turing: endpoint {
					remote-endpoint =
					<&funnel_turing_in_funnel_turing_dup>;
				};
			};
		};
	};


	funnel_turing: funnel@11189000 {
		compatible = "arm,coresight-dynamic-funnel", "arm,primecell";
		reg = <0x11189000 0x1000>;
		reg-names = "funnel-base";

		device-name = "funnel_turing";

		clocks = <&aoss_qmp>;
		clock-names = "apb_pclk";
		in-ports {
			#address-cells = <1>;
			#size-cells = <0>;

			port@0 {
				reg = <0>;
				funnel_turing_in_tpda_turing: endpoint {
					remote-endpoint =
					<&tpda_turing_out_funnel_turing>;
				};
			};

			port@4 {
				reg = <4>;
				funnel_turing_in_funnel_turing_dup: endpoint {
					remote-endpoint =
					<&funnel_turing_dup_out_funnel_turing>;
				};
			};
		};

		out-ports {
			port@0 {
				turing_funnel_out_dlct_0_4: endpoint {
					remote-endpoint =
					<&dlct_0_4_in_turing_funnel>;
				};
			};
		};
	};

	tpdm_lpass_lpi: tpdm@11350000 {
		compatible = "arm,coresight-dummy-source";
		device-name = "tpdm_lpass_lpi";

		trace-name = "tpda-lpass-lpi";
		out-ports {
			#address-cells = <1>;
			#size-cells = <0>;
			port@0 {
				reg = <0>;
				tpdm_lpass_lpi_out_lpass_lpi_funnel1_1: endpoint {
					remote-endpoint =
					<&lpass_lpi_funnel1_1_in_tpdm_lpass_lpi>;
				};
			};

			port@1 {
				reg = <1>;
				lpass_lpi_out_qmi: endpoint {
					remote-endpoint =
					<&qmi_in_lpass_lpi>;
				};
			};
		};
	};

	lpass_lpi_funnel1: funnel@11350000 {
		compatible = "arm,coresight-static-funnel";

		device-name = "funnel_lpass_lpi_1";

		in-ports {
			#address-cells = <1>;
			#size-cells = <0>;

			port@0 {
				reg = <0>;
				lpass_lpi_funnel1_1_in_lpass_stm: endpoint {
					remote-endpoint =
						<&lpass_stm_out_lpass_lpi_funnel1_1>;
				};
			};

			port@1 {
				reg = <1>;
				lpass_lpi_funnel1_1_in_tpdm_lpass_lpi: endpoint {
					remote-endpoint =
						<&tpdm_lpass_lpi_out_lpass_lpi_funnel1_1>;
				};
			};

			port@4 {
				reg = <4>;
				lpass_lpi_funnel1_4_in_tpdm_rscc: endpoint {
					remote-endpoint =
						<&tpdm_rscc_out_lpass_lpi_funnel1_4>;
				};
			};

			port@5 {
				reg = <5>;
				lpass_lpi_funnel1_5_in_tpdm_audio: endpoint {
					remote-endpoint =
						<&tpdm_audio_out_lpass_lpi_funnel1_5>;
				};
			};

		};

		out-ports {
			port {
				funnel_lpass_lpi_1_out_funnel_lpass_lpi_0: endpoint {
					remote-endpoint =
					<&funnel_lpass_lpi_0_in_funnel_lpass_lpi_1>;
				};
			};
		};
	};

	lpass_stm: lpass-stm {
		compatible = "arm,coresight-dummy-source";
		device-name = "lpass_stm";
		trace-name = "lpass-stm";
		atid = <25>;

		out-ports {
			#address-cells = <1>;
			#size-cells = <0>;

			port@0 {
				reg = <0>;
				lpass_stm_out_lpass_lpi_funnel1_1: endpoint {
					remote-endpoint =
					<&lpass_lpi_funnel1_1_in_lpass_stm>;
				};
			};

			port@1 {
				reg = <1>;
				lpass_stm_out_qmi: endpoint {
					remote-endpoint =
					<&qmi_in_lpass_stm>;
				};
			};
		};
	};

	audio-qmi {
		compatible = "qcom,coresight-qmi";

		device-name = "coresight-qmi-auido";
		qcom,inst-id = <5>;

		in-ports {
			#address-cells = <1>;
			#size-cells = <0>;

			port@0 {
				reg = <0>;
				qmi_in_audio_etm0: endpoint {
					remote-endpoint =
						<&audio_etm0_out_qmi>;
				};
			};

			port@1 {
				reg = <1>;
				qmi_in_lpass_stm: endpoint {
					remote-endpoint =
						<&lpass_stm_out_qmi>;
				};
			};

			port@2 {
				reg = <2>;
				qmi_in_lpass_lpi: endpoint {
					remote-endpoint =
						<&lpass_lpi_out_qmi>;
				};
			};

			port@3 {
				reg = <3>;
				qmi_in_lpass_rscc: endpoint {
					remote-endpoint =
						<&lpass_rscc_out_qmi>;
				};
			};

			port@4 {
				reg = <4>;
				qmi_in_lpass_audio: endpoint {
					remote-endpoint =
						<&lpass_audio_out_qmi>;
				};
			};

			port@5 {
				reg = <5>;
				qmi_in_ddr_lpi: endpoint {
					remote-endpoint =
						<&ddr_lpi_out_qmi>;
				};
			};
		};
	};

	lpass_tpdm_rscc_cmb: tpdm@11352000 {
		compatible = "arm,coresight-dummy-source";
		device-name = "tpdm_lpass_rscc";

		trace-name = "tpda-lpass-rscc";
		out-ports {
			#address-cells = <1>;
			#size-cells = <0>;

			port@0 {
				reg = <0>;
				tpdm_rscc_out_lpass_lpi_funnel1_4: endpoint {
					remote-endpoint =
						<&lpass_lpi_funnel1_4_in_tpdm_rscc>;
				};
			};

			port@1 {
				reg = <1>;
				lpass_rscc_out_qmi: endpoint {
					remote-endpoint =
					<&qmi_in_lpass_rscc>;
				};
			};
		};
	};

	lpass_tpdm_audio_dsb: tpdm@11354000 {
		compatible = "arm,coresight-dummy-source";
		device-name = "tpdm_lpass_audio";

		trace-name = "tpda-lpass-audio";

		out-ports {
			#address-cells = <1>;
			#size-cells = <0>;

			port@0 {
				tpdm_audio_out_lpass_lpi_funnel1_5: endpoint {
					remote-endpoint =
						<&lpass_lpi_funnel1_5_in_tpdm_audio>;
				};
			};

			port@1 {
				reg = <1>;
				lpass_audio_out_qmi: endpoint {
					remote-endpoint =
					<&qmi_in_lpass_audio>;
				};
			};
		};

	};

	funnel_lpass_lpi_0: funnel@11344000 {
		compatible = "arm,coresight-static-funnel";
		device-name = "funnel_lpass_lpi_0";

		in-ports {
			#address-cells = <1>;
			#size-cells = <0>;

			port@0 {
				reg = <0>;
				funnel_lpass_lpi_in_audio_etm0: endpoint {
					remote-endpoint =
					<&audio_etm0_out_funnel_lpass_lpi>;
				};
			};

			port@7 {
				reg = <7>;
				funnel_lpass_lpi_0_in_funnel_lpass_lpi_1: endpoint {
					remote-endpoint =
					<&funnel_lpass_lpi_1_out_funnel_lpass_lpi_0>;
				};
			};
		};

		out-ports {
			port {
				funnel_lpass_lpi_0_out_funnel_lpass_lpi_2: endpoint {
					remote-endpoint =
					<&funnel_lpass_lpi_2_in_funnel_lpass_lpi_0>;
				};
			};
		};
	};

	funnel_lpass_lpi_2: funnel@11368000 {
		compatible = "arm,coresight-static-funnel";
		device-name = "funnel_lpass_lpi_2";

		in-ports {
			port@0 {
				funnel_lpass_lpi_2_in_funnel_lpass_lpi_0: endpoint {
					remote-endpoint =
					<&funnel_lpass_lpi_0_out_funnel_lpass_lpi_2>;
				};
			};
		};

		out-ports {
			port {
				funnel_lpass_lpi_2_out_funnel_aoss: endpoint {
					remote-endpoint =
					<&funnel_aoss_in_funnel_lpass_lpi_2>;
				};
			};
		};
	};

	audio_etm0 {
		compatible = "qcom,coresight-remote-etm";

		device-name = "audio_etm0";
		qcom,atid-num = <2>;
		trace-name = "audio-etm0";
		atid = <40 41>;

		out-ports {
			#address-cells = <1>;
			#size-cells = <0>;

			port@0 {
				reg = <0>;
				audio_etm0_out_funnel_lpass_lpi: endpoint {
					remote-endpoint =
					<&funnel_lpass_lpi_in_audio_etm0>;
				};
			};

			port@1 {
				reg = <1>;
				audio_etm0_out_qmi: endpoint {
					remote-endpoint =
					<&qmi_in_audio_etm0>;
				};
			};
		};
	};

	lpass_tpdm_crdl_dsb: tpdm@11044000 {
		compatible = "qcom,coresight-tpdm","arm,primecell";
		reg = <0x11044000 0x1000>;

		reg-names = "tpdm-base";
		device-name = "tpdm_lpass_crdl";

		qcom,dsb-element-bits = <32>;
		qcom,dsb-msrs-num = <16>;

		clocks = <&aoss_qmp>;
		clock-names = "apb_pclk";

		status = "disabled";
		out-ports {
			port {
				lpass_tpdm_crdl_dsb_out_lpass_cx_dl_0: endpoint {
					remote-endpoint =
						<&lpass_cx_dl_0_in_lpass_tpdm_crdl_dsb>;
				};
			};
		};
	};

	lpass_cx_dl: funnel@11046000 {
		compatible = "arm,coresight-dynamic-funnel","arm,primecell";
		reg = <0x11046000 0x1000>;

		reg-names = "funnel-base";
		device-name = "funnel_lpass_dl";

		clocks = <&aoss_qmp>;
		clock-names = "apb_pclk";
		status = "disabled";
		in-ports {
			port@0 {
				lpass_cx_dl_0_in_lpass_tpdm_crdl_dsb: endpoint {
					remote-endpoint =
						<&lpass_tpdm_crdl_dsb_out_lpass_cx_dl_0>;
				};
			};
		};

		out-ports {
			port@0 {
				lpass_cx_dl_out_tpda_dlct_0_0: endpoint {
					remote-endpoint =
						<&tpda_dlct_0_0_in_lpass_cx_dl>;
				};
			};
		};
	};

	etm0 {
		compatible = "arm,primecell";
		arm,primecell-periphid = <0x000bb95d>;
		reg = <0x12040000 0x1000>;
		cpu = <&CPU0>;

		qcom,skip-power-up;

		clocks = <&aoss_qmp>;
		clock-names = "apb_pclk";
		out-ports {
			port {
				etm0_out_funnel_etm: endpoint {
				remote-endpoint = <&funnel_etm_in_etm0>;
				};
			};
		};
	};

	etm1 {
		compatible = "arm,primecell";
		arm,primecell-periphid = <0x000bb95d>;
		reg = <0x12140000 0x1000>;
		cpu = <&CPU1>;

		qcom,skip-power-up;

		clocks = <&aoss_qmp>;
		clock-names = "apb_pclk";
		out-ports {
			port {
				etm1_out_funnel_etm: endpoint {
				remote-endpoint = <&funnel_etm_in_etm1>;
				};
			};
		};
	};

	etm2 {
		compatible = "arm,primecell";
		arm,primecell-periphid = <0x000bb95d>;
		reg = <0x12240000 0x1000>;
		cpu = <&CPU2>;

		qcom,skip-power-up;

		clocks = <&aoss_qmp>;
		clock-names = "apb_pclk";
		out-ports {
			port {
				etm2_out_funnel_etm: endpoint {
					remote-endpoint = <&funnel_etm_in_etm2>;
				};
			};
		};
	};

	etm3 {
		compatible = "arm,primecell";
		arm,primecell-periphid = <0x000bb95d>;
		reg = <0x12340000 0x1000>;
		cpu = <&CPU3>;

		qcom,skip-power-up;

		clocks = <&aoss_qmp>;
		clock-names = "apb_pclk";
		out-ports {
			port {
				etm3_out_funnel_etm: endpoint {
				remote-endpoint = <&funnel_etm_in_etm3>;
				};
			};
		};
	};

	funnel_etm:funnel@12800000 {
		compatible = "arm,primecell";
		arm,primecell-periphid = <0x000bb908>;

		reg = <0x12800000 0x1000>;
		reg-names = "funnel-base";

		device-name = "funnel_etm";

		clocks = <&aoss_qmp>;
		clock-names = "apb_pclk";

		out-ports {
			port {
				funnel_etm_out_funnel_apss: endpoint {
					remote-endpoint =
					<&funnel_apss_in_funnel_etm>;
				};
			};
		};

		in-ports {
			#address-cells = <1>;
			#size-cells = <0>;

			port@0 {
				reg = <0>;
				funnel_etm_in_etm0: endpoint {
					remote-endpoint =
					<&etm0_out_funnel_etm>;
				};
			};

			port@1 {
				reg = <1>;
				funnel_etm_in_etm1: endpoint {
				remote-endpoint =
					<&etm1_out_funnel_etm>;
				};
			};

			port@2 {
				reg = <2>;
				funnel_etm_in_etm2: endpoint {
				remote-endpoint =
					<&etm2_out_funnel_etm>;
				};
			};

			port@3 {
				reg = <3>;
				funnel_etm_in_etm3: endpoint {
				remote-endpoint =
					<&etm3_out_funnel_etm>;
				};
			};

		};
	};

	funnel_apss: funnel@12810000 {
		compatible = "arm,primecell";
		arm,primecell-periphid = <0x000bb908>;

		reg = <0x12810000 0x1000>;
		reg-names = "funnel-base";

		device-name = "funnel_apss";

		clocks = <&aoss_qmp>;
		clock-names = "apb_pclk";

		in-ports {
			#address-cells = <1>;
			#size-cells = <0>;

			port@0 {
				reg = <0>;
				funnel_apss_in_funnel_etm: endpoint {
					remote-endpoint =
					<&funnel_etm_out_funnel_apss>;
				};
			};

			port@3 {
				reg = <3>;
				funnel_apss_in_tpda_apss: endpoint {
					remote-endpoint =
					<&tpda_apss_out_funnel_apss>;
				};
			};
		};

		out-ports {
			port {
				top_apss_out_fun_in1_qdss_4: endpoint {
					remote-endpoint =
					<&fun_in1_qdss_4_in_top_apss>;
				};
			};
		};
	};

	tpda_apss: tpda@12863000 {
		compatible = "qcom,coresight-tpda","arm,primecell";
		arm,primecell-periphid = <0x000f0f00>;

		reg = <0x12863000 0x1000>;
		reg-names = "tpda-base";
		device-name = "tpda_apss";

		clocks = <&aoss_qmp>;
		clock-names = "apb_pclk";

		in-ports {

			#address-cells = <1>;
			#size-cells = <0>;

			port@0 {
				reg = <0>;
				tpda_apss_in_tpdm_llm_silver: endpoint {
					remote-endpoint =
					<&tpdm_llm_silver_out_tpda_apss>;
				};
			};

			port@3 {
				reg = <3>;
				tpda_apss_in_tpdm_actpm: endpoint {
					remote-endpoint =
					<&tpdm_actpm_out_tpda_apss>;
				};
			};

			port@4 {
				reg = <4>;
				tpda_apss_in_tpdm_llm_dsb: endpoint {
					remote-endpoint =
					<&tpdm_llm_dsb_out_tpda_apss>;
				};
			};
		};

		out-ports {

			port {
				tpda_apss_out_funnel_apss: endpoint {
					remote-endpoint =
					<&funnel_apss_in_tpda_apss>;
				};
			};
		};
	};

	tpdm_llm_silver: tpdm@128a0000 {
		compatible = "qcom,coresight-tpdm","arm,primecell";
		arm,primecell-periphid = <0x000f0e00>;

		reg = <0x128a0000 0x1000>;
		reg-names = "tpdm-base";
		device-name = "tpdm_llm_silver";

		clocks = <&aoss_qmp>;
		clock-names = "apb_pclk";

		qcom,cmb-element-bits = <32>;
		qcom,cmb-msrs-num = <12>;
		out-ports {
			port {
				tpdm_llm_silver_out_tpda_apss: endpoint {
					remote-endpoint =
					<&tpda_apss_in_tpdm_llm_silver>;
				};
			};
		};
	};


	tpdm_actpm: tpdm@12860000 {
		compatible = "qcom,coresight-tpdm","arm,primecell";
		arm,primecell-periphid = <0x000f0e00>;

		reg = <0x12860000 0x1000>;
		reg-names = "tpdm-base";
		device-name = "tpdm_actpm";

		qcom,cmb-element-bits = <64>;
		qcom,cmb-msrs-num = <1>;

		clocks = <&aoss_qmp>;
		clock-names = "apb_pclk";
		out-ports {
			port {
				tpdm_actpm_out_tpda_apss: endpoint {
					remote-endpoint =
					<&tpda_apss_in_tpdm_actpm>;
				};
			};
		};
	};

	tpdm_llm_dsb: tpdm@12861000 {
		compatible = "qcom,coresight-tpdm","arm,primecell";
		arm,primecell-periphid = <0x000f0e00>;

		reg = <0x12861000 0x1000>;
		reg-names = "tpdm-base";
		device-name = "tpdm_llm_dsb";

		qcom,dsb-element-bits = <32>;
		qcom,dsb-msrs-num = <32>;

		clocks = <&aoss_qmp>;
		clock-names = "apb_pclk";
		out-ports {
			port {
				tpdm_llm_dsb_out_tpda_apss: endpoint {
					remote-endpoint =
					<&tpda_apss_in_tpdm_llm_dsb>;
				};
			};
		};
	};
};
