// SPDX-License-Identifier: BSD-3-Clause
/*
 * Copyright (c) Qualcomm Technologies, Inc. and/or its subsidiaries.
 */

#include "ravelin.dtsi"

&cx_sdpm {
	status = "disabled";
};

/ {

	model = "Qualcomm Technologies, Inc. Ravelin SG";
	compatible = "qcom,ravelin";
	qcom,msm-id = <653 0x10000>;
};
