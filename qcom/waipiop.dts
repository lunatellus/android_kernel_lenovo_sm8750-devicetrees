// SPDX-License-Identifier: BSD-3-Clause
/*
 * Copyright (c) Qualcomm Technologies, Inc. and/or its subsidiaries.
 */

/dts-v1/;

#include "waipiop.dtsi"

/ {
	model = "Qualcomm Technologies, Inc. WaipioP SoC";
	compatible = "qcom,waipiop";
	qcom,board-id = <0 0>;
};
