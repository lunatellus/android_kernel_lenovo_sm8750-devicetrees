// SPDX-License-Identifier: BSD-3-Clause
/*
 * Copyright (c) Qualcomm Technologies, Inc. and/or its subsidiaries.
 */
/dts-v1/;
/plugin/;

#include "malabar-vm-avf.dtsi"
#include "malabar-vm-rcm-avf.dtsi"

/ {
	model = "Qualcomm Technologies, Inc. Malabar SVM RCM";
	compatible = "qcom,malabar-rcm", "qcom,malabar", "qcom,malabarp-rcm", "qcom,malabarp",
			   "qcom,rcm";
	qcom,board-id = <0x10015 0x0>;

	host {
	};
};
