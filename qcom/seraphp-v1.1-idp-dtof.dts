// SPDX-License-Identifier: BSD-3-Clause
/*
 * Copyright (c) Qualcomm Technologies, Inc. and/or its subsidiaries.
 */

/dts-v1/;
/plugin/;
#include "seraphp-v1.1.dtsi"
#include "seraphp-v1.1-idp-dtof.dtsi"
/ {
	model = "Qualcomm Technologies, Inc. SeraphP v1.1 IDP DTOF";
	compatible = "qcom,seraphp-v1.1-idp", "qcom,seraphp", "qcom,idp";
	qcom,board-id = <0x10022 1>;
};
