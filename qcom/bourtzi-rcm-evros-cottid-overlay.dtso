// SPDX-License-Identifier: BSD-3-Clause
/*
 * Copyright (c) Qualcomm Technologies, Inc. and/or its subsidiaries.
 */

/dts-v1/;
/plugin/;

#include "bourtzi-rcm.dtsi"
#include "bourtzi-pmiv010x.dtsi"

/ {
	model = "Qualcomm Technologies, Inc. Bourtzi RCM + evros + cottid";
	compatible = "qcom,bourtzi-rcm", "qcom,bourtzip-rcm", "qcom,bourtzi", "qcom,bourtzip", "qcom,rcm";
	qcom,msm-id = <776 0x10000>, <777 0x10000>;
	qcom,board-id = <0x20015 0x0>;
};
