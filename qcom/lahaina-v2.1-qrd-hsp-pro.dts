// SPDX-License-Identifier: BSD-3-Clause
/*
 * Copyright (c) Qualcomm Technologies, Inc. and/or its subsidiaries.
 */

/dts-v1/;

#include "lahaina-v2.1.dtsi"
#include "lahaina-qrd-hsp-pro.dtsi"

/ {
	model = "Qualcomm Technologies, Inc. Lahaina QRD-HSP-PRO";
	compatible = "qcom,lahaina-qrd", "qcom,lahaina", "qcom,qrd";
	qcom,board-id = <0x201000B 0>;
};
