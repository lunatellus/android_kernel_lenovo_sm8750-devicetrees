// SPDX-License-Identifier: BSD-3-Clause
/*
 * Copyright (c) Qualcomm Technologies, Inc. and/or its subsidiaries.
 */

/dts-v1/;
/plugin/;

#include "seraph-atp.dtsi"
#include "seraph-le-ipa-disable.dtsi"

/ {
	model = "Qualcomm Technologies, Inc. Seraph ATP";
	compatible = "qcom,seraph-atp", "qcom,seraph", "qcom,atp";
	qcom,msm-id = <672 0x10000>;
	qcom,board-id = <0x10021 0>;
};
