// SPDX-License-Identifier: BSD-3-Clause
/*
 * Copyright (c) Qualcomm Technologies, Inc. and/or its subsidiaries.
 */

/dts-v1/;

#include "seraph-v1.1.dtsi"

/ {
	model = "Qualcomm Technologies, Inc. SeraphP v1.1 SoC";
	compatible = "qcom,seraphp";
	qcom,msm-id = <673 0x10001>;
};
