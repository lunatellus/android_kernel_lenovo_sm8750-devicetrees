// SPDX-License-Identifier: BSD-3-Clause
/*
 * Copyright (c) Qualcomm Technologies, Inc. and/or its subsidiaries.
 */

/dts-v1/;

#include "monaco-gh-vm-lv.dtsi"

/ {
	model = "Qualcomm Technologies, Inc. Monaco IVI ADAS QAM Gunyah LV VM";
	compatible = "qcom,monaco", "qcom,qam";
	qcom,board-id = <0x10019 0>;
};
