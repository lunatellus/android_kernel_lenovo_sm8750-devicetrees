// SPDX-License-Identifier: BSD-3-Clause
/*
 * Copyright (c) Qualcomm Technologies, Inc. and/or its subsidiaries.
 */

/dts-v1/;
/plugin/;

/ {
	model = "Qualcomm Technologies, Inc. Lemans Flex Single LA Guest Virtual Machine";
	compatible = "qcom,lemans", "qcom,quinvm";
	qcom,board-id = <0x0 0x1000001>;
	qcom,msm-id = <534 0x20000>;
	qcom,sdp = <0x320>;
};

#include "sa8255p-sdp8-vm.dtsi"
#include "sa8775p-sdp8-vm-cpu-conf.dtsi"
#include "sa8775p-sdp8-vm-la.dtsi"

&{/} {
	model = "Qualcomm Technologies, Inc. Lemans Flex Single LA Guest Virtual Machine";
	compatible = "qcom,lemans", "qcom,quinvm";
	qcom,msm-id = <534 0x20000>;
	qcom,board-id = <0x0 0x1000001>;
	qcom,msm-name  = "SA_QX_VM";
	qcom,sdp = <0x320>;
};
