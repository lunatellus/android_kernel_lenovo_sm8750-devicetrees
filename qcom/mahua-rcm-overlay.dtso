// SPDX-License-Identifier: BSD-3-Clause
/*
 * Copyright (c) Qualcomm Technologies, Inc. and/or its subsidiaries.
 */

/dts-v1/;
/plugin/;

#include "mahua-rcm.dtsi"

/ {
        model = "Qualcomm Technologies, Inc. Mahua CRD";
        compatible = "qcom,mahua-rcm", "qcom,mahua", "qcom,rcm";
        qcom,msm-id = <693 0x10000>;
        qcom,board-id = <21 0>;
};
