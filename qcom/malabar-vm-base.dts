// SPDX-License-Identifier: BSD-3-Clause
/*
 * Copyright (c) Qualcomm Technologies, Inc. and/or its subsidiaries.
 */

#include "canoe-vm-base.dts"

/ {
	/* Timer interrupts are different on Malabar */
	timer {
		interrupts = <0x01 0x1 0x308 0x01 0x2 0x308 0x01 0x3 0x308 0x01 0x0 0x308>;
	};
};
