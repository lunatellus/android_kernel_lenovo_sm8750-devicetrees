/*
 * Copyright (c) Qualcomm Technologies, Inc. and/or its subsidiaries.
 * SPDX-License-Identifier: BSD-3-Clause
 */

/dts-v1/;
/plugin/;

#include "mahua-dsp.dtsi"

/ {
	model = "Qualcomm Technologies, Inc. Mahua SoC";
	compatible = "qcom,mahua";
	qcom,msm-id = <693 0x10000>, <693 0x20000>;
	qcom,board-id = <0 0>;
};
