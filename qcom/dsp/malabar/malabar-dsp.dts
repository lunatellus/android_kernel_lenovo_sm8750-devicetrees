// SPDX-License-Identifier: BSD-3-Clause
/*
 * Copyright (c) Qualcomm Technologies, Inc. and/or its subsidiaries.
 */

/dts-v1/;
/plugin/;

#include "malabar-dsp.dtsi"

/ {
	model = "Qualcomm Technologies, Inc. malabar v1 SoC";
	compatible = "qcom,malabar";
	qcom,msm-id = <733 0x10000>, <0x10002DD 0x10000>,
			<757 0x10000>, <0x10002F5 0x10000>;
	qcom,board-id = <0 0>, <0 0x600>;
};
