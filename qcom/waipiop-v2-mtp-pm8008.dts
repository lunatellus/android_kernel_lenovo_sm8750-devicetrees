// SPDX-License-Identifier: BSD-3-Clause
/*
 * Copyright (c) Qualcomm Technologies, Inc. and/or its subsidiaries.
 */

/dts-v1/;

#include "waipiop-v2.dtsi"
#include "waipio-mtp.dtsi"
#include "waipio-pm8008.dtsi"

/ {
	model = "Qualcomm Technologies, Inc. WaipioP v2 MTP with PM8008";
	compatible = "qcom,waipiop-mtp", "qcom,waipiop", "qcom,mtp";
	qcom,board-id = <8 0>;
};
