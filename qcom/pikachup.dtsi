// SPDX-License-Identifier: BSD-3-Clause
/*
 * Copyright (c) Qualcomm Technologies, Inc. and/or its subsidiaries.
 */

/dts-v1/;

#include "pikachu.dtsi"

/ {
	model = "Qualcomm Technologies, Inc. PikachuP SoC";
	compatible = "qcom,pikachup";
	qcom,msm-id = <737 0x10000>;
};

&adsp_pas {
	firmware-name = "adsp.mdt", "adsp_dtb.mdt";
};
