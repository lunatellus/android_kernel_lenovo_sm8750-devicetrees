// SPDX-License-Identifier: BSD-3-Clause
/*
 * Copyright (c) Qualcomm Technologies, Inc. and/or its subsidiaries.
 */

/dts-v1/;
/plugin/;

#include "yupikp-iot-controller.dtsi"

/ {
	model = "Qualcomm Technologies, Inc. YupikP IoT Touch Controller";
	compatible = "qcom,yupikp-iot-idp", "qcom,yupikp-iot", "qcom,idp";
	qcom,msm-id = <498 0x10000>, <575 0x10000>;
	qcom,board-id = <0x100020 0xC>;
};
