// SPDX-License-Identifier: BSD-3-Clause
/*
 * Copyright (c) Qualcomm Technologies, Inc. and/or its subsidiaries.
 */
/dts-v1/;
/plugin/;

#include "chora-oemvm-avf.dtsi"
#include "chora-oemvm-atp-avf.dtsi"

/ {
	model = "Qualcomm Technologies, Inc. Chora OEMVM ATP";
	compatible = "qcom,chora-atp", "qcom,chora", "qcom,chorap-atp",
			"qcom,chorap", "qcom,atp";
	qcom,board-id = <0x10021 0x0>;

	host {
	};
};
