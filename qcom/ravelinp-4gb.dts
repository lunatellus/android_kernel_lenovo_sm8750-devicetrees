// SPDX-License-Identifier: BSD-3-Clause
/*
 * Copyright (c) Qualcomm Technologies, Inc. and/or its subsidiaries.
 */

/dts-v1/;

#include "ravelinp-4gb.dtsi"

/ {
	model = "Qualcomm Technologies, Inc. RavelinP 4Gb SoC";
	compatible = "qcom,ravelinp";
	qcom,board-id = <0 0x600>;
};
