// SPDX-License-Identifier: BSD-3-Clause
/*
 * Copyright (c) Qualcomm Technologies, Inc. and/or its subsidiaries.
 */

/dts-v1/;

#include "seraph-v1.1.dtsi"

/ {
	model = "Qualcomm Technologies, Inc. Seraph v1.1 SoC";
	compatible = "qcom,seraph";
	qcom,board-id = <0 0>;
};
