// SPDX-License-Identifier: BSD-3-Clause
/*
 * Copyright (c) Qualcomm Technologies, Inc. and/or its subsidiaries.
 */

/dts-v1/;
/plugin/;

#include "alor-mtp-iot.dtsi"

/ {
	model = "Qualcomm Technologies, Inc. Alor MTP + WCN7750 WLAN + PM7750BA SMB1500 + ST54L + Harmonium + Panderio";
	compatible = "qcom,alor-mtp", "qcom,alor", "qcom,mtp", "qcom,alorp-mtp", "qcom,alorp";
	qcom,msm-id = <685 0x10000>, <727 0x10000>, <764 0x10000>;
	qcom,board-id = <0x50008 0>;
};
