// SPDX-License-Identifier: BSD-3-Clause
/*
 * Copyright (c) Qualcomm Technologies, Inc. and/or its subsidiaries.
 */

/dts-v1/;

#include "lahaina.dtsi"
#include "lahaina-qrd-hsp.dtsi"

/ {
	model = "Qualcomm Technologies, Inc. Lahaina QRD-HSP";
	compatible = "qcom,lahaina-qrd", "qcom,lahaina", "qcom,qrd";
	qcom,board-id = <0x101000B 0>;
};
