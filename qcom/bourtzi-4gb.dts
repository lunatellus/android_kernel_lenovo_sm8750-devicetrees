// SPDX-License-Identifier: BSD-3-Clause
/*
 * Copyright (c) Qualcomm Technologies, Inc. and/or its subsidiaries.
 */

/dts-v1/;

#include "bourtzi-4gb.dtsi"

/ {
	model = "Qualcomm Technologies, Inc. Bourtzi SoC 4GB DDR";
	compatible = "qcom,bourtzi";
	qcom,board-id = <0 0x600>;
};
