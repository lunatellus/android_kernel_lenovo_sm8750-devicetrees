// SPDX-License-Identifier: BSD-3-Clause
/*
 * Copyright (c) Qualcomm Technologies, Inc. and/or its subsidiaries.
 */

/dts-v1/;

#include "waipio-v2.dtsi"

/ {
	model = "Qualcomm Technologies, Inc. Waipio v2 SoC";
	compatible = "qcom,waipio";
	qcom,board-id = <0 0>;
};
