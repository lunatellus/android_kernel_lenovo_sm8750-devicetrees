// SPDX-License-Identifier: BSD-3-Clause
/*
 * Copyright (c) Qualcomm Technologies, Inc. and/or its subsidiaries.
 */

/dts-v1/;

#include "lemans-gh-vm-lv.dtsi"
#include "lemans-gh-vm-lv-qcvirtio.dtsi"

/ {
	model = "Qualcomm Technologies, Inc. Lemans IVI QAM Gunyah LV VM QCVirtIO";
	compatible = "qcom,lemans";
	qcom,msm-id = <532 0x10000>, <532 0x20000>;
	qcom,board-id = <0x10025 0x0>;
};
