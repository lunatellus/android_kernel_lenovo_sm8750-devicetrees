// SPDX-License-Identifier: BSD-3-Clause
/*
 * Copyright (c) Qualcomm Technologies, Inc. and/or its subsidiaries.
 */

/dts-v1/;

#include "lahaina-v2.dtsi"
#include "lahaina-mtp-v2.dtsi"

/ {
	model = "Qualcomm Technologies, Inc. Lahaina MTP v2";
	compatible = "qcom,lahaina-mtp", "qcom,lahaina", "qcom,mtp";
	qcom,board-id = <0x20008 0>;
};
