// SPDX-License-Identifier: BSD-3-Clause
/*
 * Copyright (c) Qualcomm Technologies, Inc. and/or its subsidiaries.
 */

#include <dt-bindings/interrupt-controller/irq.h>
#include <dt-bindings/spmi/spmi.h>

&spmi1_bus {
	pmh0104_l_e1: pmh0104@b {
		compatible = "qcom,spmi-pmic";
		reg = <11 SPMI_USID>;
		#address-cells = <1>;
		#size-cells = <0>;

		pmh0104_l_e1_tz: pmh0104-temp-alarm@a00 {
			compatible = "qcom,spmi-temp-alarm";
			reg = <0xa00>;
			interrupts = <0xb 0xa 0x0 IRQ_TYPE_EDGE_BOTH>;
			#thermal-sensor-cells = <0>;
		};

		pmh0104_l_e1_gpios: pinctrl@8800 {
			compatible = "qcom,pmh0104-gpio";
			reg = <0x8800>;
			gpio-controller;
			#gpio-cells = <2>;
			interrupt-controller;
			#interrupt-cells = <2>;
		};
	};
};
