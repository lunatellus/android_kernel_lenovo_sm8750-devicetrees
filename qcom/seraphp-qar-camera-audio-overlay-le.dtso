// SPDX-License-Identifier: BSD-3-Clause
/*
 * Copyright (c) Qualcomm Technologies, Inc. and/or its subsidiaries.
 */

/dts-v1/;
/plugin/;

#include "seraphp-qar-camera-audio.dtsi"
#include "seraph-le-ipa-disable.dtsi"

/ {
	model = "Qualcomm Technologies, Inc. SeraphP QAR + CAMERA + AUDIO";
	compatible = "qcom,seraphp-qar", "qcom,seraphp", "qcom,qar";
	qcom,msm-id = <673 0x10000>;
	qcom,board-id = <0x1002C 1>;
};
