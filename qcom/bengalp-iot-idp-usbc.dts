// SPDX-License-Identifier: BSD-3-Clause
/*
 * Copyright (c) Qualcomm Technologies, Inc. and/or its subsidiaries.
 */

/dts-v1/;

#include "bengalp-iot.dtsi"
#include "bengalp-iot-idp.dtsi"

/ {
	model = "Qualcomm Technologies, Inc. BENGALP-IOT IDP USBC Audio";
	compatible = "qcom,bengalp-iot-idp", "qcom,bengalp-iot", "qcom,idp";
	qcom,board-id = <34 1>;
};
