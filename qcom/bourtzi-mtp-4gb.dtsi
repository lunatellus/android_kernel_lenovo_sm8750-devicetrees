// SPDX-License-Identifier: BSD-3-Clause
/*
 * Copyright (c) Qualcomm Technologies, Inc. and/or its subsidiaries.
 */

#include "bourtzi-mtp.dtsi"
#include "bourtzi-pm7250b.dtsi"
#include "bourtzi-smb1355.dtsi"

&soc {
};
