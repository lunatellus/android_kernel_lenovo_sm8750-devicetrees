// SPDX-License-Identifier: BSD-3-Clause
/*
 * Copyright (c) Qualcomm Technologies, Inc. and/or its subsidiaries.
 */

/dts-v1/;
/plugin/;

#include "chora-qrd.dtsi"

/ {
	model = "Qualcomm Technologies, Inc. Chora QRD Evros + Bonfish";
	compatible = "qcom,chora-qrd", "qcom,chora", "qcom,chorap-qrd", "qcom,chorap", "qcom,qrd";
	qcom,msm-id = <724 0x10000>, <744 0x10000>;
	qcom,board-id = <0x1020b 0x0>;
};
