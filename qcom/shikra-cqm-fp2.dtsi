// SPDX-License-Identifier: BSD-3-Clause
/*
 * Copyright (c) Qualcomm Technologies, Inc. and/or its subsidiaries.
 */

#include "shikra-cqm.dtsi"
#include "shikra-pmic-overlay-pm4125.dtsi"

/ {
	model = "Qualcomm Technologies, Inc. Shikra CQM FP2 SoC";
	compatible = "qcom,shikra-cqm", "qcom,shikra";
	qcom,msm-id = <756 0x10000>;
	qcom,softsku-id = <2>, <3>;
};
