// SPDX-License-Identifier: BSD-3-Clause
/*
 * Copyright (c) Qualcomm Technologies, Inc. and/or its subsidiaries.
 */

&soc {
	walt {
		#address-cells = <1>;
		#size-cells = <1>;
		ranges;

		qcom,cycle-cntr {
			compatible = "qcom,epss";
			reg = <0xfd91000 0x1000>,
				<0xfd92000 0x1000>;
			reg-names = "freq-domain0",
				"freq-domain1";
		};
	};
};
