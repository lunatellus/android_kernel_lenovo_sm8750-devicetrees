// SPDX-License-Identifier: BSD-3-Clause
/*
 * Copyright (c) Qualcomm Technologies, Inc. and/or its subsidiaries.
 */

/dts-v1/;
/plugin/;

#include "monaco-standalone-wdp-v1.dtsi"

/ {
	model = "Qualcomm Technologies, Inc. Monaco standalone WDP V1.0";
	qcom,board-id = <0x010024 0x1>;
};
