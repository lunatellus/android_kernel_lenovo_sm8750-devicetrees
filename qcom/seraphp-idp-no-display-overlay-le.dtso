// SPDX-License-Identifier: BSD-3-Clause
/*
 * Copyright (c) Qualcomm Technologies, Inc. and/or its subsidiaries.
 */

/dts-v1/;
/plugin/;

#include "seraphp-idp.dtsi"
#include "seraph-le-ipa-disable.dtsi"

/ {
	model = "Qualcomm Technologies, Inc. SeraphP IDP NO DISPLAY";
	compatible = "qcom,seraphp-idp", "qcom,seraphp", "qcom,idp";
	qcom,msm-id = <673 0x10000>;
	qcom,board-id = <0x10022 2>;
};
