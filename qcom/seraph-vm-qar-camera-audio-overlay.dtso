// SPDX-License-Identifier: BSD-3-Clause
/*
 * Copyright (c) Qualcomm Technologies, Inc. and/or its subsidiaries.
 */

/dts-v1/;
/plugin/;

#include "seraph-vm-avf.dtsi"
#include "seraph-vm-qar-camera-audio-avf.dtsi"

/ {
	model = "Qualcomm Technologies, Inc. Seraph SVM QAR + CAMERA + AUDIO";
	compatible = "qcom,seraph-qar", "qcom,seraph", "qcom,qar";
	qcom,board-id = <0x1002c 1>;

	host {
	};
};
