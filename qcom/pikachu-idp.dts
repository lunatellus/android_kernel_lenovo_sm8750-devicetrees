// SPDX-License-Identifier: BSD-3-Clause
/*
 * Copyright (c) Qualcomm Technologies, Inc. and/or its subsidiaries.
 */

/dts-v1/;
/plugin/;

#include "pikachu.dtsi"
#include "pikachu-idp.dtsi"

/ {
	model = "Qualcomm Technologies, Inc. PikachuP IDP";
	compatible = "qcom,pikachup-idp", "qcom,pikachup", "qcom,idp";
	qcom,board-id = <0x10022 0>;
};
