// SPDX-License-Identifier: BSD-3-Clause
/*
 * Copyright (c) Qualcomm Technologies, Inc. and/or its subsidiaries.
 */

/dts-v1/;
/plugin/;

#include "lahainap-cdp.dtsi"

/ {
	model = "Qualcomm Technologies, Inc. LahainaP CDP";
	compatible = "qcom,lahainap-cdp", "qcom,lahainap", "qcom,cdp";
	qcom,board-id = <0x10001 0>;
};
