// SPDX-License-Identifier: BSD-3-Clause
/*
 * Copyright (c) Qualcomm Technologies, Inc. and/or its subsidiaries.
 */

/dts-v1/;
/plugin/;

#include "shikra-evk-eSE.dtsi"

/ {
  model = "Qualcomm Technologies, Inc. Shikra EVK eSE";
  compatible = "qcom,shikra-evk", "qcom,shikra", "qcom,evk";
  qcom,board-id = <0x30033 0x0>;
};
