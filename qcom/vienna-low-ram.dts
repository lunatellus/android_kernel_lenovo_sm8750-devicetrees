// SPDX-License-Identifier: BSD-3-Clause
/*
 * Copyright (c) Qualcomm Technologies, Inc. and/or its subsidiaries.
 */

/dts-v1/;

#include "vienna-low-ram.dtsi"

/ {
	model = "Qualcomm Technologies, Inc. Vienna SoC 2GB DDR";
	compatible = "qcom,vienna";
	qcom,board-id = <0 0x400>;
};
