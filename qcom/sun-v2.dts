// SPDX-License-Identifier: BSD-3-Clause
/*
 * Copyright (c) 2023 Qualcomm Innovation Center, Inc. All rights reserved.
 */

/dts-v1/;

#include "sun-v2.dtsi"
#include "sun-v2-techpacks.dtsi"

#include "mm/hw_fence/sun-hw-fence.dtsi"
#include "data/sun-ipa.dtsi"
#include "fingerprint/sun-fingerprint.dtsi"

/ {
	model = "Qualcomm Technologies, Inc. Sun v2 SoC";
	compatible = "qcom,sun";
	qcom,board-id = <0 0>;
};
