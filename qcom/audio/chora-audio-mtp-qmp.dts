// SPDX-License-Identifier: BSD-3-Clause
/*
 * Copyright (c) Qualcomm Technologies, Inc. and/or its subsidiaries.
 */

/dts-v1/;
/plugin/;

#include "chora-audio-mtp-qmp.dtsi"

/ {
	model = "Qualcomm Technologies,  chora MTP + QMP + Pandeiro";
	compatible = "qcom,chora-mtp", "qcom,chora", "qcom,chorap-mtp", "qcom,chorap", "qcom,mtp";
	qcom,msm-id = <724 0x10000>, <744 0x10000>;
	qcom,board-id = <0x20008 0x0>, <0x20208 0x0>;
};
