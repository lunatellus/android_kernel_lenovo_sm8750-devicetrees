//
/* Copyright (c) Qualcomm Technologies, Inc. and/or its subsidiaries.
 *  SPDX-License-Identifier: BSD-3-Clause-Clear
 */
/dts-v1/;
/plugin/;

#include <dt-bindings/clock/qcom,chora-gcc.h>
#include <dt-bindings/interrupt-controller/arm-gic.h>
#include <dt-bindings/interconnect/qcom,chora.h>
#include <dt-bindings/regulator/qcom,rpmh-regulator-levels.h>

#include "chora-audio.dtsi"

/ {
	model = "Qualcomm Technologies, Inc. chora";
	compatible = "qcom,chora", "qcom, chorap";
	qcom,msm-id = <724 0x10000>, <744 0x10000>;
	qcom,board-id = <0 0>;
};

