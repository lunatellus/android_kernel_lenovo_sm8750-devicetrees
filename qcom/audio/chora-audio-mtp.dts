// SPDX-License-Identifier: BSD-3-Clause-Clear
/*
 * Copyright (c) Qualcomm Technologies, Inc. and/or its subsidiaries.
 */

/dts-v1/;
/plugin/;

#include "chora-audio-mtp.dtsi"

/ {
	model = "Qualcomm Technologies, Inc. chora MTP + Tanguu+ Pandeiro";
	compatible = "qcom,chora-mtp", "qcom,chora", "qcom,mtp", "qcom,chorap-mtp", "qcom,chora";
	qcom,msm-id = <724 0x10000>, <744 0x10000>;
	qcom,board-id = <0x10008 0x0>, <0x10108 0x0>, <0x10208 0x0>, <0x10308 0x0>;
};
