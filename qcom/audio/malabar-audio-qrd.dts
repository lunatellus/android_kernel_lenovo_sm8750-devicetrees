//
/* Copyright (c) Qualcomm Technologies, Inc. and/or its subsidiaries.
 * SPDX-License-Identifier: BSD-3-Clause
 */

/dts-v1/;
/plugin/;

#include "malabar-audio-qrd.dtsi"

/ {
	model = "Qualcomm Technologies, Inc. Malabar QRD";
	compatible = "qcom,malabar-qrd", "qcom,malabar", "qcom,malabarp-qrd", "qcom,malabarp",
			"qcom,qrd";
	qcom,msm-id = <733 0x10000>, <757 0x10000>;
	qcom,board-id = <0x1000b 0>, <0x1000b 0x600>;
};
