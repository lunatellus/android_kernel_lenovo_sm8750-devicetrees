// SPDX-License-Identifier: BSD-3-Clause
/*
 * Copyright (c) Qualcomm Technologies, Inc. and/or its subsidiaries.
 */

/dts-v1/;
/plugin/;

#include "shikra-evk-kunlun-nfc-m2-hsp.dtsi"

/ {
	model = "Qualcomm Technologies, Inc. Shikra EVK Kunlun NFC M2.0 HSP";
	compatible = "qcom,shikra-evk", "qcom,shikra", "qcom,shikra-cqm", "qcom,shikra-cqs", "qcom,evk";
	qcom,board-id = <0x70033 0x0>;
};
