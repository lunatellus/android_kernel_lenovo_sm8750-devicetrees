// SPDX-License-Identifier: BSD-3-Clause
/*
 * Copyright (c) Qualcomm Technologies, Inc. and/or its subsidiaries.
 */

#include "lahaina-qrd.dtsi"
#include <dt-bindings/clock/qcom,rpmh.h>

&bluetooth {
	qcom,bt-vdd-aon-config = <950000 950000 0 0>;
	qcom,bt-vdd-dig-config = <950000 950000 0 0>;
	qcom,bt-vdd-rfa1-config = <1880000 1880000 0 0>;
	qcom,bt-vdd-rfa2-config = <1350000 1350000 0 0>;
	clocks = <&rpmhcc RPMH_RF_CLK3>;
	clock-names = "ref3_clk";
};
