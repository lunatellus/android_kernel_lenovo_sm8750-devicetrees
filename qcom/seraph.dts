// SPDX-License-Identifier: BSD-3-Clause
/*
 * Copyright (c) Qualcomm Technologies, Inc. and/or its subsidiaries.
 */
/dts-v1/;

#include "seraph.dtsi"

/ {
	model = "Qualcomm Technologies, Inc. Seraph SoC";
	compatible = "qcom,seraph";
	qcom,board-id = <0 0>;
};
