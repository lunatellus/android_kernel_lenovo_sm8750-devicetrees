// SPDX-License-Identifier: BSD-3-Clause
/*
 * Copyright (c) Qualcomm Technologies, Inc. and/or its subsidiaries.
 */

/dts-v1/;

#include "lahaina.dtsi"

/ {
	model = "Qualcomm Technologies, Inc. lahaina v1 SoC";
	compatible = "qcom,lahaina";
	qcom,board-id = <0 0>;
};
