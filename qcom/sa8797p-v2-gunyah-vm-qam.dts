// SPDX-License-Identifier: BSD-3-Clause
/*
 * Copyright (c) Qualcomm Technologies, Inc. and/or its subsidiaries.
 */

/dts-v1/;

#include "sa8797p-v2-gunyah-vm-qam.dtsi"

/ {
	model = "Qualcomm Technologies, Inc. SA8x97p-v2 QAM Gunyah VM";
	compatible = "qcom,sa8797p", "qcom,qam";
	qcom,msm-id = <690 0x20000>;
	qcom,board-id = <0x01010025 0x1>;
};

&ethernet1 {
	qcom,en-eth-switch-dbl;
};
