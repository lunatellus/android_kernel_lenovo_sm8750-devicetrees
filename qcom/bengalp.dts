// SPDX-License-Identifier: BSD-3-Clause
/*
 * Copyright (c) Qualcomm Technologies, Inc. and/or its subsidiaries.
 */

/dts-v1/;

#include "bengalp.dtsi"

/ {
	model = "Qualcomm Technologies, Inc. Bengalp SoC";
	compatible = "qcom,bengalp";
	qcom,board-id = <0 0>;
};
