// SPDX-License-Identifier: BSD-3-Clause
/*
 * Copyright (c) Qualcomm Technologies, Inc. and/or its subsidiaries.
 */

/dts-v1/;
/plugin/;

&soc {
	st54spi_gpio {
		status = "ok";
		compatible = "st,st54spi_gpio";
		/* gpio used as SE_nRESET */
		gpio-power_nreset = <&tlmm 65 0x00>;
	};
};

/ {
	model = "Qualcomm Technologies, Inc. Malabar SoC";
	compatible = "qcom,malabar";
	qcom,board-id = <0x10021 0>, <0x10001 0>, <0x10008 0>, <0x1000B 0>,
			<0x10015 0>, <0x20001 0>, <0x10001 0x600>,
			<0x10008 0x600>, <0x1000b 0x600>;
	qcom,msm-id = <733 0x10000>, <757 0x10000>;
};
