// SPDX-License-Identifier: BSD-3-Clause
/*
 * Copyright (c) Qualcomm Technologies, Inc. and/or its subsidiaries.
 */

&soc {
};

&qupv3_se3_spi {
	#address-cells = <1>;
	#size-cells = <0>;

	status = "okay";
	qcom,touch-active = "goodix,gt9916S";
	required-subnodes = <&goodix_berlin_0>;

	goodix_berlin_0: goodix-berlin@0 {
		compatible = "goodix,gt9916S";
		reg = <0>;
		spi-max-frequency = <1000000>;
		goodix,panel-max-x = <1080>;
		goodix,panel-max-y = <2400>;
		goodix,panel-max-w = <255>;
		goodix,panel-max-p = <4096>;

		goodix,touch-type = "primary";
		goodix,qts_en;
		qts,trusted-touch-mode = "vm_mode";
		qts,touch-environment = "tvm";
		qts,trusted-touch-type = "primary";
		qts,trusted-touch-spi-irq = <267>;
		qts,trusted-touch-io-bases = <0x04A8C000>;
		qts,trusted-touch-io-sizes = <0x1000>;
		qts,trusted-touch-vm-gpio-list = <&tlmm 8 0 &tlmm 9 0 &tlmm 10 0
						&tlmm 11 0 &tlmm 12 0 &tlmm 13 0x2008>;
	};
};

