// SPDX-License-Identifier: BSD-3-Clause
/*
 * Copyright (c) Qualcomm Technologies, Inc. and/or its subsidiaries.
 */

/dts-v1/;

#include "lahainap-v2.1.dtsi"
#include "lahainap-cdp.dtsi"

/ {
	model = "Qualcomm Technologies, Inc. LahainaP v2.1 CDP";
	compatible = "qcom,lahainap-cdp", "qcom,lahainap", "qcom,cdp";
	qcom,board-id = <0x10001 0>;
};
