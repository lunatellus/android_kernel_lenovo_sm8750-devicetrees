// SPDX-License-Identifier: BSD-3-Clause
/*
 * Copyright (c) Qualcomm Technologies, Inc. and/or its subsidiaries.
 */

/dts-v1/;
/plugin/;

/ {
	model = "Qualcomm Technologies, Inc. Monaco Single LV Virtual Machine";
	compatible = "qcom,monaco", "qcom,quinvm";
	qcom,msm-id = <606 0x10000>;
	qcom,board-id = <0 0x4000002>;
	qcom,sdp = <0x320>;
};

#include "monaco-sdp8-vm.dtsi"
#include "sa7255p-sdp8-vm-cpu-conf.dtsi"
#include "monaco-sdp8-vm-lv-headless-mt.dtsi"
