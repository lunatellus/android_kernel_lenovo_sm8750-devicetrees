// SPDX-License-Identifier: BSD-3-Clause
/*
 * Copyright (c) Qualcomm Technologies, Inc. and/or its subsidiaries.
 */

/dts-v1/;
/plugin/;

#include "pikachup-atp.dtsi"

/ {
	model = "Qualcomm Technologies, Inc. PikachuP ATP";
	compatible = "qcom,pikachup-atp", "qcom,pikachup", "qcom,atp";
	qcom,msm-id = <737 0x10000>;
	qcom,board-id = <0x10021 0>;
};
