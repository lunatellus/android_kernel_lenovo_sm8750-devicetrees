// SPDX-License-Identifier: BSD-3-Clause
/*
 * Copyright (c) Qualcomm Technologies, Inc. and/or its subsidiaries.
 */

/dts-v1/;
/plugin/;

#include "vienna-rcm.dtsi"
#include "vienna-pmw6100-v1.dtsi"
#include "vienna-le.dtsi"

/ {
	model = "Qualcomm Technologies, Inc. Vienna RCM PMW6100 V1 for LE";
	compatible = "qcom,vienna-rcm", "qcom,vienna", "qcom,rcm";
	qcom,board-id = <0x10015 0x0>;
	qcom,pmic-id = <0x10064 0x0 0x0 0x0>;
};

