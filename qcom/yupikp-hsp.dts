// SPDX-License-Identifier: BSD-3-Clause
/*
 * Copyright (c) Qualcomm Technologies, Inc. and/or its subsidiaries.
 */

/dts-v1/;

#include "yupikp-hsp.dtsi"

/ {
	model = "Qualcomm Technologies, Inc. YupikP IDP HSP + SoC";
	compatible = "qcom,yupikp";
	qcom,board-id = <0 1>;
};
