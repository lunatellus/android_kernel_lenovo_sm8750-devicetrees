// SPDX-License-Identifier: BSD-3-Clause
/*
 * Copyright (c) Qualcomm Technologies, Inc. and/or its subsidiaries.
 */

/dts-v1/;
/plugin/;

#include "khaje-idp-lp4.dtsi"

/ {
	model = "Qualcomm Technologies, Inc. Khaje LP4 IDP";
	compatible = "qcom,khaje-idp", "qcom,khaje", "qcom,idp";
	qcom,msm-id = <518 0x10000>, <586 0x10000>, <762 0x10000>;
	qcom,board-id = <0x2010022 0>;
	qcom,pmic-id = <0x2D 0x2E 0x0 0x0>;
};
