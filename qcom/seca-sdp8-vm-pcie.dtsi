// SPDX-License-Identifier: BSD-3-Clause
/*
 * Copyright (c) Qualcomm Technologies, Inc. and/or its subsidiaries.
 */

&{/} {
	pcie2: pci@0x4000000000 {
		compatible = "qcom,pcie-ecam-rc";
		reg = <0x40 0x00000000 0x0 0x10000000>;

		device_type = "pci";

		#address-cells = <3>;
		#size-cells = <2>;

		ranges = <0x01000000 0x0 0x60000000 0x0 0x60000000 0x0 0x100000>,
				<0x02000000 0x0 0x60100000 0x0 0x60100000 0x0 0x7000000>,
				<0x43000000 0x40 0x10100000 0x40 0x10100000 0x0 0x100000>;
		bus-range = <0x00 0xff>;

		linux,pci-domain = <2>;

		power-domains = <&scmi_power 7>;
		power-domain-names = "power";

		interrupts = <GIC_SPI 844 IRQ_TYPE_LEVEL_HIGH>,
				<GIC_SPI 838 IRQ_TYPE_LEVEL_HIGH>,
				<GIC_SPI 113 IRQ_TYPE_LEVEL_HIGH>,
				<GIC_SPI 825 IRQ_TYPE_LEVEL_HIGH>,
				<GIC_SPI 846 IRQ_TYPE_LEVEL_HIGH>,
				<GIC_SPI 350 IRQ_TYPE_LEVEL_HIGH>,
				<GIC_SPI 837 IRQ_TYPE_LEVEL_HIGH>,
				<GIC_SPI 104 IRQ_TYPE_LEVEL_HIGH>;
		interrupt-parent = <&qvm_vdev_gic>;

		/*TODO: SMMU V3 is not yet enabled*/
		/*
		 *dma-coherent;
		 *iommu-map = <0x0 &virtio_iommu0 0x20000 0x1>,
		 *		<0x100 &virtio_iommu0 0x20100 0x1>,
		 *		<0x200 &virtio_iommu0 0x20200 0x1>,
		 *		<0x300 &virtio_iommu0 0x20300 0x1>;
		 */

		status = "disabled";
	};

	pcie3: pci@0x400000000 {
		compatible = "qcom,pcie-ecam-rc";
		reg = <0x4 0x00000000 0x0 0x10000000>;

		device_type = "pci";

		#address-cells = <3>;
		#size-cells = <2>;

		ranges = <0x01000000 0x0 0x70000000 0x0 0x70000000 0x0 0x100000>,
				<0x02000000 0x0 0x70100000 0x0 0x70100000 0x0 0x7000000>,
				<0x43000000 0x4 0x10100000 0x4 0x10100000 0x0 0x100000>;
		bus-range = <0x00 0xff>;

		linux,pci-domain = <3>;

		power-domains = <&scmi_power 19>;
		power-domain-names = "power";

		interrupts = <GIC_SPI 364 IRQ_TYPE_LEVEL_HIGH>,
				<GIC_SPI 287 IRQ_TYPE_LEVEL_HIGH>,
				<GIC_SPI 831 IRQ_TYPE_LEVEL_HIGH>,
				<GIC_SPI 659 IRQ_TYPE_LEVEL_HIGH>,
				<GIC_SPI 840 IRQ_TYPE_LEVEL_HIGH>,
				<GIC_SPI 823 IRQ_TYPE_LEVEL_HIGH>,
				<GIC_SPI 241 IRQ_TYPE_LEVEL_HIGH>,
				<GIC_SPI 240 IRQ_TYPE_LEVEL_HIGH>;
		interrupt-parent = <&qvm_vdev_gic>;

		/*TODO: SMMU V3 is not yet enabled*/
		/*
		 *dma-coherent;
		 *iommu-map = <0x0 &virtio_iommu0 0x30000 0x1>,
		 *		<0x100 &virtio_iommu0 0x30100 0x1>,
		 *		<0x200 &virtio_iommu0 0x30200 0x1>,
		 *		<0x300 &virtio_iommu0 0x30300 0x1>;
		 */

		status = "disabled";
	};
};
