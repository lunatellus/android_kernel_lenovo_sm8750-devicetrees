// SPDX-License-Identifier: BSD-3-Clause
/*
 * Copyright (c) Qualcomm Technologies, Inc. and/or its subsidiaries.
 */

/dts-v1/;

#include "bengal-low-ram.dtsi"
#include "bengal-idp-low-ram.dtsi"

/ {
	model = "Qualcomm Technologies, Inc. BENGAL IDP AATC 2Gb DDR";
	compatible = "qcom,bengal-idp", "qcom,bengal", "qcom,idp";
	qcom,board-id = <34 0x401>;
};
