// SPDX-License-Identifier: BSD-3-Clause
/*
 * Copyright (c) Qualcomm Technologies, Inc. and/or its subsidiaries.
 */

/dts-v1/;

#include "waipiop-v2.dtsi"

/ {
	model = "Qualcomm Technologies, Inc. WaipioP v2 SoC";
	compatible = "qcom,waipiop";
	qcom,board-id = <0 0>;
};
