// SPDX-License-Identifier: BSD-3-Clause
/*
 * Copyright (c) Qualcomm Technologies, Inc. and/or its subsidiaries.
 */

/dts-v1/;
/plugin/;

#include "lahaina-atp.dtsi"

/ {
	model = "Qualcomm Technologies, Inc. Lahaina ATP";
	compatible = "qcom,lahaina-atp", "qcom,lahaina", "qcom,atp";
	qcom,board-id = <0x10021 0>;
};
