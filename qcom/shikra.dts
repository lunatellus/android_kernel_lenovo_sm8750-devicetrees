// SPDX-License-Identifier: BSD-3-Clause
/*
 * Copyright (c) Qualcomm Technologies, Inc. and/or its subsidiaries.
 */

/dts-v1/;

#include "shikra.dtsi"

/ {
	model = "Qualcomm Technologies, Inc. Shikra SoC";
	compatible = "qcom,shikra";
	qcom,board-id = <0 0>;
};

