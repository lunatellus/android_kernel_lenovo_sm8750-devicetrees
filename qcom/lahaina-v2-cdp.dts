// SPDX-License-Identifier: BSD-3-Clause
/*
 * Copyright (c) Qualcomm Technologies, Inc. and/or its subsidiaries.
 */

/dts-v1/;

#include "lahaina-v2.dtsi"
#include "lahaina-cdp.dtsi"

/ {
	model = "Qualcomm Technologies, Inc. Lahaina V2 CDP";
	compatible = "qcom,lahaina-cdp", "qcom,lahaina", "qcom,cdp";
	qcom,board-id = <0x10001 0>;
};
