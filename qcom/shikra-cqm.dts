// SPDX-License-Identifier: BSD-3-Clause
/*
 * Copyright (c) Qualcomm Technologies, Inc. and/or its subsidiaries.
 */

/dts-v1/;

#include "shikra-cqm.dtsi"

/ {
	model = "Qualcomm Technologies, Inc. Shikra CQM SoC";
	compatible = "qcom,shikra-cqm";
	qcom,board-id = <0 0>;
};
