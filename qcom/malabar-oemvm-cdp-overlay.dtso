// SPDX-License-Identifier: BSD-3-Clause
/*
 * Copyright (c) Qualcomm Technologies, Inc. and/or its subsidiaries.
 */
/dts-v1/;
/plugin/;

#include "malabar-oemvm-avf.dtsi"
#include "malabar-oemvm-cdp-avf.dtsi"

/ {
	model = "Qualcomm Technologies, Inc. Malabar OEMVM CDP";
	compatible = "qcom,malabar-cdp", "qcom,malabar", "qcom,malabarp-cdp",
			"qcom,malabarp", "qcom,cdp";
	qcom,board-id = <0x10001 0>, <0x20001 0>;

	host {
	};
};
