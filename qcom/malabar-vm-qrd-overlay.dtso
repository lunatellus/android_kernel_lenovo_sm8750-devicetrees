// SPDX-License-Identifier: BSD-3-Clause
/*
 * Copyright (c) Qualcomm Technologies, Inc. and/or its subsidiaries.
 */
/dts-v1/;
/plugin/;

#include "malabar-vm-avf.dtsi"
#include "malabar-vm-qrd-avf.dtsi"

/ {
	model = "Qualcomm Technologies, Inc. Malabar SVM QRD";
	compatible = "qcom,malabar-qrd", "qcom,malabar", "qcom,malabarp-qrd", "qcom,malabarp",
			   "qcom,qrd";
	qcom,board-id = <0x1000b 0>;

	host {
	};
};
