// SPDX-License-Identifier: BSD-3-Clause
/*
 * Copyright (c) Qualcomm Technologies, Inc. and/or its subsidiaries.
 */

/dts-v1/;

#include "bengalp.dtsi"
#include "bengal-idp.dtsi"
#include "bengal-idp-pmi632.dtsi"

/ {
	model = "Qualcomm Technologies, Inc. BENGALP IDP";
	compatible = "qcom,bengalp-idp", "qcom,bengalp", "qcom,idp";
	qcom,board-id = <34 0>;
};
