// SPDX-License-Identifier: BSD-3-Clause
/*
 * Copyright (c) Qualcomm Technologies, Inc. and/or its subsidiaries.
 */

/dts-v1/;

#include "ravelinp.dtsi"
#include "ravelinp-idp.dtsi"

/ {
	model = "Qualcomm Technologies, Inc. RavelinP IDP";
	compatible = "qcom,ravelinp-idp", "qcom,ravelinp", "qcom,idp";
	qcom,board-id = <34 0>;
};
