// SPDX-License-Identifier: BSD-3-Clause
/*
 * Copyright (c) Qualcomm Technologies, Inc. and/or its subsidiaries.
 */
/dts-v1/;
/plugin/;

#include "malabar-oemvm-avf.dtsi"
#include "malabar-oemvm-rcm-avf.dtsi"

/ {
	model = "Qualcomm Technologies, Inc. Malabar OEMVM RCM";
	compatible = "qcom,malabar-rcm", "qcom,malabar", "qcom,malabarp-rcm", "qcom,malabarp",
			   "qcom,rcm";
	qcom,board-id = <0x10015 0x0>;

	host {
	};
};
