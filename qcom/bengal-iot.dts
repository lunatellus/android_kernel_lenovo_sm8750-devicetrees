// SPDX-License-Identifier: BSD-3-Clause
/*
 * Copyright (c) Qualcomm Technologies, Inc. and/or its subsidiaries.
 */

/dts-v1/;

#include "bengal-iot.dtsi"

/ {
	model = "Qualcomm Technologies, Inc. BENGAL-IOT SoC";
	compatible = "qcom,bengal-iot";
	qcom,board-id = <0 0>;
};
