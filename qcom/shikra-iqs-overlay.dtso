// SPDX-License-Identifier: BSD-3-Clause
/*
 * Copyright (c) Qualcomm Technologies, Inc. and/or its subsidiaries.
 */

/dts-v1/;
/plugin/;

#include "shikra-auto-evk.dtsi"

/ {
  model = "Qualcomm Technologies, Inc. Shikra IQS";
  compatible = "qcom,shikra-iqs", "qcom,shikra";
  qcom,msm-id = <759 0x10000>;
  qcom,board-id = <0x40033 0x0>;
};
