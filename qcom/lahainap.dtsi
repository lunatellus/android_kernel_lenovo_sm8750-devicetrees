// SPDX-License-Identifier: BSD-3-Clause
/*
 * Copyright (c) Qualcomm Technologies, Inc. and/or its subsidiaries.
 */

#include "lahaina.dtsi"

/ {
	model = "Qualcomm Technologies, Inc. LahainaP";
	compatible = "qcom,lahainap";
	qcom,msm-id = <439 0x10000>, <502 0x10000>;
};
