// SPDX-License-Identifier: BSD-3-Clause
/*
 * Copyright (c) Qualcomm Technologies, Inc. and/or its subsidiaries.
 */

/dts-v1/;
/plugin/;

#include "bourtzi-rumi.dtsi"

/ {
	model = "Qualcomm Technologies, Inc. Bourtzi Rumi";
	compatible = "qcom,bourtzi-rumi", "qcom,rumi", "qcom,bourtzi";
	qcom,msm-id = <776 0x10000>;
	qcom,board-id = <15 0>;
};
