// SPDX-License-Identifier: BSD-3-Clause
/*
 * Copyright (c) Qualcomm Technologies, Inc. and/or its subsidiaries.
 */

/dts-v1/;

#include "scuba-iot.dtsi"
#include "scuba-iot-qrd.dtsi"

/ {
	model = "Qualcomm Technologies, Inc. Scuba IOT QRD NON ELDO";
	compatible = "qcom,scuba-qrd", "qcom,scuba-iot", "qcom,qrd";
	qcom,board-id = <0x1000B 0>;
};
