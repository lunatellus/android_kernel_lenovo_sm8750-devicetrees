// SPDX-License-Identifier: BSD-3-Clause
/*
 * Copyright (c) Qualcomm Technologies, Inc. and/or its subsidiaries.
 */

/dts-v1/;

#include "monaco-gh-vm-la-qam.dtsi"

/ {
	model = "Qualcomm Technologies, Inc. Monaco IVI ADAS QAM Gunyah VM";
	compatible = "qcom,monaco", "qcom,qam";
	qcom,board-id = <0x10019 0>;
};
