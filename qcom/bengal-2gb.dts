// SPDX-License-Identifier: BSD-3-Clause
/*
 * Copyright (c) Qualcomm Technologies, Inc. and/or its subsidiaries.
 */

/dts-v1/;

#include "bengal-low-ram.dtsi"

/ {
	model = "Qualcomm Technologies, Inc. Bengal 2Gb DDR HD+ SoC";
	compatible = "qcom,bengal";
	qcom,board-id = <0 0x403>;
};
