// SPDX-License-Identifier: BSD-3-Clause
/*
 * Copyright (c) Qualcomm Technologies, Inc. and/or its subsidiaries.
 */

/dts-v1/;
/plugin/;

#include "vienna-wrd-ddsip.dtsi"
#include "vienna-pmw6100-v1.dtsi"
#include "vienna-le.dtsi"

/ {
	model = "Qualcomm Technologies, Inc. Vienna WRD DDSIP PMW6100 V1";
	compatible = "qcom,vienna-wrd", "qcom,vienna", "qcom,wrd";
	qcom,board-id = <0x2002d 0x0>;
	qcom,pmic-id = <0x10064 0x0 0x0 0x0>;
};

